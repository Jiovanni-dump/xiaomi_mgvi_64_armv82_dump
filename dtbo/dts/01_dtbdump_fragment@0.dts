/dts-v1/;

/ {

	fragment@0 {
		target = <0xffffffff>;

		__overlay__ {

			simtray {
				compatible = "xiaomi,simtray-status";
				status-gpio = <0xffffffff 0xd4 0x00>;
			};
		};
	};

	fragment@1 {
		target = <0xffffffff>;

		__overlay__ {

			t1_gpio_vc_all {
				phandle = <0x01>;

				pins_cmd_dat {
					pinmux = <0x3d00 0x3c00 0x3b00>;
					drive-strength = <0x02>;
					bias-disable;
					output-low;
				};
			};
		};
	};

	fragment@2 {
		target = <0xffffffff>;

		__overlay__ {

			mi_t1_chip {
				compatible = "mdm,mi_t1_chip";
				t1_ant4_vc1 = <0xffffffff 0x3d 0x00>;
				t1_ant4_vc2 = <0xffffffff 0x3c 0x00>;
				t1_ant4_vc3 = <0xffffffff 0x3b 0x00>;
				pinctrl-names = "t1_gpio_vc_all";
				pinctrl-0 = <0x01>;
			};
		};
	};

	fragment@3 {
		target = <0xffffffff>;

		__overlay__ {

			xiaomi_wifi_gpio {
				phandle = <0x02>;

				pins_cmd_dat {
					pinmux = <0x6d00>;
					drive-strength = <0x02>;
					bias-disable;
					input-enable;
				};
			};
		};
	};

	fragment@4 {
		target = <0xffffffff>;

		__overlay__ {

			xiaomi_wifi_gpio {
				compatible = "wlan,xiaomi_wifi_gpio";
				status-gpio = <0xffffffff 0x6d 0x00>;
				debounce-time = <0x1e>;
				pinctrl-names = "default";
				pinctrl-0 = <0x02>;
			};
		};
	};

	fragment@5 {
		target = <0xffffffff>;

		__overlay__ {
			bootargs_ext = "log_buf_len=4M";
		};
	};

	fragment@6 {
		target = <0xffffffff>;

		__overlay__ {
			compatible = "mediatek,disp-leds";

			backlight {
				max-brightness = <0x3fff>;
				min-brightness = <0x01>;
				max-hw-brightness = <0x3fff>;
				led_mode = <0x04>;
				default-state = "FifteenPercent";
			};
		};
	};

	fragment@7 {
		target = <0xffffffff>;

		__overlay__ {

			vin1_open {
				channel = <0x13>;
				pures = <0x00>;
			};

			vin2_open {
				channel = <0x14>;
				pures = <0x00>;
			};

			vin4_open {
				channel = <0x16>;
				pures = <0x00>;
			};

			vin5_open {
				channel = <0x17>;
				pures = <0x00>;
			};
		};
	};

	fragment@8 {
		target = <0xffffffff>;

		__overlay__ {

			vin3_open {
				channel = <0x15>;
				pures = <0x00>;
			};

			vin4_open {
				channel = <0x16>;
				pures = <0x00>;
			};

			vin5_open {
				channel = <0x17>;
				pures = <0x00>;
			};

			vin6_open {
				channel = <0x18>;
				pures = <0x00>;
			};
		};
	};

	fragment@9 {
		target = <0xffffffff>;

		__overlay__ {

			home {
				linux,keycodes = <0x72>;
			};
		};
	};

	fragment@10 {
		target = <0xffffffff>;

		__overlay__ {
			pd-vbus-upper-bound = <0x895440>;
		};
	};

	fragment@11 {
		target = <0xffffffff>;

		__overlay__ {

			lcd-bias-enp1-gpio {
				phandle = <0x03>;

				pins-cmd-dat {
					pinmux = <0xde00>;
					slew-rate = <0x01>;
					output-high;
				};
			};

			lcd-bias-enp0-gpio {
				phandle = <0x04>;

				pins-cmd-dat {
					pinmux = <0xde00>;
					slew-rate = <0x01>;
					output-low;
				};
			};

			lcd-bias-enn1-gpio {
				phandle = <0x05>;

				pins-cmd-dat {
					pinmux = <0xde00>;
					slew-rate = <0x01>;
					output-high;
				};
			};

			lcd-bias-enn0-gpio {
				phandle = <0x06>;

				pins-cmd-dat {
					pinmux = <0xde00>;
					slew-rate = <0x01>;
					output-low;
				};
			};

			lcm-rst-out1-gpio {
				phandle = <0x07>;

				pins-cmd-dat {
					pinmux = <0x900>;
					slew-rate = <0x01>;
					output-high;
				};
			};

			lcm-rst-out0-gpio {
				phandle = <0x08>;

				pins-cmd-dat {
					pinmux = <0xe600>;
					slew-rate = <0x01>;
					output-low;
				};
			};

			lcm-dsi-te {
				phandle = <0x09>;

				pins-cmd-dat {
					pinmux = <0xe501>;
				};
			};

			lcm-led-en1-gpio {
				phandle = <0x0a>;

				pins-cmd-dat {
					pinmux = <0xd700>;
					slew-rate = <0x01>;
					output-high;
				};
			};

			lcm-led-en0-gpio {
				phandle = <0x0b>;

				pins-cmd-dat {
					pinmux = <0xd700>;
					slew-rate = <0x01>;
					output-low;
				};
			};

			lcm-dsi1-te {
				phandle = <0x0c>;

				pins-cmd-dat {
					pinmux = <0xa01>;
				};
			};

			lcm-dsi-gpio {
				phandle = <0x8c>;

				pins-cmd-dat {
					pinmux = <0xe500>;
				};
			};

			lcm-dsi1-gpio {
				phandle = <0x8d>;

				pins-cmd-dat {
					pinmux = <0xa00>;
				};
			};
		};
	};

	fragment@12 {
		target = <0xffffffff>;

		__overlay__ {
			pinctrl-names = "lcd_bias_enp1_gpio\0lcd_bias_enp0_gpio\0lcd_bias_enn1_gpio\0lcd_bias_enn0_gpio\0lcm_rst_out1_gpio\0lcm_rst_out0_gpio\0mode_te_te\0lcm_led_en1_gpio\0lcm_led_en0_gpio\0mode_te_te1";
			pinctrl-0 = <0x03>;
			pinctrl-1 = <0x04>;
			pinctrl-2 = <0x05>;
			pinctrl-3 = <0x06>;
			pinctrl-4 = <0x07>;
			pinctrl-5 = <0x08>;
			pinctrl-6 = <0x09>;
			pinctrl-7 = <0x0a>;
			pinctrl-8 = <0x0b>;
			pinctrl-9 = <0x0c>;
			status = "okay";
		};
	};

	fragment@13 {
		target = <0xffffffff>;

		__overlay__ {
			dl-enable;
		};
	};

	fragment@14 {
		target = <0xffffffff>;

		__overlay__ {
			pinctrl-names = "mode_te_te\0mode_te_te1";
			pinctrl-0 = <0x09>;
			pinctrl-1 = <0x0c>;
			status = "okay";
			lk_mode_index = <0x02>;
			helper-value = <0x00 0x01 0x01 0x01 0x01 0x00 0x01 0x00 0x01 0x00 0x00 0x00 0x01 0x01 0x00 0x01 0x01 0x00 0x01 0x00 0x01 0x00 0x01 0x01 0x00 0x01 0x00 0x01 0x00 0x00 0x01 0x00 0x01 0x00 0x00 0x00 0x00 0x00 0x00 0x00 0x00 0x01 0x00 0x00 0x00 0x00 0x00 0x00 0x01 0x01 0x01 0x01 0x00 0x00 0x00 0x00 0x00 0x00 0x00 0x00 0x01 0x00 0x01 0x00 0x01 0x00 0x01 0x00 0x01 0x00 0x00 0x00 0x00 0x00 0x00 0x00 0x00 0x01 0x01 0x00 0x01>;
		};
	};

	fragment@15 {
		target = <0xffffffff>;

		__overlay__ {
			#address-cells = <0x01>;
			#size-cells = <0x00>;
			init-panel-off;

			panel1@0 {
				compatible = "truly,td4330,cmd";
				reg = <0x00>;
				reset-gpios = <0xffffffff 0x09 0x00>;
				swap-from-dts;
				lane-swap-setting = <0x01 0x02 0x00 0x03 0x04 0x02>;
				pn-swap-setting = <0x01 0x01 0x01 0x01 0x01 0x01>;
				gate-ic = <0x12df>;
				pinctrl-names = "default";

				port {

					endpoint {
						remote-endpoint = <0x0d>;
						phandle = <0x11>;
					};
				};
			};

			panel2@1 {
				compatible = "jdi,nt36672e,vdo,120hz";
				reg = <0x01>;
				reset-gpios = <0xffffffff 0x09 0x00>;
				swap-from-dts;
				gate-ic = <0x12df>;
				pinctrl-names = "default";

				port {

					endpoint {
						remote-endpoint = <0x0e>;
						phandle = <0x12>;
					};
				};
			};

			panel3@2 {
				compatible = "jdi,nt36672e,cphy,vdo";
				reg = <0x02>;
				reset-gpios = <0xffffffff 0x09 0x00>;
				gate-ic = <0x12df>;
				pinctrl-names = "default";

				port {

					endpoint {
						remote-endpoint = <0x0f>;
						phandle = <0x13>;
					};
				};
			};

			panel4@3 {
				compatible = "jdi,nt36672e,vdo,60hz";
				reg = <0x03>;
				reset-gpios = <0xffffffff 0x09 0x00>;
				gate-ic = <0x12df>;
				pinctrl-names = "default";

				port {

					endpoint {
						remote-endpoint = <0x10>;
						phandle = <0x14>;
					};
				};
			};

			ports {

				port {

					endpoint@0 {
						remote-endpoint = <0x11>;
						phandle = <0x0d>;
					};

					endpoint@1 {
						remote-endpoint = <0x12>;
						phandle = <0x0e>;
					};

					endpoint@2 {
						remote-endpoint = <0x13>;
						phandle = <0x0f>;
					};

					endpoint@3 {
						remote-endpoint = <0x14>;
						phandle = <0x10>;
					};
				};
			};
		};
	};

	fragment@16 {
		target = <0xffffffff>;

		__overlay__ {
			interrupt-parent = <0xffffffff>;
			interrupts = <0x0a 0x01 0x0a 0x01>;
			status = "okay";
		};
	};

	fragment@17 {
		target = <0xffffffff>;

		__overlay__ {
			status = "okay";
			#address-cells = <0x01>;
			#size-cells = <0x00>;

			panel1@0 {
				compatible = "n12_42_02_0a_dsc_cmd,lcm";
				reg = <0x00>;
				reset-gpios = <0xffffffff 0xe6 0x00>;
				mi,esd-err-irq-gpio = <0xffffffff 0x0e 0x2002>;
				lane-swap-setting = <0x01 0x02 0x00 0x03 0x04 0x02>;
				pn-swap-setting = <0x01 0x01 0x01 0x01 0x01 0x01>;
				pinctrl-names = "default";
				vcn18io-supply = <0xffffffff>;
				vibr-supply = <0xffffffff>;
				dvdd-gpios = <0xffffffff 0x56 0x00>;
				x7-bucken-gpios = <0xffffffff 0x99 0x00>;
				x7-vio18-gpios = <0xffffffff 0x5b 0x00>;
				phandle = <0x2e>;

				port {

					endpoint {
						remote-endpoint = <0x15>;
						phandle = <0x16>;
					};
				};
			};

			panel2@1 {
				compatible = "n12_36_02_0b_dsc_cmd,lcm";
				reg = <0x01>;
				reset-gpios = <0xffffffff 0xe6 0x00>;
				mi,esd-err-irq-gpio = <0xffffffff 0x0e 0x2002>;
				lane-swap-setting = <0x01 0x02 0x00 0x03 0x04 0x02>;
				pn-swap-setting = <0x01 0x01 0x01 0x01 0x01 0x01>;
				pinctrl-names = "default";
				vcn18io-supply = <0xffffffff>;
				vibr-supply = <0xffffffff>;
				dvdd-gpios = <0xffffffff 0x56 0x00>;
				x7-bucken-gpios = <0xffffffff 0x99 0x00>;
				x7-vio18-gpios = <0xffffffff 0x5b 0x00>;
				phandle = <0x2f>;

				port {

					endpoint {
						remote-endpoint = <0x15>;
						phandle = <0x8e>;
					};
				};
			};

			ports {

				port {

					endpoint {
						remote-endpoint = <0x16>;
						phandle = <0x15>;
					};
				};
			};
		};
	};

	fragment@18 {
		target = <0xffffffff>;

		__overlay__ {

			epa-elna {
				parts = <0xffffffff 0xffffffff>;

				common {

					flags-0 {
						rx-mode = [00];
						fe-ant-cnt = [81];
						fe-main-bt-share-lp2g = [80];
						fe-conn-spdt = [80];
						fe-reserved = [80];
					};
				};

				wifi {

					flags-0 {
						epa-option = [aa];
					};
				};

				bt {

					flags-0 {
						epa-elna;
					};
				};
			};
		};
	};

	fragment@19 {
		target = <0xffffffff>;

		__overlay__ {
			status = "okay";
			pinctrl-names = "default";
			pinctrl-0 = <0x17>;

			volup-key {
				wakeup-source;
				debounce-interval = <0x20>;
				label = "Volume_Up";
				gpios = <0xffffffff 0xc4 0x01>;
				linux,code = <0x73>;
				linux,input-type = <0x01>;
			};
		};
	};

	fragment@20 {
		target = <0xffffffff>;

		__overlay__ {

			key-default {
				phandle = <0x17>;

				pinkey {
					pinmux = <0xc400>;
					input-enable;
					bias-pull-up = <0x65>;
				};
			};
		};
	};

	fragment@21 {
		target = <0xffffffff>;

		__overlay__ {
			pinctrl-names = "default\0sleep\0work";
			pinctrl-0 = <0x18>;
			pinctrl-1 = <0x19>;
			pinctrl-2 = <0x1a>;
			max-link-speed = <0x03>;
			status = "okay";
		};
	};

	fragment@22 {
		target = <0xffffffff>;

		__overlay__ {
			pinctrl-names = "default";
			pinctrl-0 = <0x1b>;
			status = "disabled";
		};
	};

	fragment@23 {
		target = <0xffffffff>;

		__overlay__ {
			status = "okay";
		};
	};

	fragment@24 {
		target = <0xffffffff>;

		__overlay__ {
			status = "disabled";
		};
	};

	fragment@25 {
		target = <0xffffffff>;

		__overlay__ {

			pcie0-default {
				phandle = <0x18>;

				pins-cmd-dat {
					pinmux = <0x8f00>;
					output-low;
				};

				pins-cmd-dat1 {
					pinmux = <0x9000 0x9100>;
					bias-pull-up;
					input-enable;
				};
			};

			pcie0-work {
				phandle = <0x1a>;

				pins-cmd-dat {
					pinmux = <0x8f01 0x9101>;
					bias-pull-up;
				};

				pins-cmd-dat1 {
					pinmux = <0x9000>;
					bias-pull-down;
					input-enable;
				};
			};

			pcie0-sleep {
				phandle = <0x19>;

				pins-cmd-dat {
					pinmux = <0x8f00>;
					output-low;
				};

				pins-cmd-dat1 {
					pinmux = <0x9000 0x9100>;
					bias-pull-up;
					input-enable;
				};
			};

			pcie1-default {
				phandle = <0x1b>;

				pins-cmd-dat {
					pinmux = <0x202 0x302 0x402>;
					bias-pull-up;
				};
			};
		};
	};

	fragment@26 {
		target = <0xffffffff>;

		__overlay__ {
			tcpc,en_floatgnd;
			wd,wd0_tsleep = <0x01>;
			wd,wd0_tdet = <0x03>;

			port {

				endpoint {
					remote-endpoint = <0x1c>;
					phandle = <0x1d>;
				};
			};
		};
	};

	fragment@27 {
		target = <0xffffffff>;

		__overlay__ {
			orientation-switch;
			mode-switch;
			accessory;

			port {

				endpoint {
					remote-endpoint = <0x1d>;
					phandle = <0x1c>;
				};
			};
		};
	};

	fragment@28 {
		target = <0xffffffff>;

		__overlay__ {
			status = "okay";
		};
	};

	fragment@29 {
		target = <0xffffffff>;

		__overlay__ {
			status = "okay";
		};
	};

	fragment@30 {
		target = <0xffffffff>;

		__overlay__ {
			clock-frequency = <0x61a80>;

			aw882xx_smartpa@34 {
				compatible = "awinic,aw882xx_smartpa";
				#sound-dai-cells = <0x00>;
				reg = <0x34>;
				reset-gpio = <0xffffffff 0xbc 0x00>;
				irq-gpio = <0xffffffff 0xd9 0x00>;
				spk-sw-gpio = <0xffffffff 0x6a 0x00>;
				sound-channel = <0x00>;
				aw-re-min = <0x1388>;
				aw-re-max = <0x1d4c>;
				status = "okay";
				phandle = <0x1e>;
			};

			aw882xx_smartpa@35 {
				compatible = "awinic,aw882xx_smartpa";
				#sound-dai-cells = <0x00>;
				reg = <0x35>;
				reset-gpio = <0xffffffff 0xbc 0x00>;
				irq-gpio = <0xffffffff 0xcf 0x00>;
				sound-channel = <0x01>;
				aw-re-min = <0x1770>;
				aw-re-max = <0x1f40>;
				status = "okay";
				phandle = <0x1f>;
			};
		};
	};

	fragment@31 {
		target = <0xffffffff>;

		__overlay__ {
			mediatek,spk-i2s = <0x19 0x18>;

			mediatek,speaker-codec {
				sound-dai = <0x1e 0x1f>;
			};

			mediatek,speaker-codec-fs {
				sound-dai = <0x1e>;
			};
		};
	};

	fragment@32 {
		target = <0xffffffff>;

		__overlay__ {
			flavor-bin = "dx3";
		};
	};

	fragment@33 {
		target = <0xffffffff>;

		__overlay__ {
			flavor-bin = "dx3";
		};
	};

	fragment@34 {
		target = <0xffffffff>;

		__overlay__ {
			regulator-always-on;
		};
	};

	fragment@35 {
		target = <0xffffffff>;

		__overlay__ {
			regulator-always-on;
		};
	};

	fragment@36 {
		target = <0xffffffff>;

		__overlay__ {
			regulator-always-on;
		};
	};

	fragment@37 {
		target = <0xffffffff>;

		__overlay__ {
			regulator-always-on;
		};
	};

	fragment@38 {
		target = <0xffffffff>;

		__overlay__ {
			regulator-always-on;
		};
	};

	fragment@39 {
		target = <0xffffffff>;

		__overlay__ {

			sc8581_master_int_default {
				phandle = <0x8f>;

				pins-cmd-dat {
					pinmux = <0x4c00>;
					input-enable;
				};
			};

			sc8581_lpm_output_high {
				phandle = <0x90>;

				pins-cmd-dat {
					pinmux = <0x4a00>;
					slew-rate = <0x01>;
					output-high;
				};
			};

			sc8581_lpm_output_low {
				phandle = <0x91>;

				pins-cmd-dat {
					pinmux = <0x4a00>;
					slew-rate = <0x01>;
					output-low;
				};
			};
		};
	};

	fragment@40 {
		target = <0xffffffff>;

		__overlay__ {
			clock-frequency = <0x61a80>;
			status = "okay";

			bq28z610@55 {
				compatible = "bq28z610";
				reg = <0x55>;
				max_chg_power_120w;
				enable_shutdown_delay;
				normal_shutdown_vbat_1s = <0xd48>;
				critical_shutdown_vbat_1s = <0xd0c>;
				report_full_rsoc_1s = <0x251c>;
				soc_gap_1s = <0x02>;
				soc_decimal_rate = <0x00 0x26 0x0a 0x23 0x14 0x21 0x1e 0x21 0x28 0x21 0x32 0x21 0x3c 0x21 0x46 0x1e 0x50 0x19 0x5a 0x14 0x5f 0x0a>;
			};
		};
	};

	fragment@41 {
		target = <0xffffffff>;

		__overlay__ {
			clock-frequency = <0x61a80>;
			status = "okay";

			sc858x-charger@6E {
				compatible = "sc,sc858x-master";
				reg = <0x6e>;
				sc,sc858x,irq-gpio = <0xffffffff 0x0b 0x02>;
				sc,sc858x,bat-ovp-disable = <0x00>;
				sc,sc858x,bat-ovp-threshold = <0x0b>;
				sc,sc858x,bat-ocp-disable = <0x01>;
				sc,sc858x,bat-ocp-threshold = <0x04>;
				sc,sc858x,usb-ovp-threshold = <0x0b>;
				sc,sc858x,wpc-ovp-threshold = <0x0b>;
				sc,sc858x,bus-ovp-threshold = <0x28>;
				sc,sc858x,out-ovp-threshold = <0x01>;
				sc,sc858x,bus-ocp-disable = <0x00>;
				sc,sc858x,bus-ocp-threshold = <0x0f>;
				sc,sc858x,bus-ucp-fall-dg = <0x01>;
				sc,sc858x,pmid2out-ovp-threshold = <0x02>;
				sc,sc858x,pmid2out-uvp-threshold = <0x07>;
				sc,sc858x,fsw-set = <0x14>;
				sc,sc858x,acdrv-hi-en = <0x01>;
				sc,sc858x,ss-timeout = <0x05>;
				sc,sc858x,wd-timeout = <0x00>;
				sc,sc858x,mode = <0x01>;
				sc,sc858x,tsbat-flt-disable = <0x01>;
				sc,sc858x,tshut-disable = <0x01>;
				sc,sc858x,wpc-ovp-disable = <0x00>;
				sc,sc858x,usb-ovp-disable = <0x00>;
				sc,sc858x,bus-ovp-disable = <0x00>;
				sc,sc858x,out-ovp-disable = <0x00>;
				sc,sc858x,sense-r-mohm = <0x01>;
				mt6375_ovp_en_gpio = <0xffffffff 0x1a 0x00>;
			};

			sc858x-charger@6F {
				compatible = "sc,sc858x-slave";
				reg = <0x6f>;
				sc,sc858x,irq-gpio = <0xffffffff 0x0c 0x02>;
				sc,sc858x,bat-ovp-disable = <0x00>;
				sc,sc858x,bat-ovp-threshold = <0x0b>;
				sc,sc858x,bat-ocp-disable = <0x01>;
				sc,sc858x,bat-ocp-threshold = <0x04>;
				sc,sc858x,usb-ovp-threshold = <0x0b>;
				sc,sc858x,wpc-ovp-threshold = <0x0b>;
				sc,sc858x,bus-ovp-threshold = <0x28>;
				sc,sc858x,out-ovp-threshold = <0x01>;
				sc,sc858x,bus-ocp-disable = <0x00>;
				sc,sc858x,bus-ocp-threshold = <0x0f>;
				sc,sc858x,bus-ucp-fall-dg = <0x01>;
				sc,sc858x,pmid2out-ovp-threshold = <0x02>;
				sc,sc858x,pmid2out-uvp-threshold = <0x07>;
				sc,sc858x,fsw-set = <0x14>;
				sc,sc858x,acdrv-hi-en = <0x01>;
				sc,sc858x,ss-timeout = <0x00>;
				sc,sc858x,wd-timeout = <0x00>;
				sc,sc858x,mode = <0x01>;
				sc,sc858x,tsbat-flt-disable = <0x01>;
				sc,sc858x,tshut-disable = <0x01>;
				sc,sc858x,wpc-ovp-disable = <0x00>;
				sc,sc858x,usb-ovp-disable = <0x00>;
				sc,sc858x,bus-ovp-disable = <0x00>;
				sc,sc858x,out-ovp-disable = <0x00>;
				sc,sc858x,sense-r-mohm = <0x01>;
			};
		};
	};

	fragment@42 {
		target = <0xffffffff>;

		__overlay__ {
			max_charger_voltage = <0xb71b00>;
			fv = <0x1194>;
			fv_normal = <0x1180>;
			fv_ffc = <0x11c6>;
			iterm = <0x118>;
			iterm_warm = <0x118>;
			usb_charger_current = <0x7a120>;
			ac_charger_current = <0x186a00>;
			ac_charger_input_current = <0x186a00>;
			charging_host_charger_current = <0xdbba0>;
			ffc_low_tbat = <0x96>;
			ffc_medium_tbat = <0x12c>;
			ffc_warm_tbat = <0x15e>;
			ffc_little_high_tbat = <0x190>;
			ffc_high_tbat = <0x1e0>;
			ffc_high_soc = <0x5f>;
			step_fallback_hyst = <0x19>;
			step_forward_hyst = <0x05>;
			jeita_fallback_hyst = <0x0a>;
			jeita_forward_hyst = <0x0a>;
			mt6368_moscon1_control;
			en_floatgnd;
			rust_support;
			smart_snschg_support;
			pd2_input_current = <0x19f0a0>;
			min_charger_voltage_1 = <0x4630c0>;
			min_charger_voltage_2 = <0x4630c0>;
			sbu_uart_en = <0xffffffff 0x9c 0x00>;
			io-channels = <0xffffffff 0x16>;
			io-channel-names = "slave_connector_auxadc";
			jeita_fcc_cfg = <0xffffff9c 0x00 0x1036 0x320 0x1f4 0x01 0x32 0x1036 0xa8c 0x640 0x33 0x64 0x1036 0x13ec 0xd98 0x65 0x96 0x1036 0x1edc 0x1824 0x97 0x1d6 0x1036 0x5528 0x5528 0x1d7 0x258 0x1004 0x9c4 0x9c4>;
			jeita_fv_cfg = <0xffffff9c 0x00 0x1194 0x01 0x32 0x1194 0x33 0x64 0x1194 0x65 0x96 0x1194 0x97 0x1d6 0x11c6 0x1d7 0x258 0x1004>;
			step_chg_cfg_1_cycle = <0xbb8 0x1036 0x5528 0x1036 0x109a 0x3d54 0x109b 0x1162 0x3390 0x1163 0x11c6 0x2904>;
			iterm_ffc_1_cycle = <0x983>;
			iterm_ffc_little_warm_1_cycle = <0xf6f>;
			iterm_ffc_warm_1_cycle = <0x12b1>;
			iterm_ffc_hot_1_cycle = <0x1805>;
			step_chg_cfg_100_cycle = <0xbb8 0x1018 0x5528 0x1019 0x107c 0x3d54 0x107d 0x114e 0x3390 0x114f 0x11c6 0x2904>;
			iterm_ffc_100_cycle = <0xdb5>;
			iterm_ffc_little_warm_100_cycle = <0x1294>;
			iterm_ffc_warm_100_cycle = <0x173c>;
			iterm_ffc_hot_100_cycle = <0x1be3>;
			step_chg_cfg_200_cycle = <0xbb8 0x1018 0x5528 0x1019 0x107c 0x3d54 0x107d 0x114e 0x3390 0x114f 0x11c6 0x2904>;
			iterm_ffc_200_cycle = <0xbd1>;
			iterm_ffc_little_warm_200_cycle = <0x117d>;
			iterm_ffc_warm_200_cycle = <0x1679>;
			iterm_ffc_hot_200_cycle = <0x1b75>;
			step_chg_cfg_300_cycle = <0xbb8 0x1018 0x5528 0x1019 0x107c 0x3d54 0x107d 0x114e 0x3390 0x114f 0x11c6 0x2904>;
			iterm_ffc_300_cycle = <0xb1c>;
			iterm_ffc_little_warm_300_cycle = <0x1104>;
			iterm_ffc_warm_300_cycle = <0x1606>;
			iterm_ffc_hot_300_cycle = <0x1b07>;
			step_chg_cfg_400_cycle = <0xbb8 0x1018 0x5528 0x1019 0x107c 0x3d54 0x107d 0x114e 0x3390 0x114f 0x11c6 0x2904>;
			iterm_ffc_400_cycle = <0x9ed>;
			iterm_ffc_little_warm_400_cycle = <0xf20>;
			iterm_ffc_warm_400_cycle = <0x14dd>;
			iterm_ffc_hot_400_cycle = <0x1a99>;
			step_chg_cfg_500_cycle = <0xbb8 0x1018 0x5528 0x1019 0x107c 0x3d54 0x107d 0x114e 0x3390 0x114f 0x11c6 0x2904>;
			iterm_ffc_500_cycle = <0x938>;
			iterm_ffc_little_warm_500_cycle = <0xdb5>;
			iterm_ffc_warm_500_cycle = <0x13f0>;
			iterm_ffc_hot_500_cycle = <0x1a2b>;
			step_chg_cfg_600_cycle = <0xbb8 0x1018 0x5528 0x1019 0x107c 0x3d54 0x107d 0x114e 0x3390 0x114f 0x11c6 0x2904>;
			iterm_ffc_600_cycle = <0x846>;
			iterm_ffc_little_warm_600_cycle = <0xd3c>;
			iterm_ffc_warm_600_cycle = <0x137d>;
			iterm_ffc_hot_600_cycle = <0x19bd>;
			step_chg_cfg_700_cycle = <0xbb8 0x1018 0x5528 0x1019 0x107c 0x3d54 0x107d 0x114e 0x3390 0x114f 0x11c6 0x2904>;
			iterm_ffc_700_cycle = <0x809>;
			iterm_ffc_little_warm_700_cycle = <0xc4a>;
			iterm_ffc_warm_700_cycle = <0x12cd>;
			iterm_ffc_hot_700_cycle = <0x194f>;
			step_chg_cfg_800_cycle = <0xbb8 0x1018 0x4394 0x1019 0x107c 0x30d4 0x107d 0x114e 0x2904 0x114f 0x11c6 0x2094>;
			iterm_ffc_800_cycle = <0x717>;
			iterm_ffc_little_warm_800_cycle = <0xd3c>;
			iterm_ffc_warm_800_cycle = <0x137d>;
			iterm_ffc_hot_800_cycle = <0x18e1>;
			step_chg_cfg_900_cycle = <0xbb8 0x1018 0x4394 0x1019 0x107c 0x30d4 0x107d 0x114e 0x2904 0x114f 0x11c6 0x2094>;
			iterm_ffc_900_cycle = <0x662>;
			iterm_ffc_little_warm_900_cycle = <0xdb5>;
			iterm_ffc_warm_900_cycle = <0x13f0>;
			iterm_ffc_hot_900_cycle = <0x1873>;
			step_chg_cfg_1000_cycle = <0xbb8 0x1018 0x4394 0x1019 0x107c 0x30d4 0x107d 0x114e 0x2904 0x114f 0x11c6 0x2094>;
			iterm_ffc_1000_cycle = <0x846>;
			iterm_ffc_little_warm_1000_cycle = <0xf20>;
			iterm_ffc_warm_1000_cycle = <0x14dd>;
			iterm_ffc_hot_1000_cycle = <0x1c51>;
			step_chg_cfg_1100_cycle = <0xbb8 0x1018 0x4394 0x1019 0x107c 0x30d4 0x107d 0x114e 0x2904 0x114f 0x11c6 0x2094>;
			iterm_ffc_1100_cycle = <0xb1c>;
			iterm_ffc_little_warm_1100_cycle = <0x1104>;
			iterm_ffc_warm_1100_cycle = <0x1606>;
			iterm_ffc_hot_1100_cycle = <0x1c51>;
			step_chg_cfg_1200_cycle = <0xbb8 0x1018 0x4394 0x1019 0x107c 0x30d4 0x107d 0x114e 0x2904 0x114f 0x11c6 0x2094>;
			iterm_ffc_1200_cycle = <0xacd>;
			iterm_ffc_little_warm_1200_cycle = <0x1294>;
			iterm_ffc_warm_1200_cycle = <0x173c>;
			iterm_ffc_hot_1200_cycle = <0x1c51>;
			thermal_limit_dcp = <0x76c 0x76c 0x76c 0x76c 0x76c 0x76c 0x76c 0x76c 0x76c 0x76c 0x76c 0x76c 0x5dc 0x578 0x4b0 0x3e8>;
			thermal_limit_qc2 = <0x9c4 0x9c4 0x9c4 0x9c4 0x9c4 0x9c4 0x9c4 0x9c4 0x9c4 0x9c4 0x9c4 0x7d0 0x5dc 0x5dc 0x3e8 0x1f4>;
			thermal_limit_qc3_18w = <0x9c4 0x9c4 0x9c4 0x9c4 0x9c4 0x9c4 0x960 0x8fc 0x898 0x834 0x5dc 0x3e8 0x320 0x2bc 0x258 0x1f4>;
			thermal_limit_qc3_27w = <0x9c4 0x9c4 0x9c4 0x9c4 0x9c4 0x9c4 0x960 0x8fc 0x898 0x834 0x5dc 0x3e8 0x320 0x2bc 0x258 0x1f4>;
			thermal_limit_qc35 = <0x9c4 0x9c4 0x9c4 0x9c4 0x9c4 0x9c4 0x960 0x8fc 0x898 0x834 0x5dc 0x3e8 0x320 0x2bc 0x258 0x1f4>;
			thermal_limit_pd = <0x5528 0x3e80 0x2ee0 0x2328 0x1f40 0x1b58 0x1770 0x1388 0xfa0 0xdac 0xbb8 0x960 0x7d0 0x5dc 0x4b0 0x3e8>;
		};
	};

	fragment@43 {
		target = <0xffffffff>;

		__overlay__ {
			max_charger_voltage = <0xb71b00>;
			fv = <0x1180>;
			fv_normal = <0x116c>;
			fv_ffc = <0x11b2>;
			iterm = <0x104>;
			iterm_warm = <0x104>;
			usb_charger_current = <0x7a120>;
			ac_charger_current = <0x186a00>;
			ac_charger_input_current = <0x186a00>;
			charging_host_charger_current = <0xdbba0>;
			ffc_low_tbat = <0x96>;
			ffc_medium_tbat = <0x15e>;
			ffc_little_high_tbat = <0x190>;
			ffc_high_tbat = <0x1e0>;
			ffc_high_soc = <0x5f>;
			step_fallback_hyst = <0x19>;
			step_forward_hyst = <0x05>;
			jeita_fallback_hyst = <0x0a>;
			jeita_forward_hyst = <0x0a>;
			mt6368_moscon1_control;
			en_floatgnd;
			wlschg_support;
			rust_support;
			smart_snschg_support;
			pd2_input_current = <0x19f0a0>;
			min_charger_voltage_1 = <0x4630c0>;
			min_charger_voltage_2 = <0x44aa20>;
			sbu_uart_en = <0xffffffff 0x9c 0x00>;
			io-channels = <0xffffffff 0x16>;
			io-channel-names = "slave_connector_auxadc";
			jeita_fcc_cfg = <0xffffff9c 0x00 0x1068 0x384 0x1b8 0x01 0x32 0x1036 0x960 0x960 0x33 0x64 0x1036 0x11f8 0x11f8 0x65 0x96 0x1036 0x1b58 0x1b58 0x97 0x1d6 0x1036 0x5528 0x5528 0x1d7 0x258 0x1004 0x960 0x960>;
			jeita_fv_cfg = <0xffffff9c 0x00 0x1180 0x01 0x32 0x1180 0x33 0x64 0x1180 0x65 0x96 0x1180 0x97 0x1d6 0x11b2 0x1d7 0x258 0x1004>;
			step_chg_cfg_1_cycle = <0xbb8 0x1036 0x55f0 0x1037 0x109a 0x3d54 0x109b 0x1162 0x3840 0x1163 0x11b2 0x251c>;
			iterm_ffc_1_cycle = <0xaf2>;
			iterm_ffc_little_warm_1_cycle = <0x10a2>;
			iterm_ffc_warm_1_cycle = <0x16f3>;
			step_chg_cfg_100_cycle = <0xbb8 0x1018 0x55f0 0x1019 0x107c 0x3d54 0x107d 0x114e 0x3840 0x114f 0x119e 0x251c>;
			iterm_ffc_100_cycle = <0xaf2>;
			iterm_ffc_little_warm_100_cycle = <0x10a2>;
			iterm_ffc_warm_100_cycle = <0x16f3>;
			step_chg_cfg_300_cycle = <0xbb8 0x1018 0x55f0 0x1019 0x107c 0x3d54 0x107d 0x1144 0x3840 0x1145 0x1194 0x251c>;
			iterm_ffc_300_cycle = <0xaf2>;
			iterm_ffc_little_warm_300_cycle = <0x10a2>;
			iterm_ffc_warm_300_cycle = <0x16f3>;
			step_chg_cfg_500_cycle = <0xbb8 0x1018 0x55f0 0x1019 0x107c 0x3d54 0x107d 0x1144 0x3840 0x1145 0x1194 0x251c>;
			iterm_ffc_500_cycle = <0xaf2>;
			iterm_ffc_little_warm_500_cycle = <0x10a2>;
			iterm_ffc_warm_500_cycle = <0x16f3>;
			step_chg_cfg_800_cycle = <0xbb8 0x1018 0x43f8 0x1019 0x107c 0x30d4 0x107d 0x1144 0x2cc4 0x1145 0x1194 0x1d74>;
			iterm_ffc_800_cycle = <0xaf2>;
			iterm_ffc_little_warm_800_cycle = <0x10a2>;
			iterm_ffc_warm_800_cycle = <0x16f3>;
			step_chg_cfg_1_cycle_eea = <0xbb8 0x1036 0x55f0 0x1037 0x10ae 0x2648 0x10af 0x1108 0x2648 0x1109 0x116c 0x2648>;
			iterm_ffc_1_cycle_eea = <0xf5>;
			iterm_ffc_little_warm_1_cycle_eea = <0xf5>;
			iterm_ffc_warm_1_cycle_eea = <0xf5>;
			step_chg_cfg_100_cycle_eea = <0xbb8 0x1018 0x55f0 0x1019 0x10ae 0x2648 0x10af 0x1108 0x2648 0x1109 0x1162 0x2648>;
			iterm_ffc_100_cycle_eea = <0xf5>;
			iterm_ffc_little_warm_100_cycle_eea = <0xf5>;
			iterm_ffc_warm_100_cycle_eea = <0xf5>;
			step_chg_cfg_300_cycle_eea = <0xbb8 0x1018 0x55f0 0x1019 0x10ae 0x2648 0x10af 0x1108 0x2648 0x1109 0x1158 0x2648>;
			iterm_ffc_300_cycle_eea = <0xf5>;
			iterm_ffc_little_warm_300_cycle_eea = <0xf5>;
			iterm_ffc_warm_300_cycle_eea = <0xf5>;
			step_chg_cfg_500_cycle_eea = <0xbb8 0x1018 0x55f0 0x1019 0x10ae 0x2648 0x10af 0x1108 0x2648 0x1109 0x1158 0x2648>;
			iterm_ffc_500_cycle_eea = <0xf5>;
			iterm_ffc_little_warm_500_cycle_eea = <0xf5>;
			iterm_ffc_warm_500_cycle_eea = <0xf5>;
			step_chg_cfg_800_cycle_eea = <0xbb8 0x1018 0x44c0 0x1019 0x10ae 0x1ea0 0x10af 0x1108 0x1ea0 0x1109 0x1144 0x1ea0>;
			iterm_ffc_800_cycle_eea = <0xf5>;
			iterm_ffc_little_warm_800_cycle_eea = <0xf5>;
			iterm_ffc_warm_800_cycle_eea = <0xf5>;
			thermal_limit_dcp = <0x76c 0x76c 0x76c 0x76c 0x76c 0x76c 0x76c 0x76c 0x76c 0x76c 0x76c 0x76c 0x5dc 0x578 0x4b0 0x3e8>;
			thermal_limit_qc2 = <0x9c4 0x9c4 0x9c4 0x9c4 0x9c4 0x9c4 0x9c4 0x9c4 0x9c4 0x9c4 0x9c4 0x7d0 0x5dc 0x5dc 0x3e8 0x1f4>;
			thermal_limit_qc3_18w = <0x9c4 0x9c4 0x9c4 0x9c4 0x9c4 0x9c4 0x960 0x8fc 0x898 0x834 0x5dc 0x3e8 0x320 0x2bc 0x258 0x1f4>;
			thermal_limit_qc3_27w = <0x9c4 0x9c4 0x9c4 0x9c4 0x9c4 0x9c4 0x960 0x8fc 0x898 0x834 0x5dc 0x3e8 0x320 0x2bc 0x258 0x1f4>;
			thermal_limit_qc35 = <0x9c4 0x9c4 0x9c4 0x9c4 0x9c4 0x9c4 0x960 0x8fc 0x898 0x834 0x5dc 0x3e8 0x320 0x2bc 0x258 0x1f4>;
			thermal_limit_pd = <0x5528 0x3e80 0x2ee0 0x2328 0x1f40 0x1b58 0x1770 0x1388 0xfa0 0xdac 0xbb8 0x960 0x7d0 0x5dc 0x4b0 0x3e8>;
			thermal_limit_bpp = <0x3e8 0x352 0x352 0x352 0x352 0x352 0x352 0x2bc 0x2bc 0x1f4 0x1f4 0x1f4 0x1f4 0x1f4 0x190 0x12c>;
			thermal_limit_bpp_plus = <0x44c 0x44c 0x44c 0x44c 0x44c 0x2bc 0x2bc 0x258 0x258 0x1f4 0x1f4 0x1f4 0x1f4 0x1f4 0x190 0x12c>;
			thermal_limit_epp = <0x7d0 0x5dc 0x5dc 0x5dc 0x5dc 0x352 0x352 0x2bc 0x2bc 0x1f4 0x1f4 0x1f4 0x1f4 0x1f4 0x190 0x12c>;
			thermal_limit_epp_plus_20W = <0xfa0 0xd48 0xc80 0x898 0x708 0x5dc 0x514 0x44c 0x3e8 0x320 0x2bc 0x258 0x1f4 0x1f4 0x190 0x12c>;
			thermal_limit_epp_plus_30W = <0x1770 0x1130 0x1068 0xd48 0xaf0 0xa28 0x898 0x898 0x708 0x44c 0x3e8 0x320 0x2bc 0x258 0x1f4 0x190>;
			thermal_limit_epp_plus_50W = <0x2710 0x2328 0x1f40 0x1b58 0x1770 0x1388 0xfa0 0xdac 0xc80 0x9c4 0x7d0 0x3e8 0x320 0x258 0x1f4 0x190>;
		};
	};

	fragment@44 {
		target = <0xffffffff>;

		__overlay__ {

			spi0_bus_active {
				phandle = <0x20>;

				pins_cmd_dat {
					pinmux = <0xca01 0xc901 0xc701>;
					slew-rate = <0x00>;
					drive-strength = <0x02>;
					bias-pull-down;
				};
			};

			spi0_cs_active {
				phandle = <0x21>;

				pins_cmd_dat {
					pinmux = <0xc801>;
					slew-rate = <0x00>;
					drive-strength = <0x02>;
					bias-pull-up;
				};
			};

			spi0_sleep {
				phandle = <0x24>;

				pins_cmd_dat {
					pinmux = <0xc700 0xc800 0xc900 0xca00>;
					slew-rate = <0x00>;
					bias-pull-down;
					input-enable;
				};
			};

			uart1_tx_active {
				phandle = <0x22>;

				pins_cmd_dat {
					pinmux = <0xcd01>;
					slew-rate = <0x00>;
					bias-disable;
				};
			};

			uart1_rx_active {
				phandle = <0x23>;

				pins_cmd_dat {
					pinmux = <0xce01>;
					slew-rate = <0x00>;
					bias-disable;
				};
			};

			uart1_sleep {
				phandle = <0x25>;

				pins_cmd_dat {
					pinmux = <0xcd00 0xce00>;
					slew_rate = <0x00>;
					bias-pull-down;
					input-anable;
				};
			};
		};
	};

	fragment@45 {
		target = <0xffffffff>;

		__overlay__ {
			status = "okay";
			dma-mode;
			mediatek,pad-select = <0x00>;

			nvt {
				compatible = "novatek,vis-display";
				reg = <0x00>;
				status = "okay";
				spi-max-frequency = <0x18cba80>;
				nvt,always08 = <0xffffffff 0x99 0x00>;
				nvt,always18 = <0xffffffff 0x5b 0x00>;
				nvt,resetN = <0xffffffff 0x7e 0x00>;
				nvt,abnormal = <0xffffffff 0x14 0x00>;
				nvt,ready = <0xffffffff 0xbe 0x00>;
				pinctrl-names = "default\0sleep";
				pinctrl-0 = <0x20 0x21 0x22 0x23>;
				pinctrl-1 = <0x24 0x25>;
			};
		};
	};

	fragment@46 {
		target = <0xffffffff>;

		__overlay__ {
			status = "okay";
		};
	};

	fragment@47 {
		target = <0xffffffff>;

		__overlay__ {
			DISABLE_MTKBATTERY = <0x01>;
		};
	};

	fragment@48 {
		target = <0xffffffff>;

		__overlay__ {
			usb-charger-current = <0x7a120>;
			ac-charger-current = <0x16e360>;
			ac-charger-input-current = <0x1e8480>;
			non-std-ac-charger-current = <0x16e360>;
			charging-host-charger-current = <0x16e360>;
			ta-ac-charger-current = <0x16e360>;
			pd-charger-current = <0x16e360>;
			temp-t4-threshold = <0x3c>;
			temp-t3-threshold = <0x2d>;
			pre-charger-current = <0x55730>;
			fast-charge-voltage = <0xc1c>;
			max-charger-voltage = <0xb71b00>;
			boot-battery-voltage-max = <0xd7a>;
			shutdown-voltage = <0xc80>;
			boot-battery-voltage = <0x33e140>;
		};
	};

	fragment@49 {
		target = <0xffffffff>;

		__overlay__ {
			compatible = "pd_cp_manager";
			fv = <0x118a>;
			fv_ffc = <0x11be>;
			max_fcc = <0x54c4>;
			max_vbus = <0x4e20>;
			max_ibus = <0x1770>;
			fcc_low_hyst = <0x96>;
			fcc_high_hyst = <0x0a>;
			low_tbat = <0x64>;
			high_tbat = <0x1e0>;
			high_vbat = <0x1130>;
			high_soc = <0x5f>;
			low_fcc = <0x7d0>;
			cv_vbat = <0x1180>;
			cv_vbat_ffc = <0x119e>;
			cv_ibat = <0x4b0>;
			min_pdo_vbus = <0x1f40>;
			max_pdo_vbus = <0x5208>;
			mt6375_control_gpio = <0xffffffff 0xd7 0x00>;
			support_4_1_mode;
			switch1_1_single_enter = <0x4b0>;
			switch1_1_single_exit = <0x5dc>;
			switch1_1_enter = <0x9c4>;
			switch1_1_exit = <0xdac>;
			switch2_1_enter = <0x1770>;
			switch2_1_exit = <0x1d4c>;
			pdm_ibus_gap = <0x258>;
		};
	};

	fragment@50 {
		target = <0xffffffff>;

		__overlay__ {
			compatible = "pd_cp_manager_gl";
			fv = <0x1176>;
			fv_ffc = <0x11aa>;
			max_fcc = <0x54c4>;
			max_vbus = <0x4e20>;
			max_ibus = <0x1770>;
			fcc_low_hyst = <0x96>;
			fcc_high_hyst = <0x0a>;
			low_tbat = <0x64>;
			high_tbat = <0x1e0>;
			high_vbat = <0x1130>;
			high_soc = <0x5f>;
			low_fcc = <0x7d0>;
			cv_vbat = <0x116c>;
			cv_vbat_ffc = <0x119e>;
			cv_ibat = <0x960>;
			min_pdo_vbus = <0x1f40>;
			max_pdo_vbus = <0x5208>;
			mt6375_control_gpio = <0xffffffff 0xd7 0x00>;
			support_4_1_mode;
			switch1_1_single_enter = <0x4b0>;
			switch1_1_single_exit = <0x5dc>;
			switch1_1_enter = <0x9c4>;
			switch1_1_exit = <0xdac>;
			switch2_1_enter = <0x1770>;
			switch2_1_exit = <0x1d4c>;
			pdm_ibus_gap = <0x258>;
		};
	};

	fragment@51 {
		target = <0xffffffff>;

		__overlay__ {
			mediatek,eye-vrt = <0x05>;
			mediatek,eye-term = <0x05>;
			mediatek,rev6 = <0x02>;
			mediatek,discth = <0x0b>;
			mediatek,discth-india = <0x0a>;
			mediatek,eye-term-host = <0x05>;
			mediatek,eye-vrt-host = <0x05>;
			mediatek,rev6-host = <0x02>;
		};
	};

	fragment@52 {
		target = <0xffffffff>;

		__overlay__ {
			pwm_ch = <0x00>;
			pinctrl-names = "irtx_gpio_led_default\0irtx_gpio_led_set";
			pinctrl-0 = <0x26>;
			pinctrl-1 = <0x27>;
			status = "okay";
		};
	};

	fragment@53 {
		target = <0xffffffff>;

		__overlay__ {

			irtx_gpio_led_def@gpio187 {
				phandle = <0x26>;

				pins_cmd_dat {
					pinmux = <0xbb00>;
					slew-rate = <0x01>;
					bias-disable;
					output-low;
					input-schmitt-enable = <0x00>;
				};
			};

			irtx_gpio_led_set@gpio187 {
				phandle = <0x27>;

				pins_cmd_dat {
					pinmux = <0xbb02>;
					slew-rate = <0x01>;
					output-high;
				};
			};
		};
	};

	fragment@54 {
		target = <0xffffffff>;

		__overlay__ {
			regulator-min-microvolt = <0x1b7740>;
			regulator-max-microvolt = <0x1b7740>;
			regulator-always-on;
		};
	};

	fragment@55 {
		target = <0xffffffff>;

		__overlay__ {
			regulator-min-microvolt = <0x325aa0>;
			regulator-max-microvolt = <0x325aa0>;
			regulator-always-on;
		};
	};

	fragment@56 {
		target = <0xffffffff>;

		__overlay__ {
			GPIO-FDD-BAND-SUPPORT-DETECT-3RD-PIN = <0xffffffff 0x17 0x00>;
			GPIO-FDD-BAND-SUPPORT-DETECT-2ND-PIN = <0xffffffff 0x18 0x00>;
			GPIO-FDD-BAND-SUPPORT-DETECT-1ST-PIN = <0xffffffff 0xbc 0x00>;
			GPIO-SIM1-HOT-PLUG = <0xffffffff 0xd4 0x00>;
			GPIO-SIM2-HOT-PLUG = <0xffffffff 0xd5 0x00>;
			GPIO-SIM1-SCLK = <0xffffffff 0xef 0x00>;
			GPIO-SIM1-SRST = <0xffffffff 0xf0 0x00>;
			GPIO-SIM1-SIO = <0xffffffff 0xf1 0x00>;
			GPIO-SIM2-SCLK = <0xffffffff 0xf2 0x00>;
			GPIO-SIM2-SRST = <0xffffffff 0xf3 0x00>;
			GPIO-SIM2-SIO = <0xffffffff 0xf4 0x00>;
		};
	};

	fragment@57 {
		target = <0xffffffff>;

		__overlay__ {
			gpio-init-default = <0x00 0x00 0x00 0x00 0x01 0x00 0x01 0x01 0x00 0x00 0x00 0x01 0x00 0x01 0x02 0x00 0x00 0x00 0x01 0x00 0x01 0x03 0x00 0x01 0x00 0x01 0x00 0x01 0x04 0x00 0x00 0x00 0x00 0x00 0x01 0x05 0x00 0x01 0x00 0x01 0x00 0x01 0x06 0x00 0x00 0x00 0x01 0x00 0x01 0x07 0x00 0x01 0x00 0x01 0x00 0x01 0x08 0x00 0x00 0x00 0x01 0x01 0x01 0x09 0x00 0x01 0x01 0x01 0x00 0x01 0x0a 0x01 0x00 0x00 0x01 0x00 0x01 0x0b 0x00 0x00 0x00 0x01 0x01 0x01 0x0c 0x00 0x00 0x00 0x01 0x01 0x01 0x0d 0x01 0x00 0x00 0x01 0x00 0x01 0x0e 0x00 0x00 0x00 0x01 0x00 0x01 0x0f 0x01 0x00 0x00 0x01 0x00 0x01 0x10 0x00 0x00 0x00 0x01 0x01 0x01 0x11 0x00 0x00 0x00 0x01 0x00 0x01 0x12 0x00 0x01 0x01 0x01 0x00 0x01 0x13 0x00 0x01 0x00 0x01 0x00 0x01 0x14 0x00 0x00 0x00 0x01 0x00 0x00 0x15 0x01 0x00 0x00 0x00 0x00 0x01 0x16 0x01 0x00 0x00 0x01 0x00 0x01 0x17 0x00 0x00 0x00 0x01 0x00 0x01 0x18 0x00 0x00 0x00 0x01 0x00 0x01 0x19 0x01 0x00 0x00 0x01 0x00 0x01 0x1a 0x01 0x00 0x00 0x01 0x00 0x01 0x1b 0x01 0x00 0x00 0x01 0x00 0x01 0x1c 0x01 0x00 0x00 0x01 0x00 0x01 0x1d 0x01 0x00 0x00 0x01 0x00 0x01 0x1e 0x01 0x00 0x00 0x00 0x00 0x00 0x1f 0x01 0x00 0x00 0x01 0x00 0x00 0x20 0x01 0x00 0x00 0x00 0x00 0x00 0x21 0x01 0x00 0x00 0x01 0x00 0x00 0x22 0x01 0x00 0x00 0x00 0x00 0x00 0x23 0x01 0x00 0x00 0x01 0x00 0x00 0x24 0x01 0x00 0x00 0x01 0x00 0x01 0x25 0x01 0x00 0x00 0x01 0x00 0x01 0x26 0x01 0x00 0x00 0x01 0x00 0x01 0x27 0x01 0x00 0x00 0x01 0x00 0x01 0x28 0x01 0x00 0x00 0x00 0x00 0x01 0x29 0x01 0x00 0x00 0x00 0x00 0x01 0x2a 0x01 0x00 0x00 0x00 0x00 0x01 0x2b 0x01 0x00 0x00 0x00 0x00 0x01 0x2c 0x01 0x00 0x00 0x00 0x00 0x01 0x2d 0x01 0x00 0x00 0x00 0x00 0x01 0x2e 0x01 0x00 0x00 0x00 0x00 0x01 0x2f 0x01 0x00 0x00 0x00 0x00 0x01 0x30 0x01 0x00 0x00 0x00 0x00 0x01 0x31 0x01 0x00 0x00 0x00 0x00 0x01 0x32 0x01 0x00 0x00 0x00 0x00 0x01 0x33 0x01 0x00 0x00 0x00 0x00 0x01 0x34 0x01 0x00 0x00 0x00 0x00 0x01 0x35 0x01 0x00 0x00 0x00 0x00 0x01 0x36 0x01 0x00 0x00 0x00 0x00 0x01 0x37 0x02 0x00 0x00 0x00 0x00 0x00 0x38 0x02 0x00 0x00 0x01 0x00 0x00 0x39 0x01 0x00 0x00 0x00 0x00 0x01 0x3a 0x00 0x01 0x00 0x01 0x00 0x01 0x3b 0x01 0x00 0x00 0x00 0x00 0x01 0x3c 0x01 0x00 0x00 0x00 0x00 0x01 0x3d 0x01 0x00 0x00 0x00 0x00 0x01 0x3e 0x01 0x00 0x00 0x01 0x01 0x01 0x3f 0x01 0x00 0x00 0x01 0x01 0x01 0x40 0x02 0x00 0x00 0x01 0x01 0x01 0x41 0x02 0x00 0x00 0x01 0x01 0x01 0x42 0x01 0x00 0x00 0x01 0x00 0x01 0x43 0x01 0x00 0x00 0x01 0x01 0x01 0x44 0x01 0x00 0x00 0x01 0x00 0x01 0x45 0x01 0x00 0x00 0x01 0x00 0x01 0x46 0x00 0x00 0x00 0x01 0x01 0x01 0x47 0x00 0x00 0x00 0x01 0x00 0x01 0x48 0x01 0x00 0x00 0x00 0x00 0x01 0x49 0x01 0x00 0x00 0x00 0x00 0x01 0x4a 0x01 0x00 0x00 0x01 0x00 0x01 0x4b 0x01 0x00 0x00 0x01 0x01 0x01 0x4c 0x01 0x00 0x00 0x01 0x00 0x01 0x4d 0x01 0x00 0x00 0x01 0x01 0x01 0x4e 0x01 0x00 0x00 0x01 0x01 0x01 0x4f 0x01 0x00 0x00 0x01 0x01 0x01 0x51 0x07 0x00 0x00 0x01 0x00 0x01 0x52 0x07 0x00 0x00 0x01 0x00 0x01 0x53 0x07 0x00 0x00 0x01 0x00 0x01 0x54 0x07 0x00 0x00 0x00 0x00 0x01 0x55 0x07 0x00 0x00 0x01 0x00 0x01 0x56 0x00 0x01 0x00 0x01 0x00 0x01 0x57 0x06 0x00 0x00 0x01 0x00 0x01 0x58 0x06 0x00 0x00 0x01 0x00 0x01 0x59 0x00 0x01 0x01 0x01 0x00 0x01 0x5a 0x00 0x01 0x00 0x01 0x00 0x01 0x5b 0x00 0x01 0x00 0x01 0x00 0x00 0x5c 0x01 0x00 0x00 0x01 0x01 0x01 0x5d 0x01 0x00 0x00 0x01 0x01 0x01 0x5e 0x00 0x01 0x00 0x01 0x00 0x01 0x5f 0x00 0x00 0x00 0x01 0x00 0x01 0x60 0x00 0x01 0x00 0x01 0x00 0x01 0x61 0x00 0x01 0x00 0x01 0x00 0x01 0x62 0x01 0x00 0x00 0x01 0x01 0x01 0x63 0x01 0x00 0x00 0x01 0x01 0x01 0x64 0x01 0x00 0x00 0x01 0x01 0x01 0x65 0x01 0x00 0x00 0x01 0x01 0x01 0x66 0x01 0x00 0x00 0x01 0x01 0x01 0x67 0x01 0x00 0x00 0x01 0x01 0x01 0x68 0x01 0x00 0x00 0x00 0x00 0x01 0x69 0x01 0x00 0x00 0x00 0x00 0x01 0x6a 0x01 0x00 0x00 0x01 0x00 0x01 0x6b 0x01 0x00 0x00 0x01 0x00 0x01 0x6c 0x00 0x01 0x00 0x01 0x00 0x01 0x6d 0x00 0x00 0x00 0x00 0x00 0x01 0x6e 0x00 0x01 0x00 0x01 0x00 0x01 0x6f 0x00 0x01 0x00 0x01 0x00 0x01 0x70 0x00 0x01 0x01 0x01 0x00 0x01 0x71 0x00 0x00 0x00 0x01 0x00 0x01 0x72 0x00 0x01 0x00 0x01 0x00 0x01 0x73 0x00 0x01 0x01 0x01 0x00 0x01 0x74 0x01 0x00 0x00 0x01 0x00 0x01 0x75 0x01 0x00 0x00 0x01 0x00 0x01 0x76 0x00 0x01 0x00 0x01 0x00 0x01 0x77 0x00 0x01 0x00 0x01 0x00 0x01 0x78 0x01 0x00 0x00 0x01 0x01 0x01 0x79 0x01 0x00 0x00 0x01 0x01 0x01 0x7a 0x01 0x00 0x00 0x01 0x01 0x01 0x7b 0x01 0x00 0x00 0x01 0x01 0x01 0x7c 0x00 0x00 0x00 0x01 0x00 0x01 0x7d 0x01 0x00 0x00 0x01 0x00 0x01 0x7e 0x00 0x01 0x00 0x01 0x00 0x00 0x7f 0x00 0x01 0x00 0x01 0x00 0x01 0x80 0x01 0x00 0x00 0x01 0x01 0x01 0x81 0x01 0x00 0x00 0x01 0x01 0x01 0x82 0x01 0x00 0x00 0x01 0x01 0x01 0x83 0x01 0x00 0x00 0x01 0x01 0x01 0x84 0x01 0x00 0x00 0x01 0x00 0x01 0x85 0x01 0x00 0x00 0x01 0x00 0x01 0x86 0x01 0x00 0x00 0x01 0x00 0x01 0x87 0x00 0x00 0x00 0x01 0x00 0x01 0x88 0x00 0x00 0x00 0x01 0x00 0x01 0x89 0x00 0x00 0x00 0x01 0x00 0x01 0x8a 0x00 0x00 0x00 0x01 0x00 0x01 0x8b 0x00 0x00 0x00 0x00 0x00 0x01 0x8c 0x00 0x00 0x00 0x00 0x00 0x01 0x8d 0x00 0x00 0x00 0x00 0x00 0x01 0x8e 0x00 0x00 0x00 0x00 0x00 0x01 0x8f 0x01 0x00 0x00 0x01 0x00 0x01 0x90 0x00 0x00 0x00 0x01 0x00 0x01 0x91 0x01 0x00 0x00 0x01 0x00 0x01 0x92 0x00 0x00 0x00 0x00 0x00 0x01 0x93 0x00 0x00 0x00 0x00 0x00 0x01 0x94 0x00 0x00 0x00 0x00 0x00 0x01 0x95 0x00 0x00 0x00 0x00 0x00 0x01 0x96 0x00 0x01 0x00 0x01 0x00 0x01 0x97 0x00 0x01 0x00 0x01 0x00 0x01 0x98 0x00 0x01 0x00 0x01 0x00 0x01 0x99 0x00 0x01 0x00 0x01 0x00 0x00 0x9a 0x00 0x00 0x00 0x01 0x00 0x01 0x9b 0x00 0x00 0x00 0x01 0x00 0x01 0x9c 0x00 0x01 0x00 0x01 0x00 0x01 0x9d 0x00 0x00 0x00 0x01 0x00 0x01 0x9e 0x00 0x01 0x00 0x01 0x00 0x01 0x9f 0x01 0x00 0x00 0x01 0x01 0x01 0xa0 0x01 0x00 0x00 0x01 0x01 0x01 0xa1 0x01 0x00 0x00 0x01 0x01 0x01 0xa2 0x01 0x00 0x00 0x01 0x01 0x01 0xa3 0x01 0x00 0x00 0x01 0x01 0x01 0xa4 0x01 0x00 0x00 0x01 0x01 0x01 0xa5 0x01 0x00 0x00 0x00 0x00 0x01 0xa6 0x01 0x00 0x00 0x00 0x00 0x01 0xa7 0x01 0x00 0x00 0x00 0x00 0x01 0xa8 0x01 0x00 0x00 0x00 0x00 0x01 0xa9 0x01 0x00 0x00 0x01 0x00 0x01 0xaa 0x01 0x00 0x00 0x00 0x00 0x01 0xab 0x01 0x00 0x00 0x00 0x00 0x01 0xac 0x01 0x00 0x00 0x00 0x00 0x01 0xad 0x01 0x00 0x00 0x00 0x00 0x01 0xae 0x00 0x01 0x00 0x01 0x00 0x01 0xaf 0x00 0x00 0x00 0x01 0x01 0x01 0xb0 0x01 0x00 0x00 0x01 0x01 0x01 0xb1 0x01 0x00 0x00 0x01 0x01 0x01 0xb2 0x01 0x00 0x00 0x00 0x00 0x01 0xb3 0x01 0x00 0x00 0x00 0x00 0x01 0xb4 0x01 0x00 0x00 0x00 0x00 0x01 0xb5 0x01 0x00 0x00 0x01 0x00 0x01 0xb6 0x01 0x00 0x00 0x01 0x00 0x01 0xb7 0x00 0x00 0x00 0x00 0x00 0x01 0xb8 0x00 0x01 0x00 0x01 0x00 0x01 0xb9 0x00 0x00 0x00 0x00 0x00 0x01 0xba 0x00 0x00 0x00 0x00 0x00 0x01 0xbb 0x02 0x00 0x00 0x01 0x00 0x01 0xbc 0x00 0x00 0x00 0x01 0x00 0x01 0xbd 0x00 0x00 0x00 0x01 0x01 0x01 0xbe 0x00 0x00 0x00 0x01 0x00 0x00 0xbf 0x01 0x00 0x00 0x01 0x00 0x01 0xc0 0x01 0x00 0x00 0x01 0x01 0x01 0xc1 0x01 0x00 0x00 0x01 0x00 0x01 0xc2 0x01 0x00 0x00 0x01 0x00 0x00 0xc3 0x01 0x00 0x00 0x01 0x00 0x01 0xc4 0x01 0x00 0x00 0x01 0x01 0x01 0xc5 0x00 0x01 0x00 0x01 0x00 0x01 0xc6 0x07 0x00 0x00 0x01 0x00 0x01 0xc7 0x07 0x00 0x00 0x01 0x00 0x01 0xc8 0x07 0x00 0x00 0x01 0x00 0x01 0xc9 0x07 0x00 0x00 0x00 0x00 0x01 0xca 0x07 0x00 0x00 0x01 0x00 0x01 0xcb 0x01 0x00 0x00 0x00 0x00 0x01 0xcc 0x01 0x00 0x00 0x01 0x01 0x01 0xcd 0x01 0x00 0x00 0x00 0x00 0x01 0xce 0x01 0x00 0x00 0x01 0x01 0x01 0xcf 0x00 0x00 0x00 0x01 0x00 0x01 0xd0 0x00 0x01 0x00 0x01 0x00 0x01 0xd1 0x00 0x00 0x00 0x01 0x00 0x01 0xd2 0x00 0x00 0x00 0x01 0x00 0x01 0xd3 0x00 0x01 0x00 0x01 0x00 0x01 0xd4 0x01 0x00 0x00 0x01 0x01 0x01 0xd5 0x01 0x00 0x00 0x01 0x01 0x01 0xd6 0x02 0x00 0x00 0x01 0x00 0x01 0xd7 0x00 0x01 0x00 0x01 0x00 0x01 0xd8 0x00 0x00 0x00 0x00 0x00 0x01 0xd9 0x00 0x00 0x00 0x01 0x01 0x01 0xda 0x01 0x00 0x00 0x00 0x00 0x01 0xdb 0x01 0x00 0x00 0x00 0x00 0x01 0xdc 0x01 0x00 0x00 0x01 0x00 0x01 0xdd 0x01 0x00 0x00 0x00 0x00 0x01 0xde 0x01 0x00 0x00 0x01 0x00 0x01 0xdf 0x01 0x00 0x00 0x01 0x01 0x01 0xe0 0x01 0x00 0x00 0x01 0x01 0x01 0xe1 0x01 0x00 0x00 0x01 0x01 0x01 0xe2 0x01 0x00 0x00 0x01 0x01 0x01 0xe3 0x01 0x00 0x00 0x01 0x01 0x01 0xe4 0x01 0x00 0x00 0x01 0x01 0x01 0xe5 0x01 0x00 0x00 0x01 0x00 0x01 0xe6 0x00 0x01 0x00 0x01 0x00 0x01 0xe7 0x02 0x00 0x00 0x01 0x00 0x01 0xe8 0x00 0x00 0x00 0x00 0x00 0x01 0xe9 0x02 0x00 0x00 0x01 0x00 0x01 0xea 0x02 0x00 0x00 0x01 0x00 0x01 0xeb 0x01 0x00 0x00 0x01 0x00 0x01 0xec 0x01 0x00 0x00 0x01 0x01 0x01 0xed 0x01 0x00 0x00 0x01 0x00 0x01 0xee 0x01 0x00 0x00 0x01 0x00 0x01 0xef 0x01 0x00 0x00 0x00 0x00 0x01 0xf0 0x01 0x00 0x00 0x00 0x00 0x01 0xf1 0x01 0x00 0x00 0x01 0x01 0x01 0xf2 0x01 0x00 0x00 0x00 0x00 0x01 0xf3 0x01 0x00 0x00 0x00 0x00 0x01 0xf4 0x01 0x00 0x00 0x01 0x01 0x01 0xf5 0x01 0x00 0x00 0x00 0x00 0x01 0xf6 0x01 0x00 0x00 0x01 0x01 0x01 0xf7 0x01 0x00 0x00 0x01 0x01 0x01 0xf8 0x01 0x00 0x00 0x01 0x01 0x01 0xf9 0x01 0x00 0x00 0x01 0x01 0x01 0xfa 0x01 0x00 0x00 0x01 0x01 0x01>;
		};
	};

	fragment@58 {
		target = <0xffffffff>;

		__overlay__ {
			interrupt-parent = <0xffffffff>;
			interrupts = <0x08 0x08>;
			deb-gpios = <0xffffffff 0x08 0x00>;
			debounce = <0x7d000>;
			status = "okay";
		};
	};

	fragment@59 {
		target = <0xffffffff>;

		__overlay__ {
			interrupt-parent = <0xffffffff>;
			interrupts = <0x5b 0x08>;
			status = "okay";
		};
	};

	fragment@60 {
		target = <0xffffffff>;

		__overlay__ {
			interrupt-parent = <0xffffffff>;
			interrupts = <0x9a 0x04>;
			status = "okay";
		};
	};

	fragment@61 {
		target = <0xffffffff>;

		__overlay__ {
			interrupt-parent = <0xffffffff>;
			interrupts = <0xaf 0x08>;
			status = "okay";
		};
	};

	fragment@62 {
		target = <0xffffffff>;

		__overlay__ {
			interrupt-parent = <0xffffffff>;
			interrupts = <0xd9 0x08>;
			status = "okay";
		};
	};

	fragment@63 {
		target = <0xffffffff>;

		__overlay__ {
			interrupt-parent = <0xffffffff>;
			interrupts = <0xe5 0x01>;
			status = "okay";
		};
	};

	fragment@64 {
		target = <0xffffffff>;

		__overlay__ {
			compatible = "mediatek,md1_sim1_hot_plug_eint-eint";
			interrupt-parent = <0xffffffff>;
			interrupts = <0x00 0x08>;
			debounce = <0x00 0x2710>;
			dedicated = <0x00 0x00>;
			src-pin = <0x00 0x01>;
			sockettype = <0x00 0x00>;
			status = "okay";
		};
	};

	fragment@65 {
		target = <0xffffffff>;

		__overlay__ {
			mediatek,key-debounce = <0x400>;
			mediatek,sw-pwrkey = <0x74>;
			mediatek,hw-pwrkey = <0x08>;
			mediatek,sw-rstkey = <0x72>;
			mediatek,hw-rstkey = <0x11>;
			mediatek,use-extend-type = <0x00>;
			mediatek,hw-map-num = <0x48>;
			mediatek,hw-init-map = <0x73 0x00 0x00 0x00 0x00 0x00 0x00 0x00 0x00 0x00 0x00 0x00 0x00 0x00 0x00 0x00 0x00 0x00 0x00 0x00 0x00 0x00 0x00 0x00 0x00 0x00 0x00 0x00 0x00 0x00 0x00 0x00 0x00 0x00 0x00 0x00 0x00 0x00 0x00 0x00 0x00 0x00 0x00 0x00 0x00 0x00 0x00 0x00 0x00 0x00 0x00 0x00 0x00 0x00 0x00 0x00 0x00 0x00 0x00 0x00 0x00 0x00 0x00 0x00 0x00 0x00 0x00 0x00 0x00 0x00 0x00 0x00>;
			mediatek,pwrkey-eint-gpio = <0x00>;
			mediatek,pwkey-gpio-din = <0x00>;
			mediatek,hw-dl-key0 = <0x11>;
			mediatek,hw-dl-key1 = <0x00>;
			mediatek,hw-dl-key2 = <0x08>;
			mediatek,hw-recovery-key = <0x11>;
			mediatek,hw-factory-key = <0x00>;
			status = "okay";
		};
	};

	fragment@66 {
		target = <0xffffffff>;

		__overlay__ {

			sih_reset_reset {
				phandle = <0x2b>;

				pins_cmd_dat {
					pinmux = <0xd200>;
					drive-strength = <0x02>;
					bias-disable;
					output-low;
				};
			};

			sih_reset_active {
				phandle = <0x2c>;

				pins_cmd_dat {
					pinmux = <0xd200>;
					drive-strength = <0x02>;
					bias-disable;
					output-high;
				};
			};

			sih_interrupt_active {
				phandle = <0x2d>;

				pins_cmd_dat {
					pinmux = <0x600>;
					drive-strength = <0x02>;
					bias-pull-up;
					input-enable;
				};
			};
		};
	};

	fragment@67 {
		target = <0xffffffff>;

		__overlay__ {

			awinic_reset_reset {
				phandle = <0x28>;

				pins_cmd_dat {
					pinmux = <0xd200>;
					drive-strength = <0x02>;
					bias-disable;
					output-low;
				};
			};

			awinic_reset_active {
				phandle = <0x29>;

				pins_cmd_dat {
					pinmux = <0xd200>;
					drive-strength = <0x02>;
					bias-disable;
					output-high;
				};
			};

			awinic_interrupt_active {
				phandle = <0x2a>;

				pins_cmd_dat {
					pinmux = <0x600>;
					drive-strength = <0x02>;
					bias-pull-up;
					input-enable;
				};
			};
		};
	};

	fragment@68 {
		target = <0xffffffff>;

		__overlay__ {
			clock-frequency = <0x61a80>;
			status = "ok";

			aw8697_haptic@5a {
				compatible = "awinic,awinic_haptic";
				reg = <0x5a>;
				reset-gpio = <0xffffffff 0xd2 0x00>;
				irq-gpio = <0xffffffff 0x06 0x00>;
				pinctrl-names = "awinic_reset_reset\0awinic_reset_active\0awinic_interrupt_active";
				pinctrl-0 = <0x28>;
				pinctrl-1 = <0x29>;
				pinctrl-2 = <0x2a>;
				aw86927_vib_mode = <0x00>;
				aw86927_vib_f0_pre = <0x6a4>;
				aw86927_comp_gain_temp = <0xb6>;
				aw86927_vib_f0_cali_percen = <0x07>;
				aw86927_vib_cont_drv1_lvl = <0x7f>;
				aw86927_vib_cont_drv2_lvl = <0x36>;
				aw86927_vib_cont_drv1_time = <0x04>;
				aw86927_vib_cont_drv2_time = <0x06>;
				aw86927_vib_cont_drv_width = <0x6a>;
				aw86927_vib_cont_wait_num = <0x06>;
				aw86927_vib_cont_brk_time = <0x08>;
				aw86927_vib_cont_track_margin = <0x0c>;
				aw86927_vib_brk_bst_md = <0x00>;
				aw86927_vib_cont_tset = <0x06>;
				aw86927_vib_cont_bemf_set = <0x02>;
				aw86927_vib_cont_bst_brk_gain = <0x05>;
				aw86927_vib_cont_brk_gain = <0x08>;
				aw86927_vib_d2s_gain = <0x04>;
				aw86927_vib_trig_config = <0x01 0x00 0x01 0x01 0x01 0x02 0x00 0x00 0x01 0x00 0x00 0x01 0x00 0x02 0x00 0x00 0x01 0x00 0x00 0x01 0x00 0x02 0x00 0x00>;
				aw86927_vib_bst_vol_default = <0x64>;
				aw86927_vib_bst_vol_ram = <0x64>;
				aw86927_vib_bst_vol_rtp = <0x64>;
				vib_effect_id_boundary = <0x0a>;
				vib_effect_max = <0xc5>;
				vib_rtp_time = <0x14 0x14 0x14 0x14 0x14 0x14 0x14 0x14 0x4e20 0x3a98 0x3a98 0x4e20 0x61a8 0x3a98 0x7530 0x61a8 0x4e20 0x4e20 0x4e20 0x4e20 0x4e20 0x4e20 0x4e20 0x4e20 0x4e20 0x4e20 0x4e20 0x4e20 0x4e20 0x4e20 0x4e20 0x4e20 0x4e20 0x4e20 0x4e20 0x4e20 0x4e20 0x4e20 0x4e20 0x4e20 0x4e20 0x4e20 0x4e20 0x4e20 0x4e20 0x4e20 0x4e20 0x4e20 0x4e20 0x4e20 0x4e20 0x4e20 0x4e20 0x4e20 0x4e20 0x4e20 0x4e20 0x4e20 0x4e20 0x4e20 0x4e20 0x4e20 0x4e20 0x4e20 0x4e20 0x4e20 0x4e20 0x4e20 0x4e20 0x4e20 0x4e20 0x4e20 0x4e20 0x4e20 0x4e20 0x4e20 0x4e20 0x4e20 0x4e20 0x4e20 0x4e20 0x4e20 0x4e20 0x4e20 0x4e20 0x4e20 0x4e20 0x4e20 0x4e20 0x4e20 0x4e20 0x4e20 0x4e20 0x4e20 0x4e20 0x4e20 0x4e20 0x4e20 0x4e20 0x4e20 0x4e20 0x4e20 0x4e20 0x4e20 0x4e20 0x4e20 0x4e20 0x4e20 0x4e20 0x4e20 0x4e20 0x4e20 0x4e20 0x4e20 0x4e20 0x4e20 0x4e20 0x4e20 0x4e20 0x4e20 0x4e20 0x4e20 0x4e20 0x4e20 0x4e20 0x4e20 0x4e20 0x4e20 0x4e20 0x4e20 0x4e20 0x4e20 0x4e20 0x4e20 0x4e20 0x4e20 0x4e20 0x4e20 0x4e20 0x4e20 0x4e20 0x4e20 0x4e20 0x4e20 0x4e20 0x4e20 0x4e20 0x4e20 0x4e20 0x4e20 0x4e20 0x4e20 0x4e20 0x4e20 0x4e20 0x4e20 0x4e20 0x4e20 0x4e20 0x4e20 0x4e20 0x4e20 0x4e20 0x4e20 0x4e20 0x4e20 0x4e20 0x4e20 0x4e20 0x4e20 0x4e20 0x4e20 0x4e20 0x4e20 0x4e20>;
				status = "ok";

				wf_0 {
					mtk,effect-id = <0x00>;
					mtk,wf-vmax-mv = <0xe10>;
					mtk,wf-pattern = [3e 3e];
					mtk,wf-brake-pattern = <0x2010000>;
					mtk,wf-play-rate-us = <0x4e20>;
				};

				wf_1 {
					mtk,effect-id = <0x01>;
					mtk,wf-vmax-mv = <0xe10>;
					mtk,wf-pattern = [7e 3e];
					mtk,wf-brake-pattern = <0x3010000>;
					mtk,wf-play-rate-us = <0x4e20>;
				};

				wf_2 {
					mtk,effect-id = <0x02>;
					mtk,wf-vmax-mv = <0xe10>;
					mtk,wf-pattern = [7e 3e];
					mtk,wf-brake-pattern = <0x2010000>;
					mtk,wf-play-rate-us = <0x4e20>;
				};

				wf_3 {
					mtk,effect-id = <0x03>;
					mtk,wf-vmax-mv = <0xe10>;
					mtk,wf-pattern = [3e 3e];
					mtk,wf-brake-pattern = <0x2010000>;
					mtk,wf-play-rate-us = <0x4e20>;
				};

				wf_4 {
					mtk,effect-id = <0x04>;
					mtk,wf-vmax-mv = <0xe10>;
					mtk,wf-pattern = [3e 3e];
					mtk,wf-brake-pattern = <0x2010000>;
					mtk,wf-play-rate-us = <0x6d60>;
				};

				wf_5 {
					mtk,effect-id = <0x05>;
					mtk,wf-vmax-mv = <0xe10>;
					mtk,wf-pattern = [7e 7e 7e];
					mtk,wf-brake-pattern = <0x3030100>;
					mtk,wf-play-rate-us = <0x4e20>;
				};

				wf_6 {
					mtk,effect-id = <0x06>;
					mtk,wf-vmax-mv = <0xe10>;
					mtk,wf-pattern = [3e 3e];
					mtk,wf-brake-pattern = <0x2010000>;
					mtk,wf-play-rate-us = <0x4e20>;
				};

				wf_7 {
					mtk,effect-id = <0x07>;
					mtk,wf-vmax-mv = <0xe10>;
					mtk,wf-pattern = [3e 3e];
					mtk,wf-brake-pattern = <0x2010000>;
					mtk,wf-play-rate-us = <0x4e20>;
				};

				wf_8 {
					mtk,effect-id = <0x08>;
					mtk,wf-vmax-mv = <0xe10>;
					mtk,wf-pattern = [3e 3e];
					mtk,wf-brake-pattern = <0x2010000>;
					mtk,wf-play-rate-us = <0x4e20>;
				};

				wf_9 {
					mtk,effect-id = <0x09>;
					mtk,wf-vmax-mv = <0xe10>;
					mtk,wf-pattern = [3e 3e];
					mtk,wf-brake-pattern = <0x2010000>;
					mtk,wf-play-rate-us = <0x4e20>;
				};
			};

			sih6887_haptic@6B {
				compatible = "silicon,sih_haptic_688X";
				reg = <0x6b>;
				reset-gpio = <0xffffffff 0xd2 0x00>;
				irq-gpio = <0xffffffff 0x06 0x00>;
				interrupt = <0x1a 0x01>;
				pinctrl-names = "sih_reset_reset\0sih_reset_active\0sih_interrupt_active";
				pinctrl-0 = <0x2b>;
				pinctrl-1 = <0x2c>;
				pinctrl-2 = <0x2d>;
				lra_name = "0809";
				vib_effect_id_boundary = <0x0a>;
				vib_effect_max = <0xc5>;
				vib_f0_pre = <0x6a4>;
				vib_bst_vol_default = <0x5f>;
				phandle = <0x92>;
			};
		};
	};

	fragment@69 {
		target = <0xffffffff>;

		__overlay__ {
			compatible = "mediatek,mt6685-tia-ntc";
			#thermal-sensor-cells = <0x00>;
			reg = <0x00 0x1cc00554 0x00 0x04>;
			temperature-lookup-table = <0xffff63c0 0x4394c8 0xffff67a8 0x3f1088 0xffff6b90 0x3ada68 0xffff6f78 0x36daf8 0xffff7360 0x3325c0 0xffff7748 0x2fca60 0xffff7b30 0x2c9de0 0xffff7f18 0x29b3c8 0xffff8300 0x270060 0xffff86e8 0x247408 0xffff8ad0 0x221e60 0xffff8eb8 0x200b20 0xffff92a0 0x1de840 0xffff9688 0x1c07c8 0xffff9a70 0x1a4690 0xffff9e58 0x18a0b0 0xffffa240 0x171a10 0xffffa628 0x15aec8 0xffffaa10 0x145af0 0xffffadf8 0x1335f8 0xffffb1e0 0x11f5a8 0xffffb5c8 0x10ff90 0xffffb9b0 0xfd6b0 0xffffbd98 0xee4e4 0xffffc180 0xe06a0 0xffffc568 0xd3478 0xffffc950 0xc80c8 0xffffcd38 0xbb4e0 0xffffd120 0xb0a2c 0xffffd508 0xa6748 0xffffd8f0 0x9cf54 0xffffdcd8 0x94250 0xffffe0c0 0x8c488 0xffffe4a8 0x8497c 0xffffe890 0x7d0c8 0xffffec78 0x76750 0xfffff060 0x6f2e8 0xfffff448 0x69140 0xfffff830 0x634ac 0xfffffc18 0x5dd2c 0x00 0x59420 0x3e8 0x5459c 0x7d0 0x4fcf4 0xbb8 0x4b9c4 0xfa0 0x47ba8 0x1388 0x43fe4 0x1770 0x408d0 0x1b58 0x3d0f4 0x1f40 0x39f58 0x2328 0x37460 0x2710 0x345e4 0x2af8 0x318f8 0x2ee0 0x2f120 0x32c8 0x2cb3c 0x36b0 0x2a814 0x3a98 0x28618 0x3e80 0x266d8 0x4268 0x249f0 0x4650 0x22d08 0x4a38 0x21214 0x4e20 0x1fb08 0x5208 0x1e140 0x55f0 0x1c9d0 0x59d8 0x1b4b8 0x5dc0 0x19960 0x61a8 0x186a0 0x6590 0x174ee 0x6978 0x1647c 0x6d60 0x153c4 0x7148 0x14488 0x7530 0x13628 0x7918 0x128a4 0x7d00 0x11aee 0x80e8 0x10e5a 0x84d0 0x10298 0x88b8 0xf7a8 0x8ca0 0xec90 0x9088 0xe2b8 0x9470 0xd87c 0x9858 0xcf26 0x9c40 0xc652 0xa028 0xbe28 0xa410 0xb6c6 0xa7f8 0xaf1e 0xabe0 0xa6e0 0xafc8 0x9fe2 0xb3b0 0x9934 0xb798 0x92f4 0xbb80 0x8cdc 0xbf68 0x871e 0xc350 0x81a6 0xc738 0x7c6a 0xcb20 0x7760 0xcf08 0x729c 0xd2f0 0x6e0a 0xd6d8 0x69aa 0xdac0 0x657c 0xdea8 0x618a 0xe290 0x5dc0 0xe678 0x5a14 0xea60 0x5690 0xee48 0x533e 0xf230 0x500a 0xf618 0x4d12 0xfa00 0x4a1a 0xfde8 0x474a 0x101d0 0x44a2 0x105b8 0x4218 0x109a0 0x3fa2 0x10d88 0x3d54 0x11170 0x3b06 0x11558 0x38e0 0x11940 0x36ce 0x11d28 0x34d0 0x12110 0x32f0 0x124f8 0x312e 0x128e0 0x2f62 0x12cc8 0x2dc8 0x130b0 0x2c1a 0x13498 0x2a94 0x13880 0x290e 0x13c68 0x279c 0x14050 0x2633 0x14438 0x24ee 0x14820 0x23ae 0x14c08 0x226e 0x14ff0 0x2149 0x153d8 0x2020 0x157c0 0x1f10 0x15ba8 0x1e09 0x15f90 0x1cfd 0x16378 0x1c0b 0x16760 0x1b22 0x16b48 0x1a35 0x16f30 0x195c 0x17318 0x188b 0x17700 0x17c1 0x17ae8 0x16f5 0x17ed0 0x1639 0x182b8 0x1584 0x186a0 0x14d7 0x18a88 0x142f 0x18e70 0x138c 0x19258 0x12e7 0x19640 0x1252 0x19a28 0x11c2 0x19e10 0x1131 0x1a1f8 0x10ab 0x1a5e0 0x1027 0x1a9c8 0xfaa 0x1adb0 0xf2f 0x1b198 0xebb 0x1b580 0xe48 0x1b968 0xdda 0x1bd50 0xd71 0x1c138 0xd0b 0x1c520 0xca8 0x1c908 0xc48 0x1ccf0 0xbed 0x1d0d8 0xb94 0x1d4c0 0xb3e 0x1d8a8 0xaec 0x1dc90 0xa9b 0x1e078 0xa50 0x1e460 0xa02 0x1e848 0x9bd>;
		};
	};

	fragment@70 {
		target = <0xffffffff>;

		__overlay__ {
			compatible = "mediatek,mt6685-tia-ntc";
			#thermal-sensor-cells = <0x00>;
			reg = <0x00 0x1cc00558 0x00 0x04>;
			temperature-lookup-table = <0xffff63c0 0x4394c8 0xffff67a8 0x3f1088 0xffff6b90 0x3ada68 0xffff6f78 0x36daf8 0xffff7360 0x3325c0 0xffff7748 0x2fca60 0xffff7b30 0x2c9de0 0xffff7f18 0x29b3c8 0xffff8300 0x270060 0xffff86e8 0x247408 0xffff8ad0 0x221e60 0xffff8eb8 0x200b20 0xffff92a0 0x1de840 0xffff9688 0x1c07c8 0xffff9a70 0x1a4690 0xffff9e58 0x18a0b0 0xffffa240 0x171a10 0xffffa628 0x15aec8 0xffffaa10 0x145af0 0xffffadf8 0x1335f8 0xffffb1e0 0x11f5a8 0xffffb5c8 0x10ff90 0xffffb9b0 0xfd6b0 0xffffbd98 0xee4e4 0xffffc180 0xe06a0 0xffffc568 0xd3478 0xffffc950 0xc80c8 0xffffcd38 0xbb4e0 0xffffd120 0xb0a2c 0xffffd508 0xa6748 0xffffd8f0 0x9cf54 0xffffdcd8 0x94250 0xffffe0c0 0x8c488 0xffffe4a8 0x8497c 0xffffe890 0x7d0c8 0xffffec78 0x76750 0xfffff060 0x6f2e8 0xfffff448 0x69140 0xfffff830 0x634ac 0xfffffc18 0x5dd2c 0x00 0x59420 0x3e8 0x5459c 0x7d0 0x4fcf4 0xbb8 0x4b9c4 0xfa0 0x47ba8 0x1388 0x43fe4 0x1770 0x408d0 0x1b58 0x3d0f4 0x1f40 0x39f58 0x2328 0x37460 0x2710 0x345e4 0x2af8 0x318f8 0x2ee0 0x2f120 0x32c8 0x2cb3c 0x36b0 0x2a814 0x3a98 0x28618 0x3e80 0x266d8 0x4268 0x249f0 0x4650 0x22d08 0x4a38 0x21214 0x4e20 0x1fb08 0x5208 0x1e140 0x55f0 0x1c9d0 0x59d8 0x1b4b8 0x5dc0 0x19960 0x61a8 0x186a0 0x6590 0x174ee 0x6978 0x1647c 0x6d60 0x153c4 0x7148 0x14488 0x7530 0x13628 0x7918 0x128a4 0x7d00 0x11aee 0x80e8 0x10e5a 0x84d0 0x10298 0x88b8 0xf7a8 0x8ca0 0xec90 0x9088 0xe2b8 0x9470 0xd87c 0x9858 0xcf26 0x9c40 0xc652 0xa028 0xbe28 0xa410 0xb6c6 0xa7f8 0xaf1e 0xabe0 0xa6e0 0xafc8 0x9fe2 0xb3b0 0x9934 0xb798 0x92f4 0xbb80 0x8cdc 0xbf68 0x871e 0xc350 0x81a6 0xc738 0x7c6a 0xcb20 0x7760 0xcf08 0x729c 0xd2f0 0x6e0a 0xd6d8 0x69aa 0xdac0 0x657c 0xdea8 0x618a 0xe290 0x5dc0 0xe678 0x5a14 0xea60 0x5690 0xee48 0x533e 0xf230 0x500a 0xf618 0x4d12 0xfa00 0x4a1a 0xfde8 0x474a 0x101d0 0x44a2 0x105b8 0x4218 0x109a0 0x3fa2 0x10d88 0x3d54 0x11170 0x3b06 0x11558 0x38e0 0x11940 0x36ce 0x11d28 0x34d0 0x12110 0x32f0 0x124f8 0x312e 0x128e0 0x2f62 0x12cc8 0x2dc8 0x130b0 0x2c1a 0x13498 0x2a94 0x13880 0x290e 0x13c68 0x279c 0x14050 0x2633 0x14438 0x24ee 0x14820 0x23ae 0x14c08 0x226e 0x14ff0 0x2149 0x153d8 0x2020 0x157c0 0x1f10 0x15ba8 0x1e09 0x15f90 0x1cfd 0x16378 0x1c0b 0x16760 0x1b22 0x16b48 0x1a35 0x16f30 0x195c 0x17318 0x188b 0x17700 0x17c1 0x17ae8 0x16f5 0x17ed0 0x1639 0x182b8 0x1584 0x186a0 0x14d7 0x18a88 0x142f 0x18e70 0x138c 0x19258 0x12e7 0x19640 0x1252 0x19a28 0x11c2 0x19e10 0x1131 0x1a1f8 0x10ab 0x1a5e0 0x1027 0x1a9c8 0xfaa 0x1adb0 0xf2f 0x1b198 0xebb 0x1b580 0xe48 0x1b968 0xdda 0x1bd50 0xd71 0x1c138 0xd0b 0x1c520 0xca8 0x1c908 0xc48 0x1ccf0 0xbed 0x1d0d8 0xb94 0x1d4c0 0xb3e 0x1d8a8 0xaec 0x1dc90 0xa9b 0x1e078 0xa50 0x1e460 0xa02 0x1e848 0x9bd>;
		};
	};

	fragment@71 {
		target = <0xffffffff>;

		__overlay__ {
			compatible = "mediatek,mt6685-tia-ntc";
			#thermal-sensor-cells = <0x00>;
			reg = <0x00 0x1cc0055c 0x00 0x04>;
			temperature-lookup-table = <0xffff63c0 0x4394c8 0xffff67a8 0x3f1088 0xffff6b90 0x3ada68 0xffff6f78 0x36daf8 0xffff7360 0x3325c0 0xffff7748 0x2fca60 0xffff7b30 0x2c9de0 0xffff7f18 0x29b3c8 0xffff8300 0x270060 0xffff86e8 0x247408 0xffff8ad0 0x221e60 0xffff8eb8 0x200b20 0xffff92a0 0x1de840 0xffff9688 0x1c07c8 0xffff9a70 0x1a4690 0xffff9e58 0x18a0b0 0xffffa240 0x171a10 0xffffa628 0x15aec8 0xffffaa10 0x145af0 0xffffadf8 0x1335f8 0xffffb1e0 0x11f5a8 0xffffb5c8 0x10ff90 0xffffb9b0 0xfd6b0 0xffffbd98 0xee4e4 0xffffc180 0xe06a0 0xffffc568 0xd3478 0xffffc950 0xc80c8 0xffffcd38 0xbb4e0 0xffffd120 0xb0a2c 0xffffd508 0xa6748 0xffffd8f0 0x9cf54 0xffffdcd8 0x94250 0xffffe0c0 0x8c488 0xffffe4a8 0x8497c 0xffffe890 0x7d0c8 0xffffec78 0x76750 0xfffff060 0x6f2e8 0xfffff448 0x69140 0xfffff830 0x634ac 0xfffffc18 0x5dd2c 0x00 0x59420 0x3e8 0x5459c 0x7d0 0x4fcf4 0xbb8 0x4b9c4 0xfa0 0x47ba8 0x1388 0x43fe4 0x1770 0x408d0 0x1b58 0x3d0f4 0x1f40 0x39f58 0x2328 0x37460 0x2710 0x345e4 0x2af8 0x318f8 0x2ee0 0x2f120 0x32c8 0x2cb3c 0x36b0 0x2a814 0x3a98 0x28618 0x3e80 0x266d8 0x4268 0x249f0 0x4650 0x22d08 0x4a38 0x21214 0x4e20 0x1fb08 0x5208 0x1e140 0x55f0 0x1c9d0 0x59d8 0x1b4b8 0x5dc0 0x19960 0x61a8 0x186a0 0x6590 0x174ee 0x6978 0x1647c 0x6d60 0x153c4 0x7148 0x14488 0x7530 0x13628 0x7918 0x128a4 0x7d00 0x11aee 0x80e8 0x10e5a 0x84d0 0x10298 0x88b8 0xf7a8 0x8ca0 0xec90 0x9088 0xe2b8 0x9470 0xd87c 0x9858 0xcf26 0x9c40 0xc652 0xa028 0xbe28 0xa410 0xb6c6 0xa7f8 0xaf1e 0xabe0 0xa6e0 0xafc8 0x9fe2 0xb3b0 0x9934 0xb798 0x92f4 0xbb80 0x8cdc 0xbf68 0x871e 0xc350 0x81a6 0xc738 0x7c6a 0xcb20 0x7760 0xcf08 0x729c 0xd2f0 0x6e0a 0xd6d8 0x69aa 0xdac0 0x657c 0xdea8 0x618a 0xe290 0x5dc0 0xe678 0x5a14 0xea60 0x5690 0xee48 0x533e 0xf230 0x500a 0xf618 0x4d12 0xfa00 0x4a1a 0xfde8 0x474a 0x101d0 0x44a2 0x105b8 0x4218 0x109a0 0x3fa2 0x10d88 0x3d54 0x11170 0x3b06 0x11558 0x38e0 0x11940 0x36ce 0x11d28 0x34d0 0x12110 0x32f0 0x124f8 0x312e 0x128e0 0x2f62 0x12cc8 0x2dc8 0x130b0 0x2c1a 0x13498 0x2a94 0x13880 0x290e 0x13c68 0x279c 0x14050 0x2633 0x14438 0x24ee 0x14820 0x23ae 0x14c08 0x226e 0x14ff0 0x2149 0x153d8 0x2020 0x157c0 0x1f10 0x15ba8 0x1e09 0x15f90 0x1cfd 0x16378 0x1c0b 0x16760 0x1b22 0x16b48 0x1a35 0x16f30 0x195c 0x17318 0x188b 0x17700 0x17c1 0x17ae8 0x16f5 0x17ed0 0x1639 0x182b8 0x1584 0x186a0 0x14d7 0x18a88 0x142f 0x18e70 0x138c 0x19258 0x12e7 0x19640 0x1252 0x19a28 0x11c2 0x19e10 0x1131 0x1a1f8 0x10ab 0x1a5e0 0x1027 0x1a9c8 0xfaa 0x1adb0 0xf2f 0x1b198 0xebb 0x1b580 0xe48 0x1b968 0xdda 0x1bd50 0xd71 0x1c138 0xd0b 0x1c520 0xca8 0x1c908 0xc48 0x1ccf0 0xbed 0x1d0d8 0xb94 0x1d4c0 0xb3e 0x1d8a8 0xaec 0x1dc90 0xa9b 0x1e078 0xa50 0x1e460 0xa02 0x1e848 0x9bd>;
		};
	};

	fragment@72 {
		target = <0xffffffff>;

		__overlay__ {
			compatible = "generic-adc-thermal";
			#thermal-sensor-cells = <0x00>;
			io-channels = <0xffffffff 0x13>;
			io-channel-names = "sensor-channel";
			temperature-lookup-table = <0xffff63c0 0x707 0xffff67a8 0x705 0xffff6b90 0x702 0xffff6f78 0x6fe 0xffff7360 0x6fb 0xffff7748 0x6f7 0xffff7b30 0x6f3 0xffff7f18 0x6ef 0xffff8300 0x6eb 0xffff86e8 0x6e6 0xffff8ad0 0x6e1 0xffff8eb8 0x6dc 0xffff92a0 0x6d7 0xffff9688 0x6d1 0xffff9a70 0x6cb 0xffff9e58 0x6c5 0xffffa240 0x6be 0xffffa628 0x6b7 0xffffaa10 0x6b0 0xffffadf8 0x6a9 0xffffb1e0 0x6a0 0xffffb5c8 0x698 0xffffb9b0 0x68e 0xffffbd98 0x685 0xffffc180 0x67b 0xffffc568 0x671 0xffffc950 0x668 0xffffcd38 0x65c 0xffffd120 0x651 0xffffd508 0x645 0xffffd8f0 0x638 0xffffdcd8 0x62c 0xffffe0c0 0x61f 0xffffe4a8 0x612 0xffffe890 0x603 0xffffec78 0x5f6 0xfffff060 0x5e5 0xfffff448 0x5d5 0xfffff830 0x5c5 0xfffffc18 0x5b4 0x00 0x5a5 0x3e8 0x593 0x7d0 0x581 0xbb8 0x56f 0xfa0 0x55d 0x1388 0x54a 0x1770 0x537 0x1b58 0x522 0x1f40 0x50f 0x2328 0x4fc 0x2710 0x4e7 0x2af8 0x4d1 0x2ee0 0x4bc 0x32c8 0x4a6 0x36b0 0x491 0x3a98 0x47b 0x3e80 0x465 0x4268 0x450 0x4650 0x43a 0x4a38 0x423 0x4e20 0x40f 0x5208 0x3f8 0x55f0 0x3e1 0x59d8 0x3cb 0x5dc0 0x3ae 0x61a8 0x398 0x6590 0x383 0x6978 0x36e 0x6d60 0x358 0x7148 0x343 0x7530 0x32e 0x7918 0x31a 0x7d00 0x305 0x80e8 0x2f1 0x84d0 0x2dd 0x88b8 0x2ca 0x8ca0 0x2b6 0x9088 0x2a4 0x9470 0x290 0x9858 0x27e 0x9c40 0x26c 0xa028 0x25a 0xa410 0x24b 0xa7f8 0x23a 0xabe0 0x227 0xafc8 0x216 0xb3b0 0x206 0xb798 0x1f7 0xbb80 0x1e8 0xbf68 0x1d9 0xc350 0x1cb 0xc738 0x1bc 0xcb20 0x1af 0xcf08 0x1a1 0xd2f0 0x194 0xd6d8 0x188 0xdac0 0x17b 0xdea8 0x170 0xe290 0x164 0xe678 0x159 0xea60 0x14e 0xee48 0x143 0xf230 0x139 0xf618 0x12f 0xfa00 0x125 0xfde8 0x11c 0x101d0 0x113 0x105b8 0x10a 0x109a0 0x102 0x10d88 0xfa 0x11170 0xf2 0x11558 0xea 0x11940 0xe2 0x11d28 0xdb 0x12110 0xd4 0x124f8 0xce 0x128e0 0xc7 0x12cc8 0xc1 0x130b0 0xbb 0x13498 0xb5 0x13880 0xaf 0x13c68 0xa9 0x14050 0xa4 0x14438 0x9f 0x14820 0x9a 0x14c08 0x95 0x14ff0 0x90 0x153d8 0x8c 0x157c0 0x88 0x15ba8 0x83 0x15f90 0x7f 0x16378 0x7b 0x16760 0x78 0x16b48 0x74 0x16f30 0x70 0x17318 0x6d 0x17700 0x69 0x17ae8 0x66 0x17ed0 0x63 0x182b8 0x60 0x186a0 0x5d 0x18a88 0x5a 0x18e70 0x58 0x19258 0x55 0x19640 0x52 0x19a28 0x50 0x19e10 0x4e 0x1a1f8 0x4b 0x1a5e0 0x49 0x1a9c8 0x47 0x1adb0 0x45 0x1b198 0x43 0x1b580 0x41 0x1b968 0x3f 0x1bd50 0x3d 0x1c138 0x3b 0x1c520 0x3a 0x1c908 0x38 0x1ccf0 0x37 0x1d0d8 0x35 0x1d4c0 0x33 0x1d8a8 0x32 0x1dc90 0x31 0x1e078 0x2f 0x1e460 0x2e 0x1e848 0x2d>;
		};
	};

	fragment@73 {
		target = <0xffffffff>;

		__overlay__ {
			compatible = "generic-adc-thermal";
			#thermal-sensor-cells = <0x00>;
			io-channels = <0xffffffff 0x14>;
			io-channel-names = "sensor-channel";
			temperature-lookup-table = <0xffff63c0 0x707 0xffff67a8 0x705 0xffff6b90 0x702 0xffff6f78 0x6fe 0xffff7360 0x6fb 0xffff7748 0x6f7 0xffff7b30 0x6f3 0xffff7f18 0x6ef 0xffff8300 0x6eb 0xffff86e8 0x6e6 0xffff8ad0 0x6e1 0xffff8eb8 0x6dc 0xffff92a0 0x6d7 0xffff9688 0x6d1 0xffff9a70 0x6cb 0xffff9e58 0x6c5 0xffffa240 0x6be 0xffffa628 0x6b7 0xffffaa10 0x6b0 0xffffadf8 0x6a9 0xffffb1e0 0x6a0 0xffffb5c8 0x698 0xffffb9b0 0x68e 0xffffbd98 0x685 0xffffc180 0x67b 0xffffc568 0x671 0xffffc950 0x668 0xffffcd38 0x65c 0xffffd120 0x651 0xffffd508 0x645 0xffffd8f0 0x638 0xffffdcd8 0x62c 0xffffe0c0 0x61f 0xffffe4a8 0x612 0xffffe890 0x603 0xffffec78 0x5f6 0xfffff060 0x5e5 0xfffff448 0x5d5 0xfffff830 0x5c5 0xfffffc18 0x5b4 0x00 0x5a5 0x3e8 0x593 0x7d0 0x581 0xbb8 0x56f 0xfa0 0x55d 0x1388 0x54a 0x1770 0x537 0x1b58 0x522 0x1f40 0x50f 0x2328 0x4fc 0x2710 0x4e7 0x2af8 0x4d1 0x2ee0 0x4bc 0x32c8 0x4a6 0x36b0 0x491 0x3a98 0x47b 0x3e80 0x465 0x4268 0x450 0x4650 0x43a 0x4a38 0x423 0x4e20 0x40f 0x5208 0x3f8 0x55f0 0x3e1 0x59d8 0x3cb 0x5dc0 0x3ae 0x61a8 0x398 0x6590 0x383 0x6978 0x36e 0x6d60 0x358 0x7148 0x343 0x7530 0x32e 0x7918 0x31a 0x7d00 0x305 0x80e8 0x2f1 0x84d0 0x2dd 0x88b8 0x2ca 0x8ca0 0x2b6 0x9088 0x2a4 0x9470 0x290 0x9858 0x27e 0x9c40 0x26c 0xa028 0x25a 0xa410 0x24b 0xa7f8 0x23a 0xabe0 0x227 0xafc8 0x216 0xb3b0 0x206 0xb798 0x1f7 0xbb80 0x1e8 0xbf68 0x1d9 0xc350 0x1cb 0xc738 0x1bc 0xcb20 0x1af 0xcf08 0x1a1 0xd2f0 0x194 0xd6d8 0x188 0xdac0 0x17b 0xdea8 0x170 0xe290 0x164 0xe678 0x159 0xea60 0x14e 0xee48 0x143 0xf230 0x139 0xf618 0x12f 0xfa00 0x125 0xfde8 0x11c 0x101d0 0x113 0x105b8 0x10a 0x109a0 0x102 0x10d88 0xfa 0x11170 0xf2 0x11558 0xea 0x11940 0xe2 0x11d28 0xdb 0x12110 0xd4 0x124f8 0xce 0x128e0 0xc7 0x12cc8 0xc1 0x130b0 0xbb 0x13498 0xb5 0x13880 0xaf 0x13c68 0xa9 0x14050 0xa4 0x14438 0x9f 0x14820 0x9a 0x14c08 0x95 0x14ff0 0x90 0x153d8 0x8c 0x157c0 0x88 0x15ba8 0x83 0x15f90 0x7f 0x16378 0x7b 0x16760 0x78 0x16b48 0x74 0x16f30 0x70 0x17318 0x6d 0x17700 0x69 0x17ae8 0x66 0x17ed0 0x63 0x182b8 0x60 0x186a0 0x5d 0x18a88 0x5a 0x18e70 0x58 0x19258 0x55 0x19640 0x52 0x19a28 0x50 0x19e10 0x4e 0x1a1f8 0x4b 0x1a5e0 0x49 0x1a9c8 0x47 0x1adb0 0x45 0x1b198 0x43 0x1b580 0x41 0x1b968 0x3f 0x1bd50 0x3d 0x1c138 0x3b 0x1c520 0x3a 0x1c908 0x38 0x1ccf0 0x37 0x1d0d8 0x35 0x1d4c0 0x33 0x1d8a8 0x32 0x1dc90 0x31 0x1e078 0x2f 0x1e460 0x2e 0x1e848 0x2d>;
		};
	};

	fragment@74 {
		target = <0xffffffff>;

		__overlay__ {
			compatible = "generic-adc-thermal";
			#thermal-sensor-cells = <0x00>;
			io-channels = <0xffffffff 0x15>;
			io-channel-names = "sensor-channel";
			temperature-lookup-table = <0xffff63c0 0x707 0xffff67a8 0x705 0xffff6b90 0x702 0xffff6f78 0x6fe 0xffff7360 0x6fb 0xffff7748 0x6f7 0xffff7b30 0x6f3 0xffff7f18 0x6ef 0xffff8300 0x6eb 0xffff86e8 0x6e6 0xffff8ad0 0x6e1 0xffff8eb8 0x6dc 0xffff92a0 0x6d7 0xffff9688 0x6d1 0xffff9a70 0x6cb 0xffff9e58 0x6c5 0xffffa240 0x6be 0xffffa628 0x6b7 0xffffaa10 0x6b0 0xffffadf8 0x6a9 0xffffb1e0 0x6a0 0xffffb5c8 0x698 0xffffb9b0 0x68e 0xffffbd98 0x685 0xffffc180 0x67b 0xffffc568 0x671 0xffffc950 0x668 0xffffcd38 0x65c 0xffffd120 0x651 0xffffd508 0x645 0xffffd8f0 0x638 0xffffdcd8 0x62c 0xffffe0c0 0x61f 0xffffe4a8 0x612 0xffffe890 0x603 0xffffec78 0x5f6 0xfffff060 0x5e5 0xfffff448 0x5d5 0xfffff830 0x5c5 0xfffffc18 0x5b4 0x00 0x5a5 0x3e8 0x593 0x7d0 0x581 0xbb8 0x56f 0xfa0 0x55d 0x1388 0x54a 0x1770 0x537 0x1b58 0x522 0x1f40 0x50f 0x2328 0x4fc 0x2710 0x4e7 0x2af8 0x4d1 0x2ee0 0x4bc 0x32c8 0x4a6 0x36b0 0x491 0x3a98 0x47b 0x3e80 0x465 0x4268 0x450 0x4650 0x43a 0x4a38 0x423 0x4e20 0x40f 0x5208 0x3f8 0x55f0 0x3e1 0x59d8 0x3cb 0x5dc0 0x3ae 0x61a8 0x398 0x6590 0x383 0x6978 0x36e 0x6d60 0x358 0x7148 0x343 0x7530 0x32e 0x7918 0x31a 0x7d00 0x305 0x80e8 0x2f1 0x84d0 0x2dd 0x88b8 0x2ca 0x8ca0 0x2b6 0x9088 0x2a4 0x9470 0x290 0x9858 0x27e 0x9c40 0x26c 0xa028 0x25a 0xa410 0x24b 0xa7f8 0x23a 0xabe0 0x227 0xafc8 0x216 0xb3b0 0x206 0xb798 0x1f7 0xbb80 0x1e8 0xbf68 0x1d9 0xc350 0x1cb 0xc738 0x1bc 0xcb20 0x1af 0xcf08 0x1a1 0xd2f0 0x194 0xd6d8 0x188 0xdac0 0x17b 0xdea8 0x170 0xe290 0x164 0xe678 0x159 0xea60 0x14e 0xee48 0x143 0xf230 0x139 0xf618 0x12f 0xfa00 0x125 0xfde8 0x11c 0x101d0 0x113 0x105b8 0x10a 0x109a0 0x102 0x10d88 0xfa 0x11170 0xf2 0x11558 0xea 0x11940 0xe2 0x11d28 0xdb 0x12110 0xd4 0x124f8 0xce 0x128e0 0xc7 0x12cc8 0xc1 0x130b0 0xbb 0x13498 0xb5 0x13880 0xaf 0x13c68 0xa9 0x14050 0xa4 0x14438 0x9f 0x14820 0x9a 0x14c08 0x95 0x14ff0 0x90 0x153d8 0x8c 0x157c0 0x88 0x15ba8 0x83 0x15f90 0x7f 0x16378 0x7b 0x16760 0x78 0x16b48 0x74 0x16f30 0x70 0x17318 0x6d 0x17700 0x69 0x17ae8 0x66 0x17ed0 0x63 0x182b8 0x60 0x186a0 0x5d 0x18a88 0x5a 0x18e70 0x58 0x19258 0x55 0x19640 0x52 0x19a28 0x50 0x19e10 0x4e 0x1a1f8 0x4b 0x1a5e0 0x49 0x1a9c8 0x47 0x1adb0 0x45 0x1b198 0x43 0x1b580 0x41 0x1b968 0x3f 0x1bd50 0x3d 0x1c138 0x3b 0x1c520 0x3a 0x1c908 0x38 0x1ccf0 0x37 0x1d0d8 0x35 0x1d4c0 0x33 0x1d8a8 0x32 0x1dc90 0x31 0x1e078 0x2f 0x1e460 0x2e 0x1e848 0x2d>;
		};
	};

	fragment@75 {
		target = <0xffffffff>;

		__overlay__ {
			compatible = "generic-adc-thermal";
			#thermal-sensor-cells = <0x00>;
			io-channels = <0xffffffff 0x16>;
			io-channel-names = "sensor-channel";
			temperature-lookup-table = <0xffff63c0 0x707 0xffff67a8 0x705 0xffff6b90 0x702 0xffff6f78 0x6fe 0xffff7360 0x6fb 0xffff7748 0x6f7 0xffff7b30 0x6f3 0xffff7f18 0x6ef 0xffff8300 0x6eb 0xffff86e8 0x6e6 0xffff8ad0 0x6e1 0xffff8eb8 0x6dc 0xffff92a0 0x6d7 0xffff9688 0x6d1 0xffff9a70 0x6cb 0xffff9e58 0x6c5 0xffffa240 0x6be 0xffffa628 0x6b7 0xffffaa10 0x6b0 0xffffadf8 0x6a9 0xffffb1e0 0x6a0 0xffffb5c8 0x698 0xffffb9b0 0x68e 0xffffbd98 0x685 0xffffc180 0x67b 0xffffc568 0x671 0xffffc950 0x668 0xffffcd38 0x65c 0xffffd120 0x651 0xffffd508 0x645 0xffffd8f0 0x638 0xffffdcd8 0x62c 0xffffe0c0 0x61f 0xffffe4a8 0x612 0xffffe890 0x603 0xffffec78 0x5f6 0xfffff060 0x5e5 0xfffff448 0x5d5 0xfffff830 0x5c5 0xfffffc18 0x5b4 0x00 0x5a5 0x3e8 0x593 0x7d0 0x581 0xbb8 0x56f 0xfa0 0x55d 0x1388 0x54a 0x1770 0x537 0x1b58 0x522 0x1f40 0x50f 0x2328 0x4fc 0x2710 0x4e7 0x2af8 0x4d1 0x2ee0 0x4bc 0x32c8 0x4a6 0x36b0 0x491 0x3a98 0x47b 0x3e80 0x465 0x4268 0x450 0x4650 0x43a 0x4a38 0x423 0x4e20 0x40f 0x5208 0x3f8 0x55f0 0x3e1 0x59d8 0x3cb 0x5dc0 0x3ae 0x61a8 0x398 0x6590 0x383 0x6978 0x36e 0x6d60 0x358 0x7148 0x343 0x7530 0x32e 0x7918 0x31a 0x7d00 0x305 0x80e8 0x2f1 0x84d0 0x2dd 0x88b8 0x2ca 0x8ca0 0x2b6 0x9088 0x2a4 0x9470 0x290 0x9858 0x27e 0x9c40 0x26c 0xa028 0x25a 0xa410 0x24b 0xa7f8 0x23a 0xabe0 0x227 0xafc8 0x216 0xb3b0 0x206 0xb798 0x1f7 0xbb80 0x1e8 0xbf68 0x1d9 0xc350 0x1cb 0xc738 0x1bc 0xcb20 0x1af 0xcf08 0x1a1 0xd2f0 0x194 0xd6d8 0x188 0xdac0 0x17b 0xdea8 0x170 0xe290 0x164 0xe678 0x159 0xea60 0x14e 0xee48 0x143 0xf230 0x139 0xf618 0x12f 0xfa00 0x125 0xfde8 0x11c 0x101d0 0x113 0x105b8 0x10a 0x109a0 0x102 0x10d88 0xfa 0x11170 0xf2 0x11558 0xea 0x11940 0xe2 0x11d28 0xdb 0x12110 0xd4 0x124f8 0xce 0x128e0 0xc7 0x12cc8 0xc1 0x130b0 0xbb 0x13498 0xb5 0x13880 0xaf 0x13c68 0xa9 0x14050 0xa4 0x14438 0x9f 0x14820 0x9a 0x14c08 0x95 0x14ff0 0x90 0x153d8 0x8c 0x157c0 0x88 0x15ba8 0x83 0x15f90 0x7f 0x16378 0x7b 0x16760 0x78 0x16b48 0x74 0x16f30 0x70 0x17318 0x6d 0x17700 0x69 0x17ae8 0x66 0x17ed0 0x63 0x182b8 0x60 0x186a0 0x5d 0x18a88 0x5a 0x18e70 0x58 0x19258 0x55 0x19640 0x52 0x19a28 0x50 0x19e10 0x4e 0x1a1f8 0x4b 0x1a5e0 0x49 0x1a9c8 0x47 0x1adb0 0x45 0x1b198 0x43 0x1b580 0x41 0x1b968 0x3f 0x1bd50 0x3d 0x1c138 0x3b 0x1c520 0x3a 0x1c908 0x38 0x1ccf0 0x37 0x1d0d8 0x35 0x1d4c0 0x33 0x1d8a8 0x32 0x1dc90 0x31 0x1e078 0x2f 0x1e460 0x2e 0x1e848 0x2d>;
		};
	};

	fragment@76 {
		target = <0xffffffff>;

		__overlay__ {
			compatible = "generic-adc-thermal";
			#thermal-sensor-cells = <0x00>;
			io-channels = <0xffffffff 0x17>;
			io-channel-names = "sensor-channel";
			temperature-lookup-table = <0xffff63c0 0x707 0xffff67a8 0x704 0xffff6b90 0x701 0xffff6f78 0x6fe 0xffff7360 0x6fa 0xffff7748 0x6f7 0xffff7b30 0x6f3 0xffff7f18 0x6ef 0xffff8300 0x6e9 0xffff86e8 0x6e5 0xffff8ad0 0x6e0 0xffff8eb8 0x6da 0xffff92a0 0x6d5 0xffff9688 0x6cf 0xffff9a70 0x6c9 0xffff9e58 0x6c3 0xffffa240 0x6bb 0xffffa628 0x6b4 0xffffaa10 0x6ad 0xffffadf8 0x6a5 0xffffb1e0 0x69d 0xffffb5c8 0x695 0xffffb9b0 0x68b 0xffffbd98 0x682 0xffffc180 0x678 0xffffc568 0x66e 0xffffc950 0x663 0xffffcd38 0x657 0xffffd120 0x64c 0xffffd508 0x640 0xffffd8f0 0x634 0xffffdcd8 0x626 0xffffe0c0 0x619 0xffffe4a8 0x60c 0xffffe890 0x5fd 0xffffec78 0x5ee 0xfffff060 0x5df 0xfffff448 0x5cf 0xfffff830 0x5bf 0xfffffc18 0x5af 0x00 0x59d 0x3e8 0x58c 0x7d0 0x57a 0xbb8 0x568 0xfa0 0x555 0x1388 0x542 0x1770 0x52f 0x1b58 0x51b 0x1f40 0x507 0x2328 0x4f3 0x2710 0x4de 0x2af8 0x4c9 0x2ee0 0x4b4 0x32c8 0x49f 0x36b0 0x489 0x3a98 0x474 0x3e80 0x45d 0x4268 0x448 0x4650 0x431 0x4a38 0x41c 0x4e20 0x405 0x5208 0x3f0 0x55f0 0x3d9 0x59d8 0x3c4 0x5dc0 0x3ad 0x61a8 0x398 0x6590 0x383 0x6978 0x36d 0x6d60 0x358 0x7148 0x342 0x7530 0x32e 0x7918 0x318 0x7d00 0x304 0x80e8 0x2f0 0x84d0 0x2dc 0x88b8 0x2c8 0x8ca0 0x2b5 0x9088 0x2a2 0x9470 0x28f 0x9858 0x27d 0x9c40 0x26a 0xa028 0x259 0xa410 0x248 0xa7f8 0x237 0xabe0 0x226 0xafc8 0x217 0xb3b0 0x206 0xb798 0x1f7 0xbb80 0x1e8 0xbf68 0x1d9 0xc350 0x1cb 0xc738 0x1bd 0xcb20 0x1af 0xcf08 0x1a2 0xd2f0 0x195 0xd6d8 0x189 0xdac0 0x17c 0xdea8 0x170 0xe290 0x165 0xe678 0x15a 0xea60 0x14e 0xee48 0x144 0xf230 0x13a 0xf618 0x130 0xfa00 0x126 0xfde8 0x11d 0x101d0 0x114 0x105b8 0x10b 0x109a0 0x103 0x10d88 0xfa 0x11170 0xf2 0x11558 0xeb 0x11940 0xe3 0x11d28 0xdc 0x12110 0xd6 0x124f8 0xce 0x128e0 0xc8 0x12cc8 0xc1 0x130b0 0xbb 0x13498 0xb6 0x13880 0xb0 0x13c68 0xab 0x14050 0xa5 0x14438 0x9f 0x14820 0x9a 0x14c08 0x96 0x14ff0 0x91 0x153d8 0x8d 0x157c0 0x88 0x15ba8 0x84 0x15f90 0x80 0x16378 0x7c 0x16760 0x79 0x16b48 0x75 0x16f30 0x71 0x17318 0x6d 0x17700 0x6a 0x17ae8 0x67 0x17ed0 0x64 0x182b8 0x61 0x186a0 0x5e 0x18a88 0x5b 0x18e70 0x59 0x19258 0x56 0x19640 0x53 0x19a28 0x51 0x19e10 0x4f 0x1a1f8 0x4c 0x1a5e0 0x4a 0x1a9c8 0x48 0x1adb0 0x46 0x1b198 0x43 0x1b580 0x41 0x1b968 0x3f 0x1bd50 0x3e 0x1c138 0x3c 0x1c520 0x3a 0x1c908 0x39 0x1ccf0 0x37 0x1d0d8 0x35 0x1d4c0 0x34 0x1d8a8 0x33 0x1dc90 0x31 0x1e078 0x30 0x1e460 0x2f 0x1e848 0x2d>;
		};
	};

	fragment@77 {
		target = <0xffffffff>;

		__overlay__ {
			compatible = "generic-adc-thermal";
			#thermal-sensor-cells = <0x00>;
			io-channels = <0xffffffff 0x17>;
			io-channel-names = "sensor-channel";
			temperature-lookup-table = <0xffff63c0 0x707 0xffff67a8 0x705 0xffff6b90 0x702 0xffff6f78 0x6fe 0xffff7360 0x6fb 0xffff7748 0x6f7 0xffff7b30 0x6f3 0xffff7f18 0x6ef 0xffff8300 0x6eb 0xffff86e8 0x6e6 0xffff8ad0 0x6e1 0xffff8eb8 0x6dc 0xffff92a0 0x6d7 0xffff9688 0x6d1 0xffff9a70 0x6cb 0xffff9e58 0x6c5 0xffffa240 0x6be 0xffffa628 0x6b7 0xffffaa10 0x6b0 0xffffadf8 0x6a9 0xffffb1e0 0x6a0 0xffffb5c8 0x698 0xffffb9b0 0x68e 0xffffbd98 0x685 0xffffc180 0x67b 0xffffc568 0x671 0xffffc950 0x668 0xffffcd38 0x65c 0xffffd120 0x651 0xffffd508 0x645 0xffffd8f0 0x638 0xffffdcd8 0x62c 0xffffe0c0 0x61f 0xffffe4a8 0x612 0xffffe890 0x603 0xffffec78 0x5f6 0xfffff060 0x5e5 0xfffff448 0x5d5 0xfffff830 0x5c5 0xfffffc18 0x5b4 0x00 0x5a5 0x3e8 0x593 0x7d0 0x581 0xbb8 0x56f 0xfa0 0x55d 0x1388 0x54a 0x1770 0x537 0x1b58 0x522 0x1f40 0x50f 0x2328 0x4fc 0x2710 0x4e7 0x2af8 0x4d1 0x2ee0 0x4bc 0x32c8 0x4a6 0x36b0 0x491 0x3a98 0x47b 0x3e80 0x465 0x4268 0x450 0x4650 0x43a 0x4a38 0x423 0x4e20 0x40f 0x5208 0x3f8 0x55f0 0x3e1 0x59d8 0x3cb 0x5dc0 0x3ae 0x61a8 0x398 0x6590 0x383 0x6978 0x36e 0x6d60 0x358 0x7148 0x343 0x7530 0x32e 0x7918 0x31a 0x7d00 0x305 0x80e8 0x2f1 0x84d0 0x2dd 0x88b8 0x2ca 0x8ca0 0x2b6 0x9088 0x2a4 0x9470 0x290 0x9858 0x27e 0x9c40 0x26c 0xa028 0x25a 0xa410 0x24b 0xa7f8 0x23a 0xabe0 0x227 0xafc8 0x216 0xb3b0 0x206 0xb798 0x1f7 0xbb80 0x1e8 0xbf68 0x1d9 0xc350 0x1cb 0xc738 0x1bc 0xcb20 0x1af 0xcf08 0x1a1 0xd2f0 0x194 0xd6d8 0x188 0xdac0 0x17b 0xdea8 0x170 0xe290 0x164 0xe678 0x159 0xea60 0x14e 0xee48 0x143 0xf230 0x139 0xf618 0x12f 0xfa00 0x125 0xfde8 0x11c 0x101d0 0x113 0x105b8 0x10a 0x109a0 0x102 0x10d88 0xfa 0x11170 0xf2 0x11558 0xea 0x11940 0xe2 0x11d28 0xdb 0x12110 0xd4 0x124f8 0xce 0x128e0 0xc7 0x12cc8 0xc1 0x130b0 0xbb 0x13498 0xb5 0x13880 0xaf 0x13c68 0xa9 0x14050 0xa4 0x14438 0x9f 0x14820 0x9a 0x14c08 0x95 0x14ff0 0x90 0x153d8 0x8c 0x157c0 0x88 0x15ba8 0x83 0x15f90 0x7f 0x16378 0x7b 0x16760 0x78 0x16b48 0x74 0x16f30 0x70 0x17318 0x6d 0x17700 0x69 0x17ae8 0x66 0x17ed0 0x63 0x182b8 0x60 0x186a0 0x5d 0x18a88 0x5a 0x18e70 0x58 0x19258 0x55 0x19640 0x52 0x19a28 0x50 0x19e10 0x4e 0x1a1f8 0x4b 0x1a5e0 0x49 0x1a9c8 0x47 0x1adb0 0x45 0x1b198 0x43 0x1b580 0x41 0x1b968 0x3f 0x1bd50 0x3d 0x1c138 0x3b 0x1c520 0x3a 0x1c908 0x38 0x1ccf0 0x37 0x1d0d8 0x35 0x1d4c0 0x33 0x1d8a8 0x32 0x1dc90 0x31 0x1e078 0x2f 0x1e460 0x2e 0x1e848 0x2d>;
		};
	};

	fragment@78 {
		target = <0xffffffff>;

		__overlay__ {
			compatible = "generic-adc-thermal";
			#thermal-sensor-cells = <0x00>;
			io-channels = <0xffffffff 0x18>;
			io-channel-names = "sensor-channel";
			temperature-lookup-table = <0xffff63c0 0x707 0xffff67a8 0x705 0xffff6b90 0x702 0xffff6f78 0x6fe 0xffff7360 0x6fb 0xffff7748 0x6f7 0xffff7b30 0x6f3 0xffff7f18 0x6ef 0xffff8300 0x6eb 0xffff86e8 0x6e6 0xffff8ad0 0x6e1 0xffff8eb8 0x6dc 0xffff92a0 0x6d7 0xffff9688 0x6d1 0xffff9a70 0x6cb 0xffff9e58 0x6c5 0xffffa240 0x6be 0xffffa628 0x6b7 0xffffaa10 0x6b0 0xffffadf8 0x6a9 0xffffb1e0 0x6a0 0xffffb5c8 0x698 0xffffb9b0 0x68e 0xffffbd98 0x685 0xffffc180 0x67b 0xffffc568 0x671 0xffffc950 0x668 0xffffcd38 0x65c 0xffffd120 0x651 0xffffd508 0x645 0xffffd8f0 0x638 0xffffdcd8 0x62c 0xffffe0c0 0x61f 0xffffe4a8 0x612 0xffffe890 0x603 0xffffec78 0x5f6 0xfffff060 0x5e5 0xfffff448 0x5d5 0xfffff830 0x5c5 0xfffffc18 0x5b4 0x00 0x5a5 0x3e8 0x593 0x7d0 0x581 0xbb8 0x56f 0xfa0 0x55d 0x1388 0x54a 0x1770 0x537 0x1b58 0x522 0x1f40 0x50f 0x2328 0x4fc 0x2710 0x4e7 0x2af8 0x4d1 0x2ee0 0x4bc 0x32c8 0x4a6 0x36b0 0x491 0x3a98 0x47b 0x3e80 0x465 0x4268 0x450 0x4650 0x43a 0x4a38 0x423 0x4e20 0x40f 0x5208 0x3f8 0x55f0 0x3e1 0x59d8 0x3cb 0x5dc0 0x3ae 0x61a8 0x398 0x6590 0x383 0x6978 0x36e 0x6d60 0x358 0x7148 0x343 0x7530 0x32e 0x7918 0x31a 0x7d00 0x305 0x80e8 0x2f1 0x84d0 0x2dd 0x88b8 0x2ca 0x8ca0 0x2b6 0x9088 0x2a4 0x9470 0x290 0x9858 0x27e 0x9c40 0x26c 0xa028 0x25a 0xa410 0x24b 0xa7f8 0x23a 0xabe0 0x227 0xafc8 0x216 0xb3b0 0x206 0xb798 0x1f7 0xbb80 0x1e8 0xbf68 0x1d9 0xc350 0x1cb 0xc738 0x1bc 0xcb20 0x1af 0xcf08 0x1a1 0xd2f0 0x194 0xd6d8 0x188 0xdac0 0x17b 0xdea8 0x170 0xe290 0x164 0xe678 0x159 0xea60 0x14e 0xee48 0x143 0xf230 0x139 0xf618 0x12f 0xfa00 0x125 0xfde8 0x11c 0x101d0 0x113 0x105b8 0x10a 0x109a0 0x102 0x10d88 0xfa 0x11170 0xf2 0x11558 0xea 0x11940 0xe2 0x11d28 0xdb 0x12110 0xd4 0x124f8 0xce 0x128e0 0xc7 0x12cc8 0xc1 0x130b0 0xbb 0x13498 0xb5 0x13880 0xaf 0x13c68 0xa9 0x14050 0xa4 0x14438 0x9f 0x14820 0x9a 0x14c08 0x95 0x14ff0 0x90 0x153d8 0x8c 0x157c0 0x88 0x15ba8 0x83 0x15f90 0x7f 0x16378 0x7b 0x16760 0x78 0x16b48 0x74 0x16f30 0x70 0x17318 0x6d 0x17700 0x69 0x17ae8 0x66 0x17ed0 0x63 0x182b8 0x60 0x186a0 0x5d 0x18a88 0x5a 0x18e70 0x58 0x19258 0x55 0x19640 0x52 0x19a28 0x50 0x19e10 0x4e 0x1a1f8 0x4b 0x1a5e0 0x49 0x1a9c8 0x47 0x1adb0 0x45 0x1b198 0x43 0x1b580 0x41 0x1b968 0x3f 0x1bd50 0x3d 0x1c138 0x3b 0x1c520 0x3a 0x1c908 0x38 0x1ccf0 0x37 0x1d0d8 0x35 0x1d4c0 0x33 0x1d8a8 0x32 0x1dc90 0x31 0x1e078 0x2f 0x1e460 0x2e 0x1e848 0x2d>;
		};
	};

	fragment@79 {
		target = <0xffffffff>;

		__overlay__ {

			quiet_therm {
				polling-delay = <0x00>;
				polling-delay-passive = <0x00>;
				thermal-sensors = <0xffffffff>;
				phandle = <0x93>;

				trips {

					quiet-therm-crit {
						temperature = <0x1d0d8>;
						hysteresis = <0x7d0>;
						type = "passive";
						phandle = <0x94>;
					};
				};
			};

			charger1_therm {
				polling-delay = <0x00>;
				polling-delay-passive = <0x00>;
				thermal-sensors = <0xffffffff>;
				phandle = <0x95>;

				trips {

					charger1-therm-crit {
						temperature = <0x1d0d8>;
						hysteresis = <0x7d0>;
						type = "passive";
						phandle = <0x96>;
					};
				};
			};

			wifi_therm {
				polling-delay = <0x00>;
				polling-delay-passive = <0x00>;
				thermal-sensors = <0xffffffff>;
				phandle = <0x97>;

				trips {

					wifi-therm-crit {
						temperature = <0x1d0d8>;
						hysteresis = <0x7d0>;
						type = "passive";
						phandle = <0x98>;
					};
				};
			};

			flash_therm {
				polling-delay = <0x00>;
				polling-delay-passive = <0x00>;
				thermal-sensors = <0xffffffff>;
				phandle = <0x99>;

				trips {

					flash-therm-crit {
						temperature = <0x1d0d8>;
						hysteresis = <0x7d0>;
						type = "passive";
						phandle = <0x9a>;
					};
				};
			};

			ScreenPmic_therm {
				polling-delay = <0x00>;
				polling-delay-passive = <0x00>;
				thermal-sensors = <0xffffffff>;
				phandle = <0x9b>;

				trips {

					ScreenPmic-therm-crit {
						temperature = <0x1d0d8>;
						hysteresis = <0x7d0>;
						type = "passive";
						phandle = <0x9c>;
					};
				};
			};

			X7_therm {
				polling-delay = <0x00>;
				polling-delay-passive = <0x00>;
				thermal-sensors = <0xffffffff>;
				phandle = <0x9d>;

				trips {

					X7-therm-crit {
						temperature = <0x1d0d8>;
						hysteresis = <0x7d0>;
						type = "passive";
						phandle = <0x9e>;
					};
				};
			};
		};
	};

	fragment@80 {
		target = <0xffffffff>;

		__overlay__ {

			thermal-message {
				board-sensor = "VIRTUAL-SENSOR";
				phandle = <0x9f>;
			};
		};
	};

	fragment@81 {
		target = <0xffffffff>;

		__overlay__ {

			MTEE {
				compatible = "mediatek,mtk_svp_on_mtee_support";
				phandle = <0xa0>;
			};

			SecureVideoPath {
				compatible = "mediatek,mtk_sec_video_path_support";
				phandle = <0xa1>;
			};
		};
	};

	fragment@82 {
		target = <0xffffffff>;

		__overlay__ {
			status = "ok";
		};
	};

	fragment@83 {
		target = <0xffffffff>;

		__overlay__ {
			status = "ok";
		};
	};

	fragment@84 {
		target = <0xffffffff>;

		__overlay__ {
			status = "ok";
		};
	};

	fragment@85 {
		target = <0xffffffff>;

		__overlay__ {
			status = "ok";
		};
	};

	fragment@86 {
		target = <0xffffffff>;

		__overlay__ {
			status = "ok";
		};
	};

	fragment@87 {
		target = <0xffffffff>;

		__overlay__ {

			epa-elna-mtk {
				parts = <0xffffffff 0xffffffff 0xffffffff 0xffffffff>;

				hwid {
					gpio = <0xffffffff 0xd2 0x00>;
				};

				common {

					flags-0 {
						rx-mode = [35];
						fe-ant-cnt = [81];
						fe-main-bt-share-lp2g = [80];
						fe-conn-spdt = [83];
						fe-reserved = [80];
					};

					flags-1 {
						rx-mode = [35];
						fe-ant-cnt = [82];
						fe-main-bt-share-lp2g = [80];
						fe-conn-spdt = [83];
						fe-reserved = [86];
						bd-type = [01];
					};
				};

				wifi {

					flags-0 {
						epa-option = [aa];
					};

					flags-1 {
						epa-option = [aa];
					};
				};

				bt {

					flags-0 {
						epa-elna;
					};

					flags-1 {
						epa-elna;
					};
				};
			};
		};
	};

	fragment@88 {
		target = <0xffffffff>;

		__overlay__ {

			xiaomi_touch {
				compatible = "xiaomi-touch";
				status = "ok";
				touch,name = "xiaomi-touch";
				panel = <0x2e 0x2f>;
				phandle = <0xa2>;
			};
		};
	};

	fragment@89 {
		target = <0xffffffff>;

		__overlay__ {
			status = "okay";
			fifo_no_irq_support;
			autosuspend_delay = <0x0a>;
			#address-cells = <0x01>;
			#size-cells = <0x00>;

			xiaomi_touch@0 {
				status = "ok";
				compatible = "xiaomi,touch-spi";
				reg = <0x00>;
				interrupt-parent = <0xffffffff>;
				interrupts = <0x04 0x2008>;
				spi-max-frequency = <0xe4e1c0>;
				pinctrl-names = "pmx_ts_active\0pmx_ts_suspend\0pmx_gt_spi_mode\0pmx_gt_cs_gpio_mode\0pmx_gt_cs_spi_mode";
				pinctrl-0 = <0x30 0x31>;
				pinctrl-1 = <0x32 0x33>;
				pinctrl-2 = <0x34 0x35 0x36>;
				pinctrl-3 = <0x37>;
				pinctrl-4 = <0x38>;
				goodix,iovdd-name = "iovdd";
				iovdd-supply = <0xffffffff>;
				goodix,avdd-name = "avdd";
				avdd-supply = <0xffffffff>;
				goodix,irq-gpio = <0xffffffff 0x04 0x2008>;
				goodix,reset-gpio = <0xffffffff 0x03 0x00>;
				goodix,irq-flags = <0x02>;
				goodix,panel-max-x = <0x1dc8f>;
				goodix,panel-max-y = <0x4235f>;
				goodix,super-resolution-factor = <0x64>;
				goodix,panel-max-w = <0xff>;
				goodix,panel-max-p = <0x1000>;
				goodix,firmware-name = "goodix_firmware_rothko";
				goodix,config-name = "goodix_cfg_group_rothko";
				goodix,config-weijing-name = "goodix_cfg_group_rothko_weijing";
				goodix,touch-expert-array = <0x02 0x03 0x02 0x02 0x04 0x03 0x03 0x02 0x03 0x03 0x04 0x02>;
				focaltech,iovdd-name = "iovdd_focal";
				iovdd_focal-supply = <0xffffffff>;
				focaltech,avdd-name = "avdd_focal";
				avdd_focal-supply = <0xffffffff>;
				focaltech,irq-gpio = <0xffffffff 0x04 0x2008>;
				focaltech,reset-gpio = <0xffffffff 0x03 0x00>;
				focaltech,max-touch-number = <0x0a>;
				focaltech,super-resolution-factors = <0x64>;
				focaltech,display-coords = <0x00 0x00 0x1dc8f 0x4235f>;
				focaltech,touch-range-array = <0x01 0x05 0x0a 0x0f 0x14>;
				focaltech,touch-def-array = <0x03 0x03 0x03 0x03>;
				focaltech,touch-expert-array = <0x0a 0x0a 0x0a 0x0a 0x14 0x14 0x0f 0x0a 0x14 0x14 0x14 0x0a>;
				focaltech,support-fod = <0x01>;
				focaltech,fod-lx = <0x1f9>;
				focaltech,fod-ly = <0x923>;
				focaltech,fod-x-size = <0xd2>;
				focaltech,fod-y-size = <0xd2>;
				normal_cpu_mask = <0x0f>;
				game_boost_support;
				game_cpu_mask = <0x0f>;
				game_irq_boost_target = "\0\f5";
				mi_tp,game-mode-array = <0x01 0x00 0x00 0x00 0x00>;
				mi_tp,active-mode-array = <0x01 0x00 0x00 0x00 0x00>;
				mi_tp,tolerance-array = <0x04 0x00 0x02 0x02 0x02>;
				mi_tp,up-threshold-array = <0x04 0x00 0x03 0x03 0x03>;
				mi_tp,aim-sensitivity-array = <0x04 0x00 0x02 0x02 0x02>;
				mi_tp,tap-stability-array = <0x04 0x00 0x02 0x02 0x02>;
				mi_tp,edge-filter-array = <0x03 0x00 0x02 0x02 0x02>;
				mi_tp,panel-orien-array = <0x03 0x00 0x00 0x00 0x00>;
				mi_tp,report-rate-array = <0x03 0x00 0x00 0x00 0x00>;
				mi_tp,expert-mode-array = <0x03 0x01 0x01 0x01 0x01>;
			};
		};
	};

	fragment@90 {
		target = <0xffffffff>;

		__overlay__ {
			regulator-min-microvolt = <0x1b7740>;
			regulator-max-microvolt = <0x1b7740>;
		};
	};

	fragment@91 {
		target = <0xffffffff>;

		__overlay__ {
			regulator-min-microvolt = <0x325aa0>;
			regulator-max-microvolt = <0x325aa0>;
		};
	};

	fragment@92 {
		target = <0xffffffff>;

		__overlay__ {

			ts_reset_active {
				phandle = <0x30>;

				pins_cmd_dat {
					pinmux = <0x300>;
					output-low;
				};
			};

			ts_int_active {
				phandle = <0x31>;

				pins_cmd_dat {
					pinmux = <0x400>;
					input-enable;
					bias-disable;
				};
			};

			ts_int_suspend {
				phandle = <0x32>;

				pins_cmd_dat {
					pinmux = <0x400>;
					slew-rate = <0x01>;
					bias-pull-down;
				};
			};

			ts_reset_suspend {
				phandle = <0x33>;

				pins_cmd_dat {
					pinmux = <0x300>;
					slew-rate = <0x01>;
					bias-pull-down;
				};
			};

			ts_spimode {
				phandle = <0x34>;

				pins_cmd_dat {
					pinmux = <0xe802 0xe902>;
					drive-strength = <0x01>;
				};
			};

			ts_clkgtmode {
				phandle = <0x35>;

				pins_cmd_dat {
					pinmux = <0xe702>;
					drive-strength = <0x02>;
				};
			};

			ts_misogtmode {
				phandle = <0x36>;

				pins_cmd_dat {
					pinmux = <0xea02>;
					drive-strength = <0x00>;
				};
			};

			ts_csgpiomode {
				phandle = <0x37>;

				pins_cmd_dat {
					pinmux = <0xe800>;
					drive-strength = <0x01>;
					output-low;
				};
			};

			ts_csspimode {
				phandle = <0x38>;

				pins_cmd_dat {
					pinmux = <0xe802>;
					drive-strength = <0x01>;
					output-high;
				};
			};
		};
	};

	fragment@93 {
		target = <0xffffffff>;

		__overlay__ {

			xiaomi_fingerprint {
				compatible = "xiaomi,xiaomi-fp";
				spi-max-frequency = <0x7a1200>;
				netlink-event = <0x1d>;
				vfp-supply = <0xffffffff>;
				power-type = <0x01>;
				pinctrl-names = "spiio_gpio_mode\0spiio_spi_mode\0reset_high\0reset_low\0eint_default\0eint_pulldown";
				pinctrl-0 = <0x39>;
				pinctrl-1 = <0x3a>;
				pinctrl-2 = <0x3b>;
				pinctrl-3 = <0x3c>;
				pinctrl-4 = <0x3d>;
				pinctrl-5 = <0x3e>;
				xiaomi,gpio_irq = <0xffffffff 0x05 0x00>;
				interrupt-parent = <0xffffffff>;
				interrupts = <0x05 0x01 0x05 0x00>;
				status = "okay";
				phandle = <0xa3>;
			};
		};
	};

	fragment@94 {
		target = <0xffffffff>;

		__overlay__ {
			regulator-min-microvolt = <0x325aa0>;
			regulator-max-microvolt = <0x325aa0>;
		};
	};

	fragment@95 {
		target = <0xffffffff>;

		__overlay__ {

			state_gpio_mode {
				phandle = <0x39>;

				pins_cmd_dat {
					pinmux = <0xb700>;
					drive-strength = <0x06>;
					input-enable;
					bias-disable;
				};

				pins_cmd2_dat {
					pinmux = <0xb800>;
					drive-strength = <0x06>;
					input-enable;
					bias-disable;
				};

				pins_cmd3_dat {
					pinmux = <0xba00>;
					drive-strength = <0x06>;
					input-enable;
					bias-disable;
				};

				pins_cmd4_dat {
					pinmux = <0xb900>;
					drive-strength = <0x06>;
					input-enable;
					bias-disable;
				};
			};

			state_spi_mode {
				phandle = <0x3a>;

				pins_cmd_dat {
					pinmux = <0xb702>;
					drive-strength = <0x06>;
					input-enable;
					bias-disable;
				};

				pins_cmd2_dat {
					pinmux = <0xb802>;
					drive-strength = <0x06>;
					input-enable;
					bias-disable;
				};

				pins_cmd3_dat {
					pinmux = <0xba02>;
					drive-strength = <0x06>;
					input-enable;
					bias-disable;
				};

				pins_cmd4_dat {
					pinmux = <0xb902>;
					drive-strength = <0x06>;
					input-enable;
					bias-disable;
				};
			};

			state_reset_high {
				phandle = <0x3b>;

				pins_cmd_dat {
					pinmux = <0xd800>;
					slew-rate = <0x01>;
					output-high;
				};
			};

			state_reset_low {
				phandle = <0x3c>;

				pins_cmd_dat {
					pinmux = <0xd800>;
					slew-rate = <0x01>;
					output-low;
				};
			};

			state_eint_default {
				phandle = <0x3d>;

				pins_cmd_dat {
					pinmux = <0x500>;
					slew-rate = <0x00>;
					input-enable;
					bias-disable;
					input-schmitt-enable;
				};
			};

			state_eint_pulldown {
				phandle = <0x3e>;

				pins_cmd_dat {
					pinmux = <0x500>;
					slew-rate = <0x00>;
					input-enable;
					bias-pull-down;
					input-schmitt-enable;
				};
			};
		};
	};

	fragment@96 {
		target = <0xffffffff>;

		__overlay__ {

			vcam_ldo {
				compatible = "regulator-fixed";
				regulator-name = "vcam_ldo";
				regulator-min-microvolt = <0x1b7740>;
				regulator-max-microvolt = <0x1b7740>;
				gpio = <0xffffffff 0x9b 0x00>;
				enable-active-high;
				phandle = <0x51>;
			};

			camera-wide-avdd2-1p8 {
				compatible = "regulator-fixed";
				regulator-name = "camera-wide-avdd2-1p8";
				regulator-min-microvolt = <0x1b7740>;
				regulator-max-microvolt = <0x1b7740>;
				enable-active-high;
				gpio = <0xffffffff 0x5e 0x00>;
				phandle = <0x4f>;
			};

			camera-wide-dvdd-1p2 {
				compatible = "regulator-fixed";
				regulator-name = "camera-wide-dvdd-1p2";
				regulator-min-microvolt = <0x124f80>;
				regulator-max-microvolt = <0x124f80>;
				enable-active-high;
				gpio = <0xffffffff 0x5a 0x00>;
				phandle = <0x50>;
			};

			camera-tele-avdd-2p8 {
				compatible = "regulator-fixed";
				regulator-name = "camera-tele-avdd-2p8";
				regulator-min-microvolt = <0x2ab980>;
				regulator-max-microvolt = <0x2ab980>;
				enable-active-high;
				gpio = <0xffffffff 0x6f 0x00>;
				phandle = <0x5e>;
			};

			camera-tele-dvdd-1p1 {
				compatible = "regulator-fixed";
				regulator-name = "camera-tele-dvdd-1p1";
				regulator-min-microvolt = <0x10c8e0>;
				regulator-max-microvolt = <0x10c8e0>;
				enable-active-high;
				gpio = <0xffffffff 0x6e 0x00>;
				phandle = <0x5f>;
			};
		};
	};

	fragment@97 {
		target = <0xffffffff>;

		__overlay__ {
			#address-cells = <0x01>;
			#size-cells = <0x00>;

			onsemi,ldo@35 {
				compatible = "onsemi,fan53870";
				reg = <0x35>;
				index = <0x00>;
				phandle = <0xa4>;

				on,fan53870@0 {
					offset = [00 00];
					regulator-name = "fan53870-l1";
					regulator-min-microvolt = <0x80e80>;
					regulator-max-microvolt = <0x16f300>;
					min-dropout-voltage = <0x36ee8>;
					init-voltage = <0x124f80>;
					iout_ua = <0x9eb10>;
					phandle = <0x5d>;
				};

				on,fan53870@1 {
					offset = [00 01];
					regulator-name = "fan53870-l2";
					regulator-min-microvolt = <0x80e80>;
					regulator-max-microvolt = <0x16f300>;
					min-dropout-voltage = <0x36ee8>;
					init-voltage = <0x124f80>;
					iout_ua = <0x9eb10>;
					phandle = <0x76>;
				};

				on,fan53870@2 {
					offset = [00 02];
					regulator-name = "fan53870-l3";
					regulator-min-microvolt = <0x16f300>;
					regulator-max-microvolt = <0x33e140>;
					min-dropout-voltage = <0x30d40>;
					init-voltage = <0x2ab980>;
					iout_ua = <0x9eb10>;
					phandle = <0x45>;
				};

				on,fan53870@3 {
					offset = [00 03];
					regulator-name = "fan53870-l4";
					regulator-min-microvolt = <0x16f300>;
					regulator-max-microvolt = <0x33e140>;
					min-dropout-voltage = <0x30d40>;
					init-voltage = <0x2ab980>;
					iout_ua = <0x9eb10>;
					mi_adjust_reg = <0x17>;
					phandle = <0x4e>;
				};

				on,fan53870@4 {
					offset = [00 04];
					regulator-name = "fan53870-l5";
					regulator-min-microvolt = <0x16f300>;
					regulator-max-microvolt = <0x33e140>;
					min-dropout-voltage = <0x493e0>;
					init-voltage = <0x2932e0>;
					iout_ua = <0x9eb10>;
					phandle = <0x5c>;
				};

				on,fan53870@5 {
					offset = [00 05];
					regulator-name = "fan53870-l6";
					regulator-min-microvolt = <0x16f300>;
					regulator-max-microvolt = <0x33e140>;
					min-dropout-voltage = <0x493e0>;
					init-voltage = <0x2ab980>;
					iout_ua = <0x9eb10>;
					phandle = <0x75>;
				};

				on,fan53870@6 {
					offset = [00 06];
					regulator-name = "fan53870-l7";
					regulator-min-microvolt = <0x16f300>;
					regulator-max-microvolt = <0x33e140>;
					min-dropout-voltage = <0x493e0>;
					init-voltage = <0x2ab980>;
					iout_ua = <0x9eb10>;
					phandle = <0x53>;
				};
			};
		};
	};

	fragment@98 {
		target = <0xffffffff>;

		__overlay__ {

			seninf-csi-port-0 {
				compatible = "mediatek,seninf";
				csi-port = "0";
				nvmem-cells = <0xffffffff>;
				nvmem-cell-names = "rg_csi";
				phandle = <0xa5>;

				port {

					endpoint {
						remote-endpoint = <0x3f>;
						phandle = <0x77>;
					};
				};
			};

			seninf-csi-port-1 {
				compatible = "mediatek,seninf";
				csi-port = "1";
				nvmem-cells = <0xffffffff>;
				nvmem-cell-names = "rg_csi";
				phandle = <0xa6>;

				port {

					endpoint {
						remote-endpoint = <0x40>;
						phandle = <0x68>;
					};
				};
			};

			seninf-csi-port-2 {
				compatible = "mediatek,seninf";
				csi-port = "2";
				nvmem-cells = <0xffffffff>;
				nvmem-cell-names = "rg_csi";
				phandle = <0xa7>;

				port {

					endpoint {
						remote-endpoint = <0x41>;
						phandle = <0x52>;
					};
				};
			};

			seninf-csi-port-4 {
				compatible = "mediatek,seninf";
				csi-port = "4";
				nvmem-cells = <0xffffffff>;
				nvmem-cell-names = "rg_csi";
				phandle = <0xa8>;

				port {

					endpoint {
						remote-endpoint = <0x42>;
						phandle = <0x60>;
					};
				};
			};
		};
	};

	fragment@99 {
		target = <0xffffffff>;

		__overlay__ {

			camera-pins-cam0-mclk-off {
				phandle = <0x47>;

				pins-cmd-dat {
					pinmux = <0x7500>;
					drive-strength = <0x01>;
				};
			};

			camera-pins-cam0-mclk-2ma {
				phandle = <0x48>;

				pins-cmd-dat {
					pinmux = <0x7501>;
					drive-strength = <0x00>;
				};
			};

			camera-pins-cam0-mclk-4ma {
				phandle = <0x49>;

				pins-cmd-dat {
					pinmux = <0x7501>;
					drive-strength = <0x01>;
				};
			};

			camera-pins-cam0-mclk-6ma {
				phandle = <0x4a>;

				pins-cmd-dat {
					pinmux = <0x7501>;
					drive-strength = <0x02>;
				};
			};

			camera-pins-cam0-mclk-8ma {
				phandle = <0x4b>;

				pins-cmd-dat {
					pinmux = <0x7501>;
					drive-strength = <0x03>;
				};
			};

			cam0@0 {
				phandle = <0x4c>;

				pins-cmd-dat {
					pinmux = <0x7700>;
					slew-rate = <0x01>;
					output-low;
				};
			};

			cam0@1 {
				phandle = <0x4d>;

				pins-cmd-dat {
					pinmux = <0x7700>;
					slew-rate = <0x01>;
					output-high;
				};
			};

			camera-pins-cam0-oisvdd-0 {
				phandle = <0xa9>;

				pins-cmd-dat {
					pinmux = <0x5f00>;
					slew-rate = <0x01>;
					output-low;
				};
			};

			camera-pins-cam0-oisvdd-1 {
				phandle = <0xaa>;

				pins-cmd-dat {
					pinmux = <0x5f00>;
					slew-rate = <0x01>;
					output-high;
				};
			};

			camera-pins-cam1-mclk-off {
				phandle = <0x69>;

				pins-cmd-dat {
					pinmux = <0x7c00>;
					drive-strength = <0x01>;
				};
			};

			camera-pins-cam1-mclk-2ma {
				phandle = <0x6a>;

				pins-cmd-dat {
					pinmux = <0x7c01>;
					drive-strength = <0x00>;
				};
			};

			camera-pins-cam1-mclk-4ma {
				phandle = <0x6b>;

				pins-cmd-dat {
					pinmux = <0x7c01>;
					drive-strength = <0x01>;
				};
			};

			camera-pins-cam1-mclk-6ma {
				phandle = <0x6c>;

				pins-cmd-dat {
					pinmux = <0x7c01>;
					drive-strength = <0x02>;
				};
			};

			camera-pins-cam1-mclk-8ma {
				phandle = <0x6d>;

				pins-cmd-dat {
					pinmux = <0x7c01>;
					drive-strength = <0x03>;
				};
			};

			cam1@0 {
				phandle = <0x6e>;

				pins-cmd-dat {
					pinmux = <0x7200>;
					slew-rate = <0x01>;
					output-low;
				};
			};

			cam1@1 {
				phandle = <0x6f>;

				pins-cmd-dat {
					pinmux = <0x7200>;
					slew-rate = <0x01>;
					output-high;
				};
			};

			cam1@2 {
				phandle = <0x70>;

				pins-cmd-dat {
					pinmux = <0x6601>;
				};
			};

			cam1@3 {
				phandle = <0x71>;

				pins-cmd-dat {
					pinmux = <0x6602>;
				};
			};

			cam1@4 {
				phandle = <0x72>;

				pins-cmd-dat {
					pinmux = <0x6701>;
				};
			};

			cam1@5 {
				phandle = <0x73>;

				pins-cmd-dat {
					pinmux = <0x6702>;
				};
			};

			cam1@6 {
				phandle = <0x74>;

				pins-cmd-dat {
					pinmux = <0xd100>;
					bias-pull-up;
					input-enable;
				};
			};

			camera-pins-cam2-mclk-off {
				phandle = <0x55>;

				pins-cmd-dat {
					pinmux = <0x7d00>;
					drive-strength = <0x01>;
				};
			};

			camera-pins-cam2-mclk-2ma {
				phandle = <0x56>;

				pins-cmd-dat {
					pinmux = <0x7d01>;
					drive-strength = <0x00>;
				};
			};

			camera-pins-cam2-mclk-4ma {
				phandle = <0x57>;

				pins-cmd-dat {
					pinmux = <0x7d01>;
					drive-strength = <0x01>;
				};
			};

			camera-pins-cam2-mclk-6ma {
				phandle = <0x58>;

				pins-cmd-dat {
					pinmux = <0x7d01>;
					drive-strength = <0x02>;
				};
			};

			camera-pins-cam2-mclk-8ma {
				phandle = <0x59>;

				pins-cmd-dat {
					pinmux = <0x7d01>;
					drive-strength = <0x03>;
				};
			};

			cam2@0 {
				phandle = <0x5a>;

				pins-cmd-dat {
					pinmux = <0x7f00>;
					slew-rate = <0x01>;
					output-low;
				};
			};

			cam2@1 {
				phandle = <0x5b>;

				pins-cmd-dat {
					pinmux = <0x7f00>;
					slew-rate = <0x01>;
					output-high;
				};
			};

			cam2@2 {
				phandle = <0xab>;

				pins-cmd-dat {
					pinmux = <0x6c00>;
					slew-rate = <0x01>;
					output-low;
				};
			};

			cam2@3 {
				phandle = <0xac>;

				pins-cmd-dat {
					pinmux = <0x6c00>;
					slew-rate = <0x01>;
					output-high;
				};
			};

			cam4@4 {
				phandle = <0xad>;

				pins-cmd-dat {
					pinmux = <0xbd00>;
					slew-rate = <0x01>;
					output-low;
				};
			};

			cam4@5 {
				phandle = <0xae>;

				pins-cmd-dat {
					pinmux = <0xbd00>;
					slew-rate = <0x01>;
					output-high;
				};
			};

			camera-pins-cam3-mclk-off {
				phandle = <0x61>;

				pins-cmd-dat {
					pinmux = <0x7400>;
					drive-strength = <0x01>;
				};
			};

			camera-pins-cam3-mclk-2ma {
				phandle = <0x62>;

				pins-cmd-dat {
					pinmux = <0x7401>;
					drive-strength = <0x00>;
				};
			};

			camera-pins-cam3-mclk-4ma {
				phandle = <0x63>;

				pins-cmd-dat {
					pinmux = <0x7401>;
					drive-strength = <0x01>;
				};
			};

			camera-pins-cam3-mclk-6ma {
				phandle = <0x64>;

				pins-cmd-dat {
					pinmux = <0x7401>;
					drive-strength = <0x02>;
				};
			};

			camera-pins-cam3-mclk-8ma {
				phandle = <0x65>;

				pins-cmd-dat {
					pinmux = <0x7401>;
					drive-strength = <0x03>;
				};
			};

			cam0@6 {
				phandle = <0x66>;

				pins-cmd-dat {
					pinmux = <0x7600>;
					slew-rate = <0x01>;
					output-low;
				};
			};

			cam0@7 {
				phandle = <0x67>;

				pins-cmd-dat {
					pinmux = <0x7600>;
					slew-rate = <0x01>;
					output-high;
				};
			};

			cam0@8 {
				phandle = <0xaf>;

				pins-cmd-dat {
					pinmux = <0x7e00>;
					slew-rate = <0x01>;
					output-low;
				};
			};

			cam0@9 {
				phandle = <0xb0>;

				pins-cmd-dat {
					pinmux = <0x7e00>;
					slew-rate = <0x01>;
					output-high;
				};
			};

			cam0@10 {
				phandle = <0xb1>;

				pins-cmd-dat {
					pinmux = <0xdf00>;
					slew-rate = <0x01>;
					output-low;
				};
			};

			cam0@11 {
				phandle = <0xb2>;

				pins-cmd-dat {
					pinmux = <0xdf00>;
					slew-rate = <0x01>;
					output-high;
				};
			};

			camdefault {
				phandle = <0xb3>;
			};
		};
	};

	fragment@100 {
		target = <0xffffffff>;

		__overlay__ {
			#address-cells = <0x01>;
			#size-cells = <0x00>;

			port@0 {
				reg = <0x00>;

				endpoint {
					remote-endpoint = <0x43>;
					phandle = <0x46>;
				};
			};

			port@1 {

				endpoint {
					remote-endpoint = <0x44>;
					phandle = <0x54>;
				};
			};
		};
	};

	fragment@101 {
		target = <0xffffffff>;

		__overlay__ {
			status = "okay";
			clock-frequency = <0xf4240>;

			camera-af-main@c {
				compatible = "mediatek,main_vcm";
				reg = <0x0c>;
				vin-supply = <0x45>;

				port {

					endpoint {
						remote-endpoint = <0x46>;
						phandle = <0x43>;
					};
				};
			};

			camera-eeprom0@51 {
				compatible = "mediatek,camera_eeprom";
				reg = <0x51>;
				status = "okay";
				phandle = <0xb4>;
			};

			sensor0@10 {
				compatible = "mediatek,imgsensor";
				sensor-names = "rothkoimx906wide_mipi_raw\0rothkoov50h40wide_mipi_raw";
				reg = <0x10>;
				#thermal-sensor-cells = <0x00>;
				pinctrl-names = "mclk_off\0mclk_2mA\0mclk_4mA\0mclk_6mA\0mclk_8mA\0rst_low\0rst_high";
				pinctrl-0 = <0x47>;
				pinctrl-1 = <0x48>;
				pinctrl-2 = <0x49>;
				pinctrl-3 = <0x4a>;
				pinctrl-4 = <0x4b>;
				pinctrl-5 = <0x4c>;
				pinctrl-6 = <0x4d>;
				avdd-supply = <0x4e>;
				avdd1-supply = <0x4f>;
				dvdd-supply = <0x50>;
				dvdd1-supply = <0x51>;
				dovdd-supply = <0xffffffff>;
				afvdd-supply = <0x45>;
				clocks = <0xffffffff 0xdc 0xffffffff 0xdb 0xffffffff 0xb4 0xffffffff 0xda 0xffffffff 0xd9 0xffffffff 0xd7 0xffffffff 0xd6 0xffffffff 0x56>;
				clock-names = "6\012\013\019.2\024\026\052\0mclk";
				status = "okay";
				phandle = <0x7e>;

				port {

					endpoint {
						remote-endpoint = <0x52>;
						phandle = <0x41>;
					};
				};
			};
		};
	};

	fragment@102 {
		target = <0xffffffff>;

		__overlay__ {
			status = "okay";
			clock-frequency = <0x61a80>;

			camera-af-main@c {
				compatible = "mediatek,main2_vcm";
				reg = <0x0c>;
				vin-supply = <0x53>;

				port {

					endpoint {
						remote-endpoint = <0x54>;
						phandle = <0x44>;
					};
				};
			};

			sensor2@10 {
				compatible = "mediatek,imgsensor";
				sensor-names = "rothkoimx355ultra_mipi_raw\0rothkos5kjn1tele_mipi_raw";
				reg = <0x10>;
				#thermal-sensor-cells = <0x00>;
				pinctrl-names = "mclk_off\0mclk_2mA\0mclk_4mA\0mclk_6mA\0mclk_8mA\0rst_low\0rst_high";
				pinctrl-0 = <0x55>;
				pinctrl-1 = <0x56>;
				pinctrl-2 = <0x57>;
				pinctrl-3 = <0x58>;
				pinctrl-4 = <0x59>;
				pinctrl-5 = <0x5a>;
				pinctrl-6 = <0x5b>;
				avdd-supply = <0x5c>;
				dvdd-supply = <0x51>;
				dvdd1-supply = <0x5d>;
				dovdd-supply = <0xffffffff>;
				avdd1-supply = <0x5e>;
				dvdd2-supply = <0x5f>;
				afvdd-supply = <0x53>;
				clocks = <0xffffffff 0xdc 0xffffffff 0xdb 0xffffffff 0xb4 0xffffffff 0xda 0xffffffff 0xd9 0xffffffff 0xd7 0xffffffff 0xd6 0xffffffff 0x54>;
				clock-names = "6\012\013\019.2\024\026\052\0mclk";
				status = "okay";
				phandle = <0x80>;

				port {

					endpoint {
						remote-endpoint = <0x60>;
						phandle = <0x42>;
					};
				};
			};

			camera-eeprom2@50 {
				compatible = "mediatek,camera_eeprom";
				reg = <0x50>;
				status = "okay";
				phandle = <0xb5>;
			};
		};
	};

	fragment@103 {
		target = <0xffffffff>;

		__overlay__ {
			status = "okay";
			clock-frequency = <0xf4240>;
		};
	};

	fragment@104 {
		target = <0xffffffff>;

		__overlay__ {
			status = "okay";
			clock-frequency = <0x61a80>;

			sensor3@10 {
				compatible = "mediatek,imgsensor";
				sensor-names = "rothkogc02m1macro_mipi_raw\0rothkoov13b10ultra_mipi_raw";
				reg = <0x10>;
				#thermal-sensor-cells = <0x00>;
				pinctrl-names = "mclk_off\0mclk_2mA\0mclk_4mA\0mclk_6mA\0mclk_8mA\0rst_low\0rst_high";
				pinctrl-0 = <0x61>;
				pinctrl-1 = <0x62>;
				pinctrl-2 = <0x63>;
				pinctrl-3 = <0x64>;
				pinctrl-4 = <0x65>;
				pinctrl-5 = <0x66>;
				pinctrl-6 = <0x67>;
				avdd-supply = <0x53>;
				avdd1-supply = <0x5c>;
				dvdd-supply = <0x51>;
				dvdd1-supply = <0x5d>;
				dovdd-supply = <0xffffffff>;
				dvdd2-supply = <0xffffffff>;
				clocks = <0xffffffff 0xdc 0xffffffff 0xdb 0xffffffff 0xb4 0xffffffff 0xda 0xffffffff 0xd9 0xffffffff 0xd7 0xffffffff 0xd6 0xffffffff 0x55>;
				clock-names = "6\012\013\019.2\024\026\052\0mclk";
				status = "okay";
				phandle = <0x81>;

				port {

					endpoint {
						remote-endpoint = <0x68>;
						phandle = <0x40>;
					};
				};
			};

			camera-eeprom3@52 {
				compatible = "mediatek,camera_eeprom";
				reg = <0x52>;
				status = "okay";
				phandle = <0xb6>;
			};
		};
	};

	fragment@105 {
		target = <0xffffffff>;

		__overlay__ {
			status = "okay";
			clock-frequency = <0xf4240>;
			mediatek,bypass-mark-suspend;

			sensor1@10 {
				compatible = "mediatek,imgsensor";
				sensor-names = "rothkoov20bfront_mipi_raw\0rothkos5kkd1front_mipi_raw";
				reg = <0x10>;
				pinctrl-names = "mclk1_off\0mclk1_2mA\0mclk1_4mA\0mclk1_6mA\0mclk1_8mA\0rst_low\0rst_high\0scl_ap\0scl_scp\0sda_ap\0sda_scp\0eint";
				pinctrl-0 = <0x69>;
				pinctrl-1 = <0x6a>;
				pinctrl-2 = <0x6b>;
				pinctrl-3 = <0x6c>;
				pinctrl-4 = <0x6d>;
				pinctrl-5 = <0x6e>;
				pinctrl-6 = <0x6f>;
				pinctrl-7 = <0x70>;
				pinctrl-8 = <0x71>;
				pinctrl-9 = <0x72>;
				pinctrl-10 = <0x73>;
				pinctrl-11 = <0x74>;
				avdd-supply = <0x75>;
				dvdd-supply = <0x76>;
				dovdd-supply = <0xffffffff>;
				dvdd1-supply = <0x51>;
				clocks = <0xffffffff 0xa0 0xffffffff 0x9f 0xffffffff 0xb4 0xffffffff 0x9e 0xffffffff 0x9d 0xffffffff 0x9a 0xffffffff 0xbf 0xffffffff 0x99 0xffffffff 0x10>;
				clock-names = "clk1_6\0clk1_12\0clk1_13\0clk1_19.2\0clk1_24\0clk1_26\0clk1_26_ulposc\0clk1_52\0clk1_mclk1";
				status = "okay";
				phandle = <0x7f>;

				port {

					endpoint {
						remote-endpoint = <0x77>;
						phandle = <0x3f>;
					};
				};
			};

			camera-eeprom1@51 {
				compatible = "mediatek,camera_eeprom";
				reg = <0x51>;
				status = "okay";
				phandle = <0xb7>;
			};
		};
	};

	fragment@106 {
		target = <0xffffffff>;

		__overlay__ {
			#address-cells = <0x01>;
			#size-cells = <0x00>;

			ocp81373@63 {
				compatible = "mediatek,ocp81373";
				#address-cells = <0x01>;
				#size-cells = <0x00>;
				reg = <0x63>;
				#cooling-cells = <0x02>;
				pinctrl-names = "hwen-high\0hwen-low";
				pinctrl-0 = <0x78>;
				pinctrl-1 = <0x79>;
				status = "okay";
				phandle = <0xb8>;

				flash@0 {
					reg = <0x00>;
					type = <0x00>;
					ct = <0x00>;
					part = <0x00>;

					port {

						endpoint {
							remote-endpoint = <0x7a>;
							phandle = <0x7c>;
						};
					};
				};

				flash@1 {
					reg = <0x01>;
					type = <0x00>;
					ct = <0x01>;
					part = <0x00>;

					port {

						endpoint {
							remote-endpoint = <0x7b>;
							phandle = <0x7d>;
						};
					};
				};
			};
		};
	};

	fragment@107 {
		target = <0xffffffff>;

		__overlay__ {

			hwen-high {
				phandle = <0x78>;

				pins-cmd-dat {
					pinmux = <0x700>;
					slew-rate = <0x01>;
					output-high;
				};
			};

			hwen-low {
				phandle = <0x79>;

				pins-cmd-dat {
					pinmux = <0x700>;
					slew-rate = <0x01>;
					output-low;
				};
			};
		};
	};

	fragment@108 {
		target = <0xffffffff>;

		__overlay__ {
			#address-cells = <0x01>;
			#size-cells = <0x00>;

			port@0 {
				reg = <0x00>;

				endpoint {
					remote-endpoint = <0x7c>;
					phandle = <0x7a>;
				};
			};

			port@1 {
				reg = <0x01>;

				endpoint {
					remote-endpoint = <0x7d>;
					phandle = <0x7b>;
				};
			};
		};
	};

	fragment@109 {
		target = <0xffffffff>;

		__overlay__ {

			camera0 {
				polling-delay = <0x00>;
				polling-delay-passive = <0x00>;
				thermal-sensors = <0x7e>;
				phandle = <0xb9>;

				trips {

					camera0-crit {
						temperature = <0x1d4c0>;
						hysteresis = <0x7d0>;
						type = "passive";
						phandle = <0xba>;
					};
				};
			};

			camera1 {
				polling-delay = <0x00>;
				polling-delay-passive = <0x00>;
				thermal-sensors = <0x7f>;
				phandle = <0xbb>;

				trips {

					camera1-crit {
						temperature = <0x1d4c0>;
						hysteresis = <0x7d0>;
						type = "passive";
						phandle = <0xbc>;
					};
				};
			};

			camera2 {
				polling-delay = <0x00>;
				polling-delay-passive = <0x00>;
				thermal-sensors = <0x80>;
				phandle = <0xbd>;

				trips {

					camera2-crit {
						temperature = <0x1d4c0>;
						hysteresis = <0x7d0>;
						type = "passive";
						phandle = <0xbe>;
					};
				};
			};

			camera3 {
				polling-delay = <0x00>;
				polling-delay-passive = <0x00>;
				thermal-sensors = <0x81>;
				phandle = <0xbf>;

				trips {

					camera3-crit {
						temperature = <0x1d4c0>;
						hysteresis = <0x7d0>;
						type = "passive";
						phandle = <0xc0>;
					};
				};
			};
		};
	};

	fragment@110 {
		target = <0xffffffff>;

		__overlay__ {
			binding-core = <0x04 0x05 0x06>;
		};
	};

	fragment@111 {
		target = <0xffffffff>;

		__overlay__ {
			status = "okay";
			clock-frequency = <0x61a80>;

			nxp@28 {
				compatible = "qcom,nq-nci";
				reg = <0x28>;
				qcom,nq-irq = <0xffffffff 0x9a 0x00>;
				interrupt-parent = <0xffffffff>;
				interrupts = <0x9a 0x04 0x9a 0x00>;
				qcom,nq-ven = <0xffffffff 0x12 0x00>;
				qcom,nq-clkreq = <0xffffffff 0x0f 0x00>;
				tms,irq-gpio = <0xffffffff 0x9a 0x00>;
				tms,ven-gpio = <0xffffffff 0x12 0x00>;
				tms,download-gpio = <0xffffffff 0x13 0x00>;
				interrupt-names = "nfc_irq";
				pinctrl-names = "default\0nfc_active\0nfc_suspend";
				pinctrl-0 = <0x82>;
				pinctrl-1 = <0x83 0x84 0x85 0x86>;
				pinctrl-2 = <0x87 0x88 0x89 0x8a>;
			};
		};
	};

	fragment@112 {
		target = <0xffffffff>;

		__overlay__ {

			nfc_default {
				phandle = <0x82>;
			};

			nfc_int_active {
				phandle = <0x83>;

				pins_cmd_dat {
					pinmux = <0x9a00>;
					slew-rate = <0x00>;
					drive-strength = <0x02>;
					bias-pull-up;
				};
			};

			nfc_int_suspend {
				phandle = <0x87>;

				pins_cmd_dat {
					pinmux = <0x9a00>;
					slew-rate = <0x00>;
					drive-strength = <0x02>;
					bias-pull-up;
				};
			};

			nfc_enable_active {
				phandle = <0x84>;

				pins_cmd_dat {
					pinmux = <0x1200>;
					slew-rate = <0x01>;
					output-high;
					drive-strength = <0x02>;
					bias-pull-up = <0x67>;
				};
			};

			nfc_enable_suspend {
				phandle = <0x88>;

				pins_cmd_dat {
					pinmux = <0x1200>;
					slew-rate = <0x01>;
					drive-strength = <0x02>;
					bias-disable;
				};
			};

			nfc_firmwaredownload_active {
				phandle = <0x85>;

				pins_cmd_dat {
					pinmux = <0x1300>;
					slew-rate = <0x01>;
					drive-strength = <0x02>;
					bias-pull-up;
				};
			};

			nfc_firmwaredownload_suspend {
				phandle = <0x89>;

				pins_cmd_dat {
					pinmux = <0x1300>;
					slew-rate = <0x01>;
					drive-strength = <0x02>;
					bias-disable;
				};
			};

			nfc_clk_req_active {
				phandle = <0x86>;

				pins_cmd_dat {
					pinmux = <0xf01>;
					slew-rate = <0x00>;
					input-enable;
					drive-strength = <0x02>;
					bias-pull-up;
				};
			};

			nfc_clk_req_suspend {
				phandle = <0x8a>;

				pins_cmd_dat {
					pinmux = <0xf01>;
					slew-rate = <0x00>;
					input-enable;
					drive-strength = <0x02>;
					bias-pull-down;
				};
			};
		};
	};

	fragment@113 {
		target = <0xffffffff>;

		__overlay__ {
			#address-cells = <0x01>;
			#size-cells = <0x00>;

			p61@31 {
				compatible = "nxp,p61";
				reg = <0x00>;
				nxp,nfcc = "3-0028";
				spi-max-frequency = <0x7a1200>;
				status = "okay";
				pinctrl-names = "nxp_ese_spi_mode";
				pinctrl-0 = <0x8b>;
			};
		};
	};

	fragment@114 {
		target = <0xffffffff>;

		__overlay__ {

			nxp_ese_spi_mode {
				phandle = <0x8b>;

				pins_cmd_dat {
					pinmux = <0x4d01 0x4c01 0x4a01 0x4b01>;
					drive-strength = <0x06>;
				};
			};
		};
	};

	fragment@115 {
		target = <0xffffffff>;

		__overlay__ {
			clock-frequency = <0x61a80>;

			nuvolta_1652@41 {
				compatible = "nuvolta,rx1652";
				reg = <0x41>;
				pwr_det_gpio = <0xffffffff 0x11 0x00>;
				rx_irq_gpio = <0xffffffff 0x10 0x00>;
				rx_sleep_gpio = <0xffffffff 0xd0 0x00>;
				reverse_chg_ovp_gpio = <0xffffffff 0xe1 0x00>;
				reverse_boost_gpio = <0xffffffff 0xbe 0x00>;
				pmic_vbus-supply = <0xffffffff>;
			};
		};
	};

	fragment@116 {
		target = <0xffffffff>;

		__overlay__ {
			compatible = "wls_cp_manager";
			fv = <0x1176>;
			fv_ffc = <0x11aa>;
			max_fcc = <0x2710>;
			max_vbus = <0x4c2c>;
			max_ibus = <0x9c4>;
			fcc_low_hyst = <0x96>;
			fcc_high_hyst = <0x00>;
			low_tbat = <0x64>;
			high_tbat = <0x1e0>;
			high_vbat = <0x1130>;
			high_soc = <0x5f>;
			low_fcc = <0x7d0>;
			cv_vbat = <0x116c>;
			cv_vbat_ffc = <0x119e>;
			cv_ibat = <0x7d0>;
			vbus_low_gap_div = <0x1f4>;
			vbus_high_gap_div = <0x258>;
			wls_cm_ibus_gap = <0x258>;
		};
	};

	__symbols__ {
		t1_gpio_vc_all = "/fragment@1/__overlay__/t1_gpio_vc_all";
		xiaomi_wifi_gpio = "/fragment@3/__overlay__/xiaomi_wifi_gpio";
		mtkfb_pins_lcd_bias_enp1 = "/fragment@11/__overlay__/lcd-bias-enp1-gpio";
		mtkfb_pins_lcd_bias_enp0 = "/fragment@11/__overlay__/lcd-bias-enp0-gpio";
		mtkfb_pins_lcd_bias_enn1 = "/fragment@11/__overlay__/lcd-bias-enn1-gpio";
		mtkfb_pins_lcd_bias_enn0 = "/fragment@11/__overlay__/lcd-bias-enn0-gpio";
		mtkfb_pins_lcm_rst_out1_gpio = "/fragment@11/__overlay__/lcm-rst-out1-gpio";
		mtkfb_pins_lcm_rst_out0_gpio = "/fragment@11/__overlay__/lcm-rst-out0-gpio";
		mtkfb_pins_lcm_dsi_te = "/fragment@11/__overlay__/lcm-dsi-te";
		mtkfb_pins_lcm_led_en1 = "/fragment@11/__overlay__/lcm-led-en1-gpio";
		mtkfb_pins_lcm_led_en0 = "/fragment@11/__overlay__/lcm-led-en0-gpio";
		mtkfb_pins_lcm_dsi1_te = "/fragment@11/__overlay__/lcm-dsi1-te";
		mtkfb_pins_lcm_dsi_gpio = "/fragment@11/__overlay__/lcm-dsi-gpio";
		mtkfb_pins_lcm_dsi1_gpio = "/fragment@11/__overlay__/lcm-dsi1-gpio";
		panel1_in = "/fragment@15/__overlay__/panel1@0/port/endpoint";
		panel2_in = "/fragment@15/__overlay__/panel2@1/port/endpoint";
		panel3_in = "/fragment@15/__overlay__/panel3@2/port/endpoint";
		panel4_in = "/fragment@15/__overlay__/panel4@3/port/endpoint";
		dsi1_out = "/fragment@15/__overlay__/ports/port/endpoint@0";
		dsi1_out2 = "/fragment@15/__overlay__/ports/port/endpoint@1";
		dsi1_out3 = "/fragment@15/__overlay__/ports/port/endpoint@2";
		dsi1_out4 = "/fragment@15/__overlay__/ports/port/endpoint@3";
		rothko_42_02_0a_dsc_cmd = "/fragment@17/__overlay__/panel1@0";
		panel_in1 = "/fragment@17/__overlay__/panel1@0/port/endpoint";
		rothko_36_02_0b_dsc_cmd = "/fragment@17/__overlay__/panel2@1";
		panel_in2 = "/fragment@17/__overlay__/panel2@1/port/endpoint";
		dsi_out = "/fragment@17/__overlay__/ports/port/endpoint";
		key_gpio_default = "/fragment@20/__overlay__/key-default";
		pcie0_pins_default = "/fragment@25/__overlay__/pcie0-default";
		pcie0_pins_work = "/fragment@25/__overlay__/pcie0-work";
		pcie0_pins_sleep = "/fragment@25/__overlay__/pcie0-sleep";
		pcie1_pins_default = "/fragment@25/__overlay__/pcie1-default";
		tcpc_typec_usb = "/fragment@26/__overlay__/port/endpoint";
		ssusb_mux = "/fragment@27/__overlay__/port/endpoint";
		spk1 = "/fragment@30/__overlay__/aw882xx_smartpa@34";
		spk2 = "/fragment@30/__overlay__/aw882xx_smartpa@35";
		sc8581_master_int_default = "/fragment@39/__overlay__/sc8581_master_int_default";
		sc8581_lpm_output_high = "/fragment@39/__overlay__/sc8581_lpm_output_high";
		sc8581_lpm_output_low = "/fragment@39/__overlay__/sc8581_lpm_output_low";
		spi0_bus_active = "/fragment@44/__overlay__/spi0_bus_active";
		spi0_cs_active = "/fragment@44/__overlay__/spi0_cs_active";
		spi0_sleep = "/fragment@44/__overlay__/spi0_sleep";
		uart1_tx_active = "/fragment@44/__overlay__/uart1_tx_active";
		uart1_rx_active = "/fragment@44/__overlay__/uart1_rx_active";
		uart1_sleep = "/fragment@44/__overlay__/uart1_sleep";
		irtx_gpio_led_default = "/fragment@53/__overlay__/irtx_gpio_led_def@gpio187";
		irtx_gpio_led_set = "/fragment@53/__overlay__/irtx_gpio_led_set@gpio187";
		sih_reset_low = "/fragment@66/__overlay__/sih_reset_reset";
		sih_reset_high = "/fragment@66/__overlay__/sih_reset_active";
		sih_interrupt = "/fragment@66/__overlay__/sih_interrupt_active";
		awinic_reset_low = "/fragment@67/__overlay__/awinic_reset_reset";
		awinic_reset_high = "/fragment@67/__overlay__/awinic_reset_active";
		awinic_interrupt = "/fragment@67/__overlay__/awinic_interrupt_active";
		sih6887_haptic = "/fragment@68/__overlay__/sih6887_haptic@6B";
		quiet_therm = "/fragment@79/__overlay__/quiet_therm";
		quiet_therm_crit = "/fragment@79/__overlay__/quiet_therm/trips/quiet-therm-crit";
		charger1_therm = "/fragment@79/__overlay__/charger1_therm";
		charger1_therm_crit = "/fragment@79/__overlay__/charger1_therm/trips/charger1-therm-crit";
		wifi_therm = "/fragment@79/__overlay__/wifi_therm";
		wifi_therm_crit = "/fragment@79/__overlay__/wifi_therm/trips/wifi-therm-crit";
		flash_therm = "/fragment@79/__overlay__/flash_therm";
		flash_therm_crit = "/fragment@79/__overlay__/flash_therm/trips/flash-therm-crit";
		ScreenPmic_therm = "/fragment@79/__overlay__/ScreenPmic_therm";
		ScreenPmic_therm_crit = "/fragment@79/__overlay__/ScreenPmic_therm/trips/ScreenPmic-therm-crit";
		X7_therm = "/fragment@79/__overlay__/X7_therm";
		X7_therm_crit = "/fragment@79/__overlay__/X7_therm/trips/X7-therm-crit";
		thermal_message = "/fragment@80/__overlay__/thermal-message";
		mtee = "/fragment@81/__overlay__/MTEE";
		svp = "/fragment@81/__overlay__/SecureVideoPath";
		xiaomi_touch = "/fragment@88/__overlay__/xiaomi_touch";
		ts_reset_active = "/fragment@92/__overlay__/ts_reset_active";
		ts_int_active = "/fragment@92/__overlay__/ts_int_active";
		ts_int_suspend = "/fragment@92/__overlay__/ts_int_suspend";
		ts_reset_suspend = "/fragment@92/__overlay__/ts_reset_suspend";
		ts_spi_mode = "/fragment@92/__overlay__/ts_spimode";
		ts_clk_gt_mode = "/fragment@92/__overlay__/ts_clkgtmode";
		ts_miso_gt_mode = "/fragment@92/__overlay__/ts_misogtmode";
		ts_cs_gpio_mode = "/fragment@92/__overlay__/ts_csgpiomode";
		ts_cs_spi_mode = "/fragment@92/__overlay__/ts_csspimode";
		xiaomi_fingerprint = "/fragment@93/__overlay__/xiaomi_fingerprint";
		fingerprints_spiio_gpio_mode = "/fragment@95/__overlay__/state_gpio_mode";
		fingerprints_spiio_spi_mode = "/fragment@95/__overlay__/state_spi_mode";
		fingerprints_reset_high = "/fragment@95/__overlay__/state_reset_high";
		fingerprints_reset_low = "/fragment@95/__overlay__/state_reset_low";
		fingerprints_eint_default = "/fragment@95/__overlay__/state_eint_default";
		fingerprints_eint_pulldown = "/fragment@95/__overlay__/state_eint_pulldown";
		vcam_ldo = "/fragment@96/__overlay__/vcam_ldo";
		camera_wide_avdd2_1p8 = "/fragment@96/__overlay__/camera-wide-avdd2-1p8";
		camera_wide_dvdd_1p2 = "/fragment@96/__overlay__/camera-wide-dvdd-1p2";
		camera_tele_avdd_2p8 = "/fragment@96/__overlay__/camera-tele-avdd-2p8";
		camera_tele_dvdd_1p2 = "/fragment@96/__overlay__/camera-tele-dvdd-1p1";
		fan53870_pm = "/fragment@97/__overlay__/onsemi,ldo@35";
		fan53870_l1 = "/fragment@97/__overlay__/onsemi,ldo@35/on,fan53870@0";
		fan53870_l2 = "/fragment@97/__overlay__/onsemi,ldo@35/on,fan53870@1";
		fan53870_l3 = "/fragment@97/__overlay__/onsemi,ldo@35/on,fan53870@2";
		fan53870_l4 = "/fragment@97/__overlay__/onsemi,ldo@35/on,fan53870@3";
		fan53870_l5 = "/fragment@97/__overlay__/onsemi,ldo@35/on,fan53870@4";
		fan53870_l6 = "/fragment@97/__overlay__/onsemi,ldo@35/on,fan53870@5";
		fan53870_l7 = "/fragment@97/__overlay__/onsemi,ldo@35/on,fan53870@6";
		seninf_csi_port_0 = "/fragment@98/__overlay__/seninf-csi-port-0";
		seninf_csi_port_0_in = "/fragment@98/__overlay__/seninf-csi-port-0/port/endpoint";
		seninf_csi_port_1 = "/fragment@98/__overlay__/seninf-csi-port-1";
		seninf_csi_port_1_in = "/fragment@98/__overlay__/seninf-csi-port-1/port/endpoint";
		seninf_csi_port_2 = "/fragment@98/__overlay__/seninf-csi-port-2";
		seninf_csi_port_2_in = "/fragment@98/__overlay__/seninf-csi-port-2/port/endpoint";
		seninf_csi_port_4 = "/fragment@98/__overlay__/seninf-csi-port-4";
		seninf_csi_port_4_in = "/fragment@98/__overlay__/seninf-csi-port-4/port/endpoint";
		camera_pins_cam0_mclk_off = "/fragment@99/__overlay__/camera-pins-cam0-mclk-off";
		camera_pins_cam0_mclk_2ma = "/fragment@99/__overlay__/camera-pins-cam0-mclk-2ma";
		camera_pins_cam0_mclk_4ma = "/fragment@99/__overlay__/camera-pins-cam0-mclk-4ma";
		camera_pins_cam0_mclk_6ma = "/fragment@99/__overlay__/camera-pins-cam0-mclk-6ma";
		camera_pins_cam0_mclk_8ma = "/fragment@99/__overlay__/camera-pins-cam0-mclk-8ma";
		camera_pins_cam0_rst_0 = "/fragment@99/__overlay__/cam0@0";
		camera_pins_cam0_rst_1 = "/fragment@99/__overlay__/cam0@1";
		camera_pins_cam0_oisvdd_0 = "/fragment@99/__overlay__/camera-pins-cam0-oisvdd-0";
		camera_pins_cam0_oisvdd_1 = "/fragment@99/__overlay__/camera-pins-cam0-oisvdd-1";
		camera_pins_cam1_mclk_off = "/fragment@99/__overlay__/camera-pins-cam1-mclk-off";
		camera_pins_cam1_mclk_2ma = "/fragment@99/__overlay__/camera-pins-cam1-mclk-2ma";
		camera_pins_cam1_mclk_4ma = "/fragment@99/__overlay__/camera-pins-cam1-mclk-4ma";
		camera_pins_cam1_mclk_6ma = "/fragment@99/__overlay__/camera-pins-cam1-mclk-6ma";
		camera_pins_cam1_mclk_8ma = "/fragment@99/__overlay__/camera-pins-cam1-mclk-8ma";
		camera_pins_cam1_rst_0 = "/fragment@99/__overlay__/cam1@0";
		camera_pins_cam1_rst_1 = "/fragment@99/__overlay__/cam1@1";
		camera_pins_cam1_scl_ap = "/fragment@99/__overlay__/cam1@2";
		camera_pins_cam1_scl_scp = "/fragment@99/__overlay__/cam1@3";
		camera_pins_cam1_sda_ap = "/fragment@99/__overlay__/cam1@4";
		camera_pins_cam1_sda_scp = "/fragment@99/__overlay__/cam1@5";
		camera_pins_cam1_eint = "/fragment@99/__overlay__/cam1@6";
		camera_pins_cam2_mclk_off = "/fragment@99/__overlay__/camera-pins-cam2-mclk-off";
		camera_pins_cam2_mclk_2ma = "/fragment@99/__overlay__/camera-pins-cam2-mclk-2ma";
		camera_pins_cam2_mclk_4ma = "/fragment@99/__overlay__/camera-pins-cam2-mclk-4ma";
		camera_pins_cam2_mclk_6ma = "/fragment@99/__overlay__/camera-pins-cam2-mclk-6ma";
		camera_pins_cam2_mclk_8ma = "/fragment@99/__overlay__/camera-pins-cam2-mclk-8ma";
		camera_pins_cam2_rst_0 = "/fragment@99/__overlay__/cam2@0";
		camera_pins_cam2_rst_1 = "/fragment@99/__overlay__/cam2@1";
		camera_pins_cam2_dvdd_0 = "/fragment@99/__overlay__/cam2@2";
		camera_pins_cam2_dvdd_1 = "/fragment@99/__overlay__/cam2@3";
		camera_pins_cam4_oisen_0 = "/fragment@99/__overlay__/cam4@4";
		camera_pins_cam4_oisen_1 = "/fragment@99/__overlay__/cam4@5";
		camera_pins_cam3_mclk_off = "/fragment@99/__overlay__/camera-pins-cam3-mclk-off";
		camera_pins_cam3_mclk_2ma = "/fragment@99/__overlay__/camera-pins-cam3-mclk-2ma";
		camera_pins_cam3_mclk_4ma = "/fragment@99/__overlay__/camera-pins-cam3-mclk-4ma";
		camera_pins_cam3_mclk_6ma = "/fragment@99/__overlay__/camera-pins-cam3-mclk-6ma";
		camera_pins_cam3_mclk_8ma = "/fragment@99/__overlay__/camera-pins-cam3-mclk-8ma";
		camera_pins_cam3_rst_0 = "/fragment@99/__overlay__/cam0@6";
		camera_pins_cam3_rst_1 = "/fragment@99/__overlay__/cam0@7";
		camera_pins_cam3_dvdd_0 = "/fragment@99/__overlay__/cam0@8";
		camera_pins_cam3_dvdd_1 = "/fragment@99/__overlay__/cam0@9";
		camera_pins_cam3_oisen_0 = "/fragment@99/__overlay__/cam0@10";
		camera_pins_cam3_oisen_1 = "/fragment@99/__overlay__/cam0@11";
		camera_pins_default = "/fragment@99/__overlay__/camdefault";
		main_af_endpoint = "/fragment@100/__overlay__/port@0/endpoint";
		main_af_cam1_endpoint = "/fragment@100/__overlay__/port@1/endpoint";
		main_af = "/fragment@101/__overlay__/camera-af-main@c/port/endpoint";
		mtk_camera_eeprom0 = "/fragment@101/__overlay__/camera-eeprom0@51";
		sensor0 = "/fragment@101/__overlay__/sensor0@10";
		sensor0_out = "/fragment@101/__overlay__/sensor0@10/port/endpoint";
		main_af_cam1 = "/fragment@102/__overlay__/camera-af-main@c/port/endpoint";
		sensor2 = "/fragment@102/__overlay__/sensor2@10";
		sensor2_out = "/fragment@102/__overlay__/sensor2@10/port/endpoint";
		mtk_camera_eeprom2 = "/fragment@102/__overlay__/camera-eeprom2@50";
		sensor3 = "/fragment@104/__overlay__/sensor3@10";
		sensor3_out = "/fragment@104/__overlay__/sensor3@10/port/endpoint";
		mtk_camera_eeprom3 = "/fragment@104/__overlay__/camera-eeprom3@52";
		sensor1 = "/fragment@105/__overlay__/sensor1@10";
		sensor1_out = "/fragment@105/__overlay__/sensor1@10/port/endpoint";
		mtk_camera_eeprom1 = "/fragment@105/__overlay__/camera-eeprom1@51";
		ocp81373 = "/fragment@106/__overlay__/ocp81373@63";
		fl_core_0 = "/fragment@106/__overlay__/ocp81373@63/flash@0/port/endpoint";
		fl_core_1 = "/fragment@106/__overlay__/ocp81373@63/flash@1/port/endpoint";
		ocp81373_pins_hwen_high = "/fragment@107/__overlay__/hwen-high";
		ocp81373_pins_hwen_low = "/fragment@107/__overlay__/hwen-low";
		flashlight_0 = "/fragment@108/__overlay__/port@0/endpoint";
		flashlight_1 = "/fragment@108/__overlay__/port@1/endpoint";
		camera0 = "/fragment@109/__overlay__/camera0";
		camera0_crit = "/fragment@109/__overlay__/camera0/trips/camera0-crit";
		camera1 = "/fragment@109/__overlay__/camera1";
		camera1_crit = "/fragment@109/__overlay__/camera1/trips/camera1-crit";
		camera2 = "/fragment@109/__overlay__/camera2";
		camera2_crit = "/fragment@109/__overlay__/camera2/trips/camera2-crit";
		camera3 = "/fragment@109/__overlay__/camera3";
		camera3_crit = "/fragment@109/__overlay__/camera3/trips/camera3-crit";
		nfc_default = "/fragment@112/__overlay__/nfc_default";
		nfc_int_active = "/fragment@112/__overlay__/nfc_int_active";
		nfc_int_suspend = "/fragment@112/__overlay__/nfc_int_suspend";
		nfc_enable_active = "/fragment@112/__overlay__/nfc_enable_active";
		nfc_enable_suspend = "/fragment@112/__overlay__/nfc_enable_suspend";
		nfc_firmwaredownload_active = "/fragment@112/__overlay__/nfc_firmwaredownload_active";
		nfc_firmwaredownload_suspend = "/fragment@112/__overlay__/nfc_firmwaredownload_suspend";
		nfc_clk_req_active = "/fragment@112/__overlay__/nfc_clk_req_active";
		nfc_clk_req_suspend = "/fragment@112/__overlay__/nfc_clk_req_suspend";
		nxp_ese_spi_mode = "/fragment@114/__overlay__/nxp_ese_spi_mode";
	};

	__fixups__ {
		odm = "/fragment@0:target:0\0/fragment@2:target:0\0/fragment@4:target:0\0/fragment@80:target:0\0/fragment@88:target:0\0/fragment@93:target:0\0/fragment@96:target:0";
		pio = "/fragment@0/__overlay__/simtray:status-gpio:0\0/fragment@1:target:0\0/fragment@2/__overlay__/mi_t1_chip:t1_ant4_vc1:0\0/fragment@2/__overlay__/mi_t1_chip:t1_ant4_vc2:0\0/fragment@2/__overlay__/mi_t1_chip:t1_ant4_vc3:0\0/fragment@3:target:0\0/fragment@4/__overlay__/xiaomi_wifi_gpio:status-gpio:0\0/fragment@11:target:0\0/fragment@15/__overlay__/panel1@0:reset-gpios:0\0/fragment@15/__overlay__/panel2@1:reset-gpios:0\0/fragment@15/__overlay__/panel3@2:reset-gpios:0\0/fragment@15/__overlay__/panel4@3:reset-gpios:0\0/fragment@16/__overlay__:interrupt-parent:0\0/fragment@17/__overlay__/panel1@0:reset-gpios:0\0/fragment@17/__overlay__/panel1@0:mi,esd-err-irq-gpio:0\0/fragment@17/__overlay__/panel1@0:dvdd-gpios:0\0/fragment@17/__overlay__/panel1@0:x7-bucken-gpios:0\0/fragment@17/__overlay__/panel1@0:x7-vio18-gpios:0\0/fragment@17/__overlay__/panel2@1:reset-gpios:0\0/fragment@17/__overlay__/panel2@1:mi,esd-err-irq-gpio:0\0/fragment@17/__overlay__/panel2@1:dvdd-gpios:0\0/fragment@17/__overlay__/panel2@1:x7-bucken-gpios:0\0/fragment@17/__overlay__/panel2@1:x7-vio18-gpios:0\0/fragment@19/__overlay__/volup-key:gpios:0\0/fragment@20:target:0\0/fragment@25:target:0\0/fragment@30/__overlay__/aw882xx_smartpa@34:reset-gpio:0\0/fragment@30/__overlay__/aw882xx_smartpa@34:irq-gpio:0\0/fragment@30/__overlay__/aw882xx_smartpa@34:spk-sw-gpio:0\0/fragment@30/__overlay__/aw882xx_smartpa@35:reset-gpio:0\0/fragment@30/__overlay__/aw882xx_smartpa@35:irq-gpio:0\0/fragment@39:target:0\0/fragment@41/__overlay__/sc858x-charger@6E:sc,sc858x,irq-gpio:0\0/fragment@41/__overlay__/sc858x-charger@6E:mt6375_ovp_en_gpio:0\0/fragment@41/__overlay__/sc858x-charger@6F:sc,sc858x,irq-gpio:0\0/fragment@42/__overlay__:sbu_uart_en:0\0/fragment@43/__overlay__:sbu_uart_en:0\0/fragment@44:target:0\0/fragment@45/__overlay__/nvt:nvt,always08:0\0/fragment@45/__overlay__/nvt:nvt,always18:0\0/fragment@45/__overlay__/nvt:nvt,resetN:0\0/fragment@45/__overlay__/nvt:nvt,abnormal:0\0/fragment@45/__overlay__/nvt:nvt,ready:0\0/fragment@49/__overlay__:mt6375_control_gpio:0\0/fragment@50/__overlay__:mt6375_control_gpio:0\0/fragment@53:target:0\0/fragment@56/__overlay__:GPIO-FDD-BAND-SUPPORT-DETECT-3RD-PIN:0\0/fragment@56/__overlay__:GPIO-FDD-BAND-SUPPORT-DETECT-2ND-PIN:0\0/fragment@56/__overlay__:GPIO-FDD-BAND-SUPPORT-DETECT-1ST-PIN:0\0/fragment@56/__overlay__:GPIO-SIM1-HOT-PLUG:0\0/fragment@56/__overlay__:GPIO-SIM2-HOT-PLUG:0\0/fragment@56/__overlay__:GPIO-SIM1-SCLK:0\0/fragment@56/__overlay__:GPIO-SIM1-SRST:0\0/fragment@56/__overlay__:GPIO-SIM1-SIO:0\0/fragment@56/__overlay__:GPIO-SIM2-SCLK:0\0/fragment@56/__overlay__:GPIO-SIM2-SRST:0\0/fragment@56/__overlay__:GPIO-SIM2-SIO:0\0/fragment@58/__overlay__:interrupt-parent:0\0/fragment@58/__overlay__:deb-gpios:0\0/fragment@59/__overlay__:interrupt-parent:0\0/fragment@60/__overlay__:interrupt-parent:0\0/fragment@61/__overlay__:interrupt-parent:0\0/fragment@62/__overlay__:interrupt-parent:0\0/fragment@63/__overlay__:interrupt-parent:0\0/fragment@64/__overlay__:interrupt-parent:0\0/fragment@66:target:0\0/fragment@67:target:0\0/fragment@68/__overlay__/aw8697_haptic@5a:reset-gpio:0\0/fragment@68/__overlay__/aw8697_haptic@5a:irq-gpio:0\0/fragment@68/__overlay__/sih6887_haptic@6B:reset-gpio:0\0/fragment@68/__overlay__/sih6887_haptic@6B:irq-gpio:0\0/fragment@87/__overlay__/epa-elna-mtk/hwid:gpio:0\0/fragment@89/__overlay__/xiaomi_touch@0:interrupt-parent:0\0/fragment@89/__overlay__/xiaomi_touch@0:goodix,irq-gpio:0\0/fragment@89/__overlay__/xiaomi_touch@0:goodix,reset-gpio:0\0/fragment@89/__overlay__/xiaomi_touch@0:focaltech,irq-gpio:0\0/fragment@89/__overlay__/xiaomi_touch@0:focaltech,reset-gpio:0\0/fragment@92:target:0\0/fragment@93/__overlay__/xiaomi_fingerprint:xiaomi,gpio_irq:0\0/fragment@93/__overlay__/xiaomi_fingerprint:interrupt-parent:0\0/fragment@95:target:0\0/fragment@96/__overlay__/vcam_ldo:gpio:0\0/fragment@96/__overlay__/camera-wide-avdd2-1p8:gpio:0\0/fragment@96/__overlay__/camera-wide-dvdd-1p2:gpio:0\0/fragment@96/__overlay__/camera-tele-avdd-2p8:gpio:0\0/fragment@96/__overlay__/camera-tele-dvdd-1p1:gpio:0\0/fragment@99:target:0\0/fragment@107:target:0\0/fragment@111/__overlay__/nxp@28:qcom,nq-irq:0\0/fragment@111/__overlay__/nxp@28:interrupt-parent:0\0/fragment@111/__overlay__/nxp@28:qcom,nq-ven:0\0/fragment@111/__overlay__/nxp@28:qcom,nq-clkreq:0\0/fragment@111/__overlay__/nxp@28:tms,irq-gpio:0\0/fragment@111/__overlay__/nxp@28:tms,ven-gpio:0\0/fragment@111/__overlay__/nxp@28:tms,download-gpio:0\0/fragment@112:target:0\0/fragment@114:target:0\0/fragment@115/__overlay__/nuvolta_1652@41:pwr_det_gpio:0\0/fragment@115/__overlay__/nuvolta_1652@41:rx_irq_gpio:0\0/fragment@115/__overlay__/nuvolta_1652@41:rx_sleep_gpio:0\0/fragment@115/__overlay__/nuvolta_1652@41:reverse_chg_ovp_gpio:0\0/fragment@115/__overlay__/nuvolta_1652@41:reverse_boost_gpio:0";
		chosen = "/fragment@5:target:0";
		mtk_leds = "/fragment@6:target:0";
		mt6373_adc = "/fragment@7:target:0\0/fragment@72/__overlay__:io-channels:0\0/fragment@73/__overlay__:io-channels:0\0/fragment@74/__overlay__:io-channels:0\0/fragment@75/__overlay__:io-channels:0\0/fragment@76/__overlay__:io-channels:0";
		pmic_adc = "/fragment@8:target:0\0/fragment@42/__overlay__:io-channels:0\0/fragment@43/__overlay__:io-channels:0\0/fragment@77/__overlay__:io-channels:0\0/fragment@78/__overlay__:io-channels:0";
		mt6363keys = "/fragment@9:target:0";
		pdc = "/fragment@10:target:0";
		mtkfb = "/fragment@12:target:0";
		mmlsys_config = "/fragment@13:target:0";
		dispsys_config = "/fragment@14:target:0";
		dsi1 = "/fragment@15:target:0";
		dsi1_te = "/fragment@16:target:0";
		dsi0 = "/fragment@17:target:0";
		mt6373_vcn18io = "/fragment@17/__overlay__/panel1@0:vcn18io-supply:0\0/fragment@17/__overlay__/panel2@1:vcn18io-supply:0";
		mt6373_vibr = "/fragment@17/__overlay__/panel1@0:vibr-supply:0\0/fragment@17/__overlay__/panel2@1:vibr-supply:0";
		connfem = "/fragment@18:target:0\0/fragment@87:target:0";
		qm42195 = "/fragment@18/__overlay__/epa-elna:parts:0";
		qm45197 = "/fragment@18/__overlay__/epa-elna:parts:4";
		gpio_keys = "/fragment@19:target:0";
		pcie0 = "/fragment@21:target:0";
		pcie1 = "/fragment@22:target:0";
		pciephy0 = "/fragment@23:target:0";
		pciephy1 = "/fragment@24:target:0";
		mt6375_typec = "/fragment@26:target:0";
		typec_mux_switch = "/fragment@27:target:0";
		ps5170 = "/fragment@28:target:0";
		usb_dp_selector = "/fragment@29:target:0";
		i2c0 = "/fragment@30:target:0";
		sound = "/fragment@31:target:0";
		wifi = "/fragment@32:target:0";
		bt = "/fragment@33:target:0";
		mt6363_vbuck5 = "/fragment@34:target:0";
		mt6363_vbuck6 = "/fragment@35:target:0";
		mt6363_vsram_digrf = "/fragment@36:target:0";
		mt6363_vsram_modem = "/fragment@37:target:0";
		mt6363_vcn15 = "/fragment@38:target:0";
		i2c11 = "/fragment@40:target:0";
		i2c10 = "/fragment@41:target:0";
		charger = "/fragment@42:target:0";
		charger_gl = "/fragment@43:target:0";
		spi0 = "/fragment@45:target:0";
		uart1 = "/fragment@46:target:0";
		mtk_gauge = "/fragment@47:target:0";
		lk_charger = "/fragment@48:target:0";
		pd_cp_manager = "/fragment@49:target:0";
		pd_cp_manager_gl = "/fragment@50:target:0";
		u2port0 = "/fragment@51:target:0";
		irtx_pwm = "/fragment@52:target:0";
		mt6373_vrf18_aif = "/fragment@54:target:0";
		mt6373_vcn33_1 = "/fragment@55:target:0";
		gpio_usage_mapping = "/fragment@56:target:0";
		gpio = "/fragment@57:target:0";
		mrdump_ext_rst = "/fragment@58:target:0";
		rt5133_eint = "/fragment@59:target:0";
		nfc = "/fragment@60:target:0";
		subpmic_pmu_eint = "/fragment@61:target:0";
		smart_pa = "/fragment@62:target:0";
		dsi_te = "/fragment@63:target:0";
		md1_sim1_hot_plug_eint = "/fragment@64:target:0";
		keypad = "/fragment@65:target:0";
		i2c1 = "/fragment@68:target:0";
		tboard_thermistor1 = "/fragment@69:target:0";
		tboard_thermistor2 = "/fragment@70:target:0";
		tboard_thermistor3 = "/fragment@71:target:0";
		tboard_thermistor4 = "/fragment@72:target:0\0/fragment@79/__overlay__/quiet_therm:thermal-sensors:0";
		tboard_thermistor5 = "/fragment@73:target:0\0/fragment@79/__overlay__/charger1_therm:thermal-sensors:0";
		tboard_thermistor6 = "/fragment@74:target:0";
		tboard_thermistor7 = "/fragment@75:target:0\0/fragment@79/__overlay__/wifi_therm:thermal-sensors:0";
		tboard_thermistor8 = "/fragment@76:target:0\0/fragment@79/__overlay__/flash_therm:thermal-sensors:0";
		tboard_thermistor9 = "/fragment@77:target:0\0/fragment@79/__overlay__/X7_therm:thermal-sensors:0";
		tboard_thermistor10 = "/fragment@78:target:0\0/fragment@79/__overlay__/ScreenPmic_therm:thermal-sensors:0";
		thermal_zones = "/fragment@79:target:0\0/fragment@109:target:0";
		mtee_svp = "/fragment@81:target:0";
		mtkheap_page_svp = "/fragment@82:target:0";
		mtkheap_page_tee = "/fragment@83:target:0";
		mtkheap_page_wfd = "/fragment@84:target:0";
		mtkheap_region_svp = "/fragment@85:target:0";
		mtkheap_region_wfd = "/fragment@86:target:0";
		qm42639 = "/fragment@87/__overlay__/epa-elna-mtk:parts:0\0/fragment@87/__overlay__/epa-elna-mtk:parts:8";
		qm45639 = "/fragment@87/__overlay__/epa-elna-mtk:parts:4\0/fragment@87/__overlay__/epa-elna-mtk:parts:12";
		spi6 = "/fragment@89:target:0";
		mt6373_vant18 = "/fragment@89/__overlay__/xiaomi_touch@0:iovdd-supply:0\0/fragment@89/__overlay__/xiaomi_touch@0:iovdd_focal-supply:0\0/fragment@90:target:0";
		mt6373_vcn33_3 = "/fragment@89/__overlay__/xiaomi_touch@0:avdd-supply:0\0/fragment@89/__overlay__/xiaomi_touch@0:avdd_focal-supply:0\0/fragment@91:target:0";
		mt6373_vcn33_2 = "/fragment@93/__overlay__/xiaomi_fingerprint:vfp-supply:0\0/fragment@94:target:0";
		i2c6 = "/fragment@97:target:0\0/fragment@106:target:0";
		seninf_top = "/fragment@98:target:0";
		csi_efuse0 = "/fragment@98/__overlay__/seninf-csi-port-0:nvmem-cells:0";
		csi_efuse1 = "/fragment@98/__overlay__/seninf-csi-port-1:nvmem-cells:0";
		csi_efuse2 = "/fragment@98/__overlay__/seninf-csi-port-2:nvmem-cells:0";
		csi_efuse4 = "/fragment@98/__overlay__/seninf-csi-port-4:nvmem-cells:0";
		mtk_composite_v4l2_2 = "/fragment@100:target:0";
		i2c2 = "/fragment@101:target:0";
		mt6373_vrfio18_aif = "/fragment@101/__overlay__/sensor0@10:dovdd-supply:0\0/fragment@102/__overlay__/sensor2@10:dovdd-supply:0\0/fragment@104/__overlay__/sensor3@10:dvdd2-supply:0\0/fragment@105/__overlay__/sensor1@10:dovdd-supply:0";
		topckgen_clk = "/fragment@101/__overlay__/sensor0@10:clocks:0\0/fragment@101/__overlay__/sensor0@10:clocks:8\0/fragment@101/__overlay__/sensor0@10:clocks:16\0/fragment@101/__overlay__/sensor0@10:clocks:24\0/fragment@101/__overlay__/sensor0@10:clocks:32\0/fragment@101/__overlay__/sensor0@10:clocks:40\0/fragment@101/__overlay__/sensor0@10:clocks:48\0/fragment@101/__overlay__/sensor0@10:clocks:56\0/fragment@102/__overlay__/sensor2@10:clocks:0\0/fragment@102/__overlay__/sensor2@10:clocks:8\0/fragment@102/__overlay__/sensor2@10:clocks:16\0/fragment@102/__overlay__/sensor2@10:clocks:24\0/fragment@102/__overlay__/sensor2@10:clocks:32\0/fragment@102/__overlay__/sensor2@10:clocks:40\0/fragment@102/__overlay__/sensor2@10:clocks:48\0/fragment@102/__overlay__/sensor2@10:clocks:56\0/fragment@104/__overlay__/sensor3@10:clocks:0\0/fragment@104/__overlay__/sensor3@10:clocks:8\0/fragment@104/__overlay__/sensor3@10:clocks:16\0/fragment@104/__overlay__/sensor3@10:clocks:24\0/fragment@104/__overlay__/sensor3@10:clocks:32\0/fragment@104/__overlay__/sensor3@10:clocks:40\0/fragment@104/__overlay__/sensor3@10:clocks:48\0/fragment@104/__overlay__/sensor3@10:clocks:56\0/fragment@105/__overlay__/sensor1@10:clocks:0\0/fragment@105/__overlay__/sensor1@10:clocks:8\0/fragment@105/__overlay__/sensor1@10:clocks:16\0/fragment@105/__overlay__/sensor1@10:clocks:24\0/fragment@105/__overlay__/sensor1@10:clocks:32\0/fragment@105/__overlay__/sensor1@10:clocks:40\0/fragment@105/__overlay__/sensor1@10:clocks:48\0/fragment@105/__overlay__/sensor1@10:clocks:56";
		i2c4 = "/fragment@102:target:0";
		i2c7 = "/fragment@103:target:0\0/fragment@115:target:0";
		i2c8 = "/fragment@104:target:0";
		mt6373_vfp = "/fragment@104/__overlay__/sensor3@10:dovdd-supply:0";
		i2c9 = "/fragment@105:target:0";
		vlp_cksys_clk = "/fragment@105/__overlay__/sensor1@10:clocks:64";
		mtk_composite_v4l2_1 = "/fragment@108:target:0";
		mitee = "/fragment@110:target:0";
		i2c3 = "/fragment@111:target:0";
		spi5 = "/fragment@113:target:0";
		mt6375_otg_vbus = "/fragment@115/__overlay__/nuvolta_1652@41:pmic_vbus-supply:0";
		wls_cp_manager = "/fragment@116:target:0";
	};

	__local_fixups__ {

		fragment@2 {

			__overlay__ {

				mi_t1_chip {
					pinctrl-0 = <0x00>;
				};
			};
		};

		fragment@4 {

			__overlay__ {

				xiaomi_wifi_gpio {
					pinctrl-0 = <0x00>;
				};
			};
		};

		fragment@12 {

			__overlay__ {
				pinctrl-0 = <0x00>;
				pinctrl-1 = <0x00>;
				pinctrl-2 = <0x00>;
				pinctrl-3 = <0x00>;
				pinctrl-4 = <0x00>;
				pinctrl-5 = <0x00>;
				pinctrl-6 = <0x00>;
				pinctrl-7 = <0x00>;
				pinctrl-8 = <0x00>;
				pinctrl-9 = <0x00>;
			};
		};

		fragment@14 {

			__overlay__ {
				pinctrl-0 = <0x00>;
				pinctrl-1 = <0x00>;
			};
		};

		fragment@15 {

			__overlay__ {

				panel1@0 {

					port {

						endpoint {
							remote-endpoint = <0x00>;
						};
					};
				};

				panel2@1 {

					port {

						endpoint {
							remote-endpoint = <0x00>;
						};
					};
				};

				panel3@2 {

					port {

						endpoint {
							remote-endpoint = <0x00>;
						};
					};
				};

				panel4@3 {

					port {

						endpoint {
							remote-endpoint = <0x00>;
						};
					};
				};

				ports {

					port {

						endpoint@0 {
							remote-endpoint = <0x00>;
						};

						endpoint@1 {
							remote-endpoint = <0x00>;
						};

						endpoint@2 {
							remote-endpoint = <0x00>;
						};

						endpoint@3 {
							remote-endpoint = <0x00>;
						};
					};
				};
			};
		};

		fragment@17 {

			__overlay__ {

				panel1@0 {

					port {

						endpoint {
							remote-endpoint = <0x00>;
						};
					};
				};

				panel2@1 {

					port {

						endpoint {
							remote-endpoint = <0x00>;
						};
					};
				};

				ports {

					port {

						endpoint {
							remote-endpoint = <0x00>;
						};
					};
				};
			};
		};

		fragment@19 {

			__overlay__ {
				pinctrl-0 = <0x00>;
			};
		};

		fragment@21 {

			__overlay__ {
				pinctrl-0 = <0x00>;
				pinctrl-1 = <0x00>;
				pinctrl-2 = <0x00>;
			};
		};

		fragment@22 {

			__overlay__ {
				pinctrl-0 = <0x00>;
			};
		};

		fragment@26 {

			__overlay__ {

				port {

					endpoint {
						remote-endpoint = <0x00>;
					};
				};
			};
		};

		fragment@27 {

			__overlay__ {

				port {

					endpoint {
						remote-endpoint = <0x00>;
					};
				};
			};
		};

		fragment@31 {

			__overlay__ {

				mediatek,speaker-codec {
					sound-dai = <0x00 0x04>;
				};

				mediatek,speaker-codec-fs {
					sound-dai = <0x00>;
				};
			};
		};

		fragment@45 {

			__overlay__ {

				nvt {
					pinctrl-0 = <0x00 0x04 0x08 0x0c>;
					pinctrl-1 = <0x00 0x04>;
				};
			};
		};

		fragment@52 {

			__overlay__ {
				pinctrl-0 = <0x00>;
				pinctrl-1 = <0x00>;
			};
		};

		fragment@68 {

			__overlay__ {

				aw8697_haptic@5a {
					pinctrl-0 = <0x00>;
					pinctrl-1 = <0x00>;
					pinctrl-2 = <0x00>;
				};

				sih6887_haptic@6B {
					pinctrl-0 = <0x00>;
					pinctrl-1 = <0x00>;
					pinctrl-2 = <0x00>;
				};
			};
		};

		fragment@88 {

			__overlay__ {

				xiaomi_touch {
					panel = <0x00 0x04>;
				};
			};
		};

		fragment@89 {

			__overlay__ {

				xiaomi_touch@0 {
					pinctrl-0 = <0x00 0x04>;
					pinctrl-1 = <0x00 0x04>;
					pinctrl-2 = <0x00 0x04 0x08>;
					pinctrl-3 = <0x00>;
					pinctrl-4 = <0x00>;
				};
			};
		};

		fragment@93 {

			__overlay__ {

				xiaomi_fingerprint {
					pinctrl-0 = <0x00>;
					pinctrl-1 = <0x00>;
					pinctrl-2 = <0x00>;
					pinctrl-3 = <0x00>;
					pinctrl-4 = <0x00>;
					pinctrl-5 = <0x00>;
				};
			};
		};

		fragment@98 {

			__overlay__ {

				seninf-csi-port-0 {

					port {

						endpoint {
							remote-endpoint = <0x00>;
						};
					};
				};

				seninf-csi-port-1 {

					port {

						endpoint {
							remote-endpoint = <0x00>;
						};
					};
				};

				seninf-csi-port-2 {

					port {

						endpoint {
							remote-endpoint = <0x00>;
						};
					};
				};

				seninf-csi-port-4 {

					port {

						endpoint {
							remote-endpoint = <0x00>;
						};
					};
				};
			};
		};

		fragment@100 {

			__overlay__ {

				port@0 {

					endpoint {
						remote-endpoint = <0x00>;
					};
				};

				port@1 {

					endpoint {
						remote-endpoint = <0x00>;
					};
				};
			};
		};

		fragment@101 {

			__overlay__ {

				camera-af-main@c {
					vin-supply = <0x00>;

					port {

						endpoint {
							remote-endpoint = <0x00>;
						};
					};
				};

				sensor0@10 {
					pinctrl-0 = <0x00>;
					pinctrl-1 = <0x00>;
					pinctrl-2 = <0x00>;
					pinctrl-3 = <0x00>;
					pinctrl-4 = <0x00>;
					pinctrl-5 = <0x00>;
					pinctrl-6 = <0x00>;
					avdd-supply = <0x00>;
					avdd1-supply = <0x00>;
					dvdd-supply = <0x00>;
					dvdd1-supply = <0x00>;
					afvdd-supply = <0x00>;

					port {

						endpoint {
							remote-endpoint = <0x00>;
						};
					};
				};
			};
		};

		fragment@102 {

			__overlay__ {

				camera-af-main@c {
					vin-supply = <0x00>;

					port {

						endpoint {
							remote-endpoint = <0x00>;
						};
					};
				};

				sensor2@10 {
					pinctrl-0 = <0x00>;
					pinctrl-1 = <0x00>;
					pinctrl-2 = <0x00>;
					pinctrl-3 = <0x00>;
					pinctrl-4 = <0x00>;
					pinctrl-5 = <0x00>;
					pinctrl-6 = <0x00>;
					avdd-supply = <0x00>;
					dvdd-supply = <0x00>;
					dvdd1-supply = <0x00>;
					avdd1-supply = <0x00>;
					dvdd2-supply = <0x00>;
					afvdd-supply = <0x00>;

					port {

						endpoint {
							remote-endpoint = <0x00>;
						};
					};
				};
			};
		};

		fragment@104 {

			__overlay__ {

				sensor3@10 {
					pinctrl-0 = <0x00>;
					pinctrl-1 = <0x00>;
					pinctrl-2 = <0x00>;
					pinctrl-3 = <0x00>;
					pinctrl-4 = <0x00>;
					pinctrl-5 = <0x00>;
					pinctrl-6 = <0x00>;
					avdd-supply = <0x00>;
					avdd1-supply = <0x00>;
					dvdd-supply = <0x00>;
					dvdd1-supply = <0x00>;

					port {

						endpoint {
							remote-endpoint = <0x00>;
						};
					};
				};
			};
		};

		fragment@105 {

			__overlay__ {

				sensor1@10 {
					pinctrl-0 = <0x00>;
					pinctrl-1 = <0x00>;
					pinctrl-2 = <0x00>;
					pinctrl-3 = <0x00>;
					pinctrl-4 = <0x00>;
					pinctrl-5 = <0x00>;
					pinctrl-6 = <0x00>;
					pinctrl-7 = <0x00>;
					pinctrl-8 = <0x00>;
					pinctrl-9 = <0x00>;
					pinctrl-10 = <0x00>;
					pinctrl-11 = <0x00>;
					avdd-supply = <0x00>;
					dvdd-supply = <0x00>;
					dvdd1-supply = <0x00>;

					port {

						endpoint {
							remote-endpoint = <0x00>;
						};
					};
				};
			};
		};

		fragment@106 {

			__overlay__ {

				ocp81373@63 {
					pinctrl-0 = <0x00>;
					pinctrl-1 = <0x00>;

					flash@0 {

						port {

							endpoint {
								remote-endpoint = <0x00>;
							};
						};
					};

					flash@1 {

						port {

							endpoint {
								remote-endpoint = <0x00>;
							};
						};
					};
				};
			};
		};

		fragment@108 {

			__overlay__ {

				port@0 {

					endpoint {
						remote-endpoint = <0x00>;
					};
				};

				port@1 {

					endpoint {
						remote-endpoint = <0x00>;
					};
				};
			};
		};

		fragment@109 {

			__overlay__ {

				camera0 {
					thermal-sensors = <0x00>;
				};

				camera1 {
					thermal-sensors = <0x00>;
				};

				camera2 {
					thermal-sensors = <0x00>;
				};

				camera3 {
					thermal-sensors = <0x00>;
				};
			};
		};

		fragment@111 {

			__overlay__ {

				nxp@28 {
					pinctrl-0 = <0x00>;
					pinctrl-1 = <0x00 0x04 0x08 0x0c>;
					pinctrl-2 = <0x00 0x04 0x08 0x0c>;
				};
			};
		};

		fragment@113 {

			__overlay__ {

				p61@31 {
					pinctrl-0 = <0x00>;
				};
			};
		};
	};
};
